## imx/meta-fsl-demos/conf/layer.conf
```bitbake
# We have a conf and classes directory, add to BBPATH
BBPATH .= ":${LAYERDIR}"

# We have a packages directory, add to BBFILES
BBFILES += "${LAYERDIR}/recipes-*/*/*.bb \
            ${LAYERDIR}/recipes-*/*/*.bbappend"

BBFILE_COLLECTIONS += "fsl-bsp-release"
BBFILE_PATTERN_fsl-bsp-release := "^${LAYERDIR}"
BBFILE_PRIORITY_fsl-bsp-release = "8"

BBMASK .= "${@base_contains('MACHINE', 'imx6slevk','|meta-fsl-arm/recipes-graphics/mesa', '', d)}"

MACHINE_GSTREAMER_1_0_PLUGIN_mx6 = "gst1.0-fsl-plugin"
```

## imx/meta-fsl-qt5/conf/layer.conf
```bitbake
# We have a conf and classes directory, add to BBPATH
BBPATH .= ":${LAYERDIR}"

# We have a packages directory, add to BBFILES
BBFILES += "${LAYERDIR}/recipes-*/*/*.bb \
            ${LAYERDIR}/recipes-*/*/*.bbappend"

BBFILE_COLLECTIONS += "fsl-bsp-release"
BBFILE_PATTERN_fsl-bsp-release := "^${LAYERDIR}"
BBFILE_PRIORITY_fsl-bsp-release = "8"

# Use this to ignore the bbappends in the  meta-qt5.  
# The meta-fsl-bsp-release layer has the correct version of bbappend.

BBMASK = ".*meta-qt5/recipes-devtools/cmake"
```

## imx/meta-sdk/conf/distro/fsl-imx-release-dfb.conf
```bitbake
# i.MX DISTRO for Direct Frame Buffer

include conf/distro/include/fsl-imx-base.inc
include conf/distro/include/fsl-imx-providers.inc

DISTRO = "fsl-imx-release-dfb"

# Remove backends that conflict with directfb and add directfb

DISTRO_FEATURES_remove = "x11 wayland "
DISTRO_FEATURES_append = " directfb opengl"
```

## imx/meta-sdk/conf/distro/fsl-imx-release-fb.conf
```bitbake
# This is the DISTRO for the FrameBuffer only graphical backend.

include conf/distro/include/fsl-imx-base.inc
include conf/distro/include/fsl-imx-providers.inc

DISTRO = "fsl-imx-release-fb"

# Remove conflicting backends.
DISTRO_FEATURES_remove = "x11 wayland directfb "
```

## imx/meta-sdk/conf/distro/fsl-imx-release-wayland.conf
```bitbake
# Distro for Wayland without X11

include conf/distro/include/fsl-imx-base.inc
include conf/distro/include/fsl-imx-providers.inc

DISTRO = "fsl-imx-release-wayland"

# Remove conflicting backends
DISTRO_FEATURES_remove = "directfb x11 "
DISTRO_FEATURES_append = " wayland"
```

## imx/meta-sdk/conf/distro/fsl-imx-release-x11.conf
```bitbake
include conf/distro/include/fsl-imx-base.inc
include conf/distro/include/fsl-imx-providers.inc

DISTRO = "fsl-imx-release-x11"

# Remove conflicting backends.
DISTRO_FEATURES_remove = "wayland"

# These are X11 specific
DISTRO_FEATURES_append = " x11"
```

## imx/meta-sdk/conf/distro/fsl-imx-release-xwayland.conf
```bitbake
# Distro for Wayland with X11

DISTRO = "fsl-imx-release-xwayland"

include conf/distro/include/fsl-imx-base.inc

# Remove conflicting backends
DISTRO_FEATURES_remove = "directfb "
DISTRO_FEATURES_append = " x11 wayland pam"

PREFERRED_PROVIDER_virtual/mesa_mx6q = ""
PREFERRED_PROVIDER_virtual/mesa_mx6dl = ""
PREFERRED_PROVIDER_virtual/mesa_mx6sx = ""
PREFERRED_PROVIDER_virtual/mesa_mx6sl = ""

XSERVER_remove = "xf86-video-fbdev xf86-video-imxfb-vivante xf86-input-evdev"
```

## imx/meta-sdk/conf/distro/fsl-imx-release.conf
```bitbake
require conf/distro/poky.conf

DISTRO = "fsl-imx-release"

# Comment out the 2 lines below to use bluez4.
DISTRO_FEATURES_append_mx6 = " bluez5"
DISTRO_FEATURES_append_mx7 = " bluez5"

# Preferred Providers
PREFERRED_PROVIDER_u-boot_mx5 = "u-boot-fslc"
PREFERRED_PROVIDER_u-boot_mx6 = "u-boot-imx"
PREFERRED_PROVIDER_u-boot_mx7 = "u-boot-imx"

PREFERRED_PROVIDER_virtual/kernel_mx6 = "linux-imx"
PREFERRED_PROVIDER_virtual/kernel_mx7 = "linux-imx"

PREFERRED_PROVIDER_virtual/libgal-x11_mx6 = "imx-gpu-viv"
PREFERRED_PROVIDER_virtual/libopenvg_mx6q = "imx-gpu-viv"
PREFERRED_PROVIDER_virtual/libopenvg_mx6dl = "imx-gpu-viv"
PREFERRED_PROVIDER_virtual/libopenvg_mx6sx = "imx-gpu-viv"
PREFERRED_PROVIDER_virtual/libopenvg_mx6sl = "imx-gpu-viv"

# Preferred Versions

# set these because of meta-fsl-arm override to new xorg version
PREFERRED_VERSION_xserver-xorg_mx6q = "2:1.17.0"
PREFERRED_VERSION_xserver-xorg_mx6dl = "2:1.17.0"
PREFERRED_VERSION_xserver-xorg_mx6s = "2:1.17.0"
PREFERRED_VERSION_xserver-xorg_mx6sl = "2:1.17.0"
PREFERRED_VERSION_xserver-xorg_mx6sx = "2:1.17.0"
PREFERRED_VERSION_xserver-xorg_mx6ul = "2:1.17.0"
PREFERRED_VERSION_xserver-xorg_mx7 = "2:1.17.0"

PREFERRED_VERSION_xtrans = "1.3.5"

# preferred versions of recipes-graphics
FP_TAG = "${@base_contains("TUNE_FEATURES", "callconvention-hard", "-hfp", "-sfp", d)}"

PREFERRED_VERSION_imx-gpu-viv = "5.0.11.p7.1${FP_TAG}"
PREFERRED_VERSION_xf86-video-imxfb-vivante = "5.0.11.p7.1"
PREFERRED_VERSION_imx-gpu-viv-kernel = "5.0.11.p7.1"

PREFERRED_VERSION_fsl-gpu-sdk_mx6 = "2.1"

# Use Wayland new version
BBMASK = "meta-fsl-arm/recipes-graphics/wayland/weston_%.bbappend"
BBMASK .= "|meta-fsl-arm/recipes-graphics/mesa/mesa_%.bbappend"

# Remove the GST patch on the community
BBMASK .= "|meta-fsl-arm/recipes-multimedia/gstreamer/gstreamer1.0-plugins-base_%.bbappend"
PREFERRED_VERSION_wayland_mx6 = "1.7.0"
PREFERRED_VERSION_weston_mx6 = "1.7.0"
PREFERRED_VERSION_wayland-native = "1.7.0"
PREFERRED_VERSION_libinput_mx6 = "0.11.0"

# Preferred versions of recipes-bsp
PREFERRED_VERSION_imx-vpu_mx5 = "11.09.02"
PREFERRED_VERSION_imx-vpu_mx6 = "5.4.30"
PREFERRED_VERSION_imx-lib_mx5 = "11.09.02"
PREFERRED_VERSION_imx-lib_mx6 = "5.1"
PREFERRED_VERSION_imx-lib_mx7 = "5.1"
PREFERRED_VERSION_imx-test = "5.1"
PREFERRED_VERSION_imx-uuc = "0.5"
PREFERRED_VERSION_imx-kobs = "5.1"
PREFERRED_VERSION_firmware-imx = "5.0"
PREFERRED_VERSION_u-boot-imx_mx6 = "2014.04"
PREFERRED_VERSION_u-boot-imx_mx7 = "2014.04"
PREFERRED_VERSION_u-boot-imx-mfgtool_mx6 = "2014.04"
PREFERRED_VERSION_u-boot-imx-mfgtool_mx7 = "2014.04"

# preferred versions of recipes-kernel
PREFERRED_VERSION_linux-libc-headers = "3.14"
PREFERRED_VERSION_linux-imx_mx6 = "3.14.38"
PREFERRED_VERSION_linux-imx_mx7 = "3.14.38"
PREFERRED_VERSION_mfgtool-linux-imx_mx6 = "3.14.38"
PREFERRED_VERSION_mfgtool-linux-imx_mx7 = "3.14.38"
PREFERRED_VERSION_linux-mfgtool_mx6 = "3.14.38"
PREFERRED_VERSION_linux-imx-mfg_mx6 = "3.14.38"
PREFERRED_VERSION_linux-mfgtool_mx7 = "3.14.38"
PREFERRED_VERSION_linux-imx-mfg_mx7 = "3.14.38"

# preferred versions of recipes-multimedia
PREFERRED_VERSION_gst-fsl-plugin = "4.0.3"
PREFERRED_VERSION_libfslcodec = "4.0.6"
PREFERRED_VERSION_libfslparser = "4.0.6"
PREFERRED_VERSION_libfslvpuwrap = "1.0.58"
PREFERRED_VERSION_gst1.0-fsl-plugin = "4.0.6"
PREFERRED_VERSION_fsl-alsa-plugins = "1.0.25"
PREFERRED_VERSION_gst-plugins-gl = "0.10.3"
PREFERRED_VERSION_fslqtapplications = "1.0.4"

MACHINE_GSTREAMER_1_0_PLUGIN_mx6 = "gst1.0-fsl-plugin"
MACHINE_GSTREAMER_1_0_PLUGIN_mx6q = "gst1.0-fsl-plugin"
MACHINE_GSTREAMER_1_0_PLUGIN_mx6dl = "gst1.0-fsl-plugin"
MACHINE_GSTREAMER_1_0_PLUGIN_mx6sl = "gst1.0-fsl-plugin"
MACHINE_GSTREAMER_1_0_PLUGIN_mx6sx = "gst1.0-fsl-plugin"
MACHINE_GSTREAMER_1_0_PLUGIN_mx7 = "gst1.0-fsl-plugin"

MACHINE_GSTREAMER_PLUGIN_mx6ul = ""
MACHINE_GSTREAMER_PLUGIN_mx6qp = ""
MACHINE_GSTREAMER_PLUGIN_mx7 = ""

DEFAULTTUNE_mx6 ?= "cortexa9hf-neon"

SANITY_TESTED_DISTROS += " \
    Ubuntu-12.04 \n \
"
```

## imx/meta-sdk/conf/distro/fsl-imx-sfp-mx6.conf
```bitbake
# i.MX DISTRO showing how to tune for software floating point
# DEPRECATED: Note that software floating point has been deprecated
# and will not be available in future releases

# Start with desired base distro
require conf/distro/fsl-imx-x11.conf

# Override the tuning via a more-specific SOC_FAMILY variable override
DEFAULTTUNE_mx6q = "cortexa9-neon"
DEFAULTTUNE_mx6dl = "cortexa9-neon"
DEFAULTTUNE_mx6sx = "cortexa9-neon"
DEFAULTTUNE_mx6sl = "cortexa9-neon"
```

## imx/meta-sdk/conf/distro/fsl-imx-wayland.conf
```bitbake
# i.MX DISTRO for Wayland without X11

include conf/distro/include/fsl-imx-base.inc
include conf/distro/include/fsl-imx-preferred-env.inc

DISTRO = "fsl-imx-wayland"

# Remove conflicting backends
DISTRO_FEATURES_remove = "directfb x11 "
DISTRO_FEATURES_append = " wayland pam systemd"
```

## imx/meta-sdk/conf/distro/fsl-imx-x11.conf
```bitbake
# i.MX DISTRO for X11 with no wayland

include conf/distro/include/fsl-imx-base.inc
include conf/distro/include/fsl-imx-preferred-env.inc

DISTRO = "fsl-imx-x11"

# Remove conflicting backends.
DISTRO_FEATURES_remove = "wayland"

# These are X11 specific
DISTRO_FEATURES_append = " x11"

RDEPENDS_packagegroup-core-tools-testapps_remove = "mesa-demos"
RDEPENDS_packagegroup-fsl-tools-gpu-external_remove = "mesa-demos"
```

## imx/meta-sdk/conf/distro/fsl-imx-xwayland.conf
```bitbake
# i.MX DISTRO for Wayland with X11

include conf/distro/include/fsl-imx-base.inc
include conf/distro/include/fsl-imx-preferred-env.inc

DISTRO = "fsl-imx-xwayland"

# Remove conflicting backends
DISTRO_FEATURES_remove = "directfb "
DISTRO_FEATURES_append = " x11 wayland pam"

XSERVER_remove = "xf86-video-fbdev xf86-video-imxfb-vivante xf86-input-evdev"
```

## imx/meta-sdk/conf/distro/imx-x11-optee.conf
```bitbake
# i.MX DISTRO for X11 with OPTEE

require conf/distro/fsl-imx-x11.conf
require conf/distro/include/imx-optee.inc

DISTRO = "imx-x11-optee"
```

## imx/meta-sdk/conf/distro/imx-xwayland-optee.conf
```bitbake
# i.MX DISTRO for XWayland with OPTEE

require conf/distro/fsl-imx-xwayland.conf
require conf/distro/include/imx-optee.inc

DISTRO = "imx-xwayland-optee"
```

## imx/meta-sdk/conf/distro/include/fsl-imx-base.inc
```bitbake
DISTRO = "fsl-imx"
DISTRO_NAME = "NXP i.MX Release Distro"
DISTRO_VERSION = "4.19-warrior"

DISTRO_CODENAME = "warrior"
SDK_VENDOR = "-pokysdk"
SDK_VERSION := "${DISTRO_VERSION}"
#SDK_VERSION := "${@'${DISTRO_VERSION}'.replace('snapshot-${DATE}','snapshot')}"

MAINTAINER = "NXP <lauren.post@nxp.com>"

TARGET_VENDOR = "-poky"

LOCALCONF_VERSION = "1"

IMX_DEFAULT_DISTRO_FEATURES = "opengl ptest multiarch"
# Enable vulkan distro feature only for mx8
IMX_DEFAULT_DISTRO_FEATURES_append_mx8 = " vulkan"
# Enable jailhouse distro feature only for mx8m
IMX_DEFAULT_DISTRO_FEATURES_append_mx8m = " jailhouse"
IMX_DEFAULT_EXTRA_RDEPENDS = "packagegroup-core-boot"
IMX_DEFAULT_EXTRA_RRECOMMENDS = "kernel-module-af-packet"

BBMASK += "poky/meta/recipes-graphics/vulkan/vulkan_1.1.73.0.bb"

DISTRO_FEATURES ?= "${DISTRO_FEATURES_DEFAULT} ${DISTRO_FEATURES_LIBC} ${IMX_DEFAULT_DISTRO_FEATURES}"

SDK_NAME = "${DISTRO}-${TCLIBC}-${SDK_ARCH}-${IMAGE_BASENAME}-${TUNE_PKGARCH}"
SDKPATH = "/opt/${DISTRO}/${SDK_VERSION}"

DISTRO_EXTRA_RDEPENDS += " ${IMX_DEFAULT_EXTRA_RDEPENDS}"
DISTRO_EXTRA_RRECOMMENDS += " ${IMX_DEFAULT_EXTRA_RRECOMMENDS}"

TCLIBCAPPEND = ""

PREMIRRORS ??= "\
bzr://.*/.*   http://downloads.yoctoproject.org/mirror/sources/ \n \
cvs://.*/.*   http://downloads.yoctoproject.org/mirror/sources/ \n \
git://.*/.*   http://downloads.yoctoproject.org/mirror/sources/ \n \
gitsm://.*/.* http://downloads.yoctoproject.org/mirror/sources/ \n \
hg://.*/.*    http://downloads.yoctoproject.org/mirror/sources/ \n \
osc://.*/.*   http://downloads.yoctoproject.org/mirror/sources/ \n \
p4://.*/.*    http://downloads.yoctoproject.org/mirror/sources/ \n \
svn://.*/.*   http://downloads.yoctoproject.org/mirror/sources/ \n"

MIRRORS =+ "\
ftp://.*/.*      http://downloads.yoctoproject.org/mirror/sources/ \n \
http://.*/.*     http://downloads.yoctoproject.org/mirror/sources/ \n \
https://.*/.*    http://downloads.yoctoproject.org/mirror/sources/ \n"

# The CONNECTIVITY_CHECK_URI's are used to test whether we can succesfully
# fetch from the network (and warn you if not). To disable the test set
# the variable to be empty.
# Git example url: git://git.yoctoproject.org/yocto-firewall-test;protocol=git;rev=master
CONNECTIVITY_CHECK_URIS ?= "https://www.example.com/"

SANITY_TESTED_DISTROS ?= " \
            poky-2.5 \n \
            poky-2.6 \n \
            ubuntu-16.04 \n \
            ubuntu-18.04 \n \
            fedora-28 \n \
            centos-7 \n \
            debian-8 \n \
            debian-9 \n \
            opensuse-42.3 \n \
            "

#
# OELAYOUT_ABI allows us to notify users when the format of TMPDIR changes in
# an incompatible way. Such changes should usually be detailed in the commit
# that breaks the format and have been previously discussed on the mailing list
# with general agreement from the core team.
#
OELAYOUT_ABI = "11"

# add poky sanity bbclass
INHERIT += "poky-sanity"

# QA check settings - a little stricter than the OE-Core defaults
WARN_TO_ERROR_QA = "already-stripped compile-host-path install-host-path \
                    installed-vs-shipped ldflags pn-overrides rpaths staticdev \
                    useless-rpaths"
WARN_QA_remove = "${WARN_TO_ERROR_QA}"
ERROR_QA_append = " ${WARN_TO_ERROR_QA}"
```

## imx/meta-sdk/conf/distro/include/fsl-imx-preferred-env.inc
```bitbake
# Use i.MX Kernel, U-Boot and Gstreamer 1.0 providers
PREFERRED_PROVIDER_virtual/bootloader_imx = "u-boot-imx"
#PREFERRED_PROVIDER_virtual/bootloader_mx6 = "u-boot-imx"
#PREFERRED_PROVIDER_virtual/bootloader_mx6ul = "u-boot-imx"
#PREFERRED_PROVIDER_virtual/bootloader_mx6sll = "u-boot-imx"
#PREFERRED_PROVIDER_virtual/bootloader_mx7d = "u-boot-imx"
#PREFERRED_PROVIDER_virtual/bootloader_mx7ulp = "u-boot-imx"

PREFERRED_PROVIDER_virtual/kernel_imx = "linux-imx"
#PREFERRED_PROVIDER_virtual/kernel_mx6 = "linux-imx"
#PREFERRED_PROVIDER_virtual/kernel_mx6ul = "linux-imx"
#PREFERRED_PROVIDER_virtual/kernel_mx6sll = "linux-imx"
#PREFERRED_PROVIDER_virtual/kernel_mx7d = "linux-imx"
#PREFERRED_PROVIDER_virtual/kernel_mx7ulp = "linux-imx"
#PREFERRED_PROVIDER_virtual/kernel_imx7ulp_zebu = "linux-imx"

PREFERRED_VERSION_linux-libc-headers_imx = "4.14"

MACHINE_GSTREAMER_1_0_PLUGIN_mx6ul = "imx-gst1.0-plugin"
MACHINE_GSTREAMER_1_0_PLUGIN_mx6sll = "imx-gst1.0-plugin"
MACHINE_GSTREAMER_1_0_PLUGIN_mx6q = "imx-gst1.0-plugin"
MACHINE_GSTREAMER_1_0_PLUGIN_mx6dl = "imx-gst1.0-plugin"
MACHINE_GSTREAMER_1_0_PLUGIN_mx6sl = "imx-gst1.0-plugin"
MACHINE_GSTREAMER_1_0_PLUGIN_mx6sx = "imx-gst1.0-plugin"
MACHINE_GSTREAMER_1_0_PLUGIN_mx7d = "imx-gst1.0-plugin"
MACHINE_GSTREAMER_1_0_PLUGIN_mx7ulp = "imx-gst1.0-plugin"
MACHINE_GSTREAMER_1_0_PLUGIN_mx8 = "imx-gst1.0-plugin"

# Extra audio support
# Add support for ALL i.MX6/7/8 SoC families
MACHINE_EXTRA_RRECOMMENDS_append_imx = " ${@bb.utils.contains('DISTRO_FEATURES', 'alsa', 'imx-alsa-plugins', '', d)}"

# Default toolchains used in testing i.MX BSPs
DEFAULTTUNE_mx6   = "cortexa9hf-neon"
DEFAULTTUNE_mx6ul = "cortexa7hf-neon"
DEFAULTTUNE_mx6sll = "cortexa9hf-neon"
DEFAULTTUNE_mx7d   = "cortexa7hf-neon"
DEFAULTTUNE_mx7ulp = "cortexa7hf-neon"
DEFAULTTUNE_mx8 = "aarch64"

# Enable the kenrel loadable module as default
USE_GPU_VIV_MODULE = "1"

IMX_GPU_VERSION            ?= "6.2.4.p2.1"
IMX_GPU_VERSION_SUFFIX      = "aarch32"
IMX_GPU_VERSION_SUFFIX_mx8  = "aarch64"

PREFERRED_VERSION_imx-gpu-viv               = "${IMX_GPU_VERSION}-${IMX_GPU_VERSION_SUFFIX}"
PREFERRED_VERSION_xf86-video-imx-vivante    = "${IMX_GPU_VERSION}"
PREFERRED_VERSION_kernel-module-imx-gpu-viv = "${IMX_GPU_VERSION}"
PREFERRED_VERSION_imx-gpu-g2d               = "${IMX_GPU_VERSION}-${IMX_GPU_VERSION_SUFFIX}"

PREFERRED_VERSION_gstreamer1.0-plugins-base = "1.14.0.imx"
PREFERRED_VERSION_gstreamer1.0-plugins-bad  = "1.14.0.imx"
PREFERRED_VERSION_gstreamer1.0-plugins-good = "1.14.0.imx"
PREFERRED_VERSION_gstreamer1.0              = "1.14.0.imx"

# Use systemd as default init manager
VIRTUAL-RUNTIME_init_manager = "systemd"
PREFERRED_PROVIDER_udev = "systemd"
PREFERRED_PROVIDER_udev-utils = "systemd"
DISTRO_FEATURES_BACKFILL_CONSIDERED = "sysvinit"
IMX_DEFAULT_DISTRO_FEATURES += " systemd"

SOC_HAS_VIVANTE_KERNEL_DRIVER_SUPPORT_mx6 = "1"
SOC_HAS_VIVANTE_KERNEL_DRIVER_SUPPORT_mx7ulp = "1"

UBOOT_SUFFIX_mx6ul = "imx"
SPL_BINARY_mx6ul = ""
UBOOT_MAKE_TARGET_mx6ul = "u-boot.imx"
```
