## meta-bsp/conf/machine/imv8dxla1ddr3evk.conf
```bitbake
#@TYPE: Machine
#@NAME: i.MX 8DXL DDR3 EVK Board
#@DESCRIPTION: Machine configuration for NXP i.MX 8DXL DDR3 Evaluation Kit (EVK) Board
#@MAINTAINER: Lauren Post <lauren.post@nxp.com>

MACHINEOVERRIDES =. "mx8:mx8x:mx8dxl:mx8dxla1:"


require conf/machine/include/imx-base.inc
require conf/machine/include/arm/arch-arm64.inc
require conf/machine/include/imx8dxl-common.inc

UBOOT_CONFIG ??= "sd"
UBOOT_CONFIG[sd]   = "imx8dxl_ddr3_evk_defconfig,sdcard"
UBOOT_CONFIG[nand]   = "imx8dxl_ddr3_evk_nand_defconfig,ubifs"

BOARD_TYPE = "ddr3-evk"
```

## meta-bsp/conf/machine/imx6dlsabreauto.conf
```bitbake
#@TYPE: Machine
#@NAME: NXP i.MX6DL SABRE Automotive
#@SOC: i.MX6DL
#@DESCRIPTION: Machine configuration for NXP i.MX6DL SABRE Automotive
#@MAINTAINER: Daiane Angolini <daiane.angolini@nxp.com>

MACHINEOVERRIDES =. "mx6:mx6dl:"

require conf/machine/include/imx6sabreauto-common.inc

KERNEL_DEVICETREE = "imx6dl-sabreauto.dtb imx6dl-sabreauto-gpmi-weim.dtb imx6dl-sabreauto-ecspi.dtb \
                     imx6dl-sabreauto-flexcan1.dtb imx6dl-sabreauto-enetirq.dtb imx6dl-sabreauto-pcie.dtb "

MACHINE_FEATURES_append = " optee"

UBOOT_CONFIG ??= "${@bb.utils.contains('MACHINE_FEATURES', 'optee', 'sd-optee', 'sd', d)}"
UBOOT_CONFIG[sd] = "mx6dlsabreauto_config,sdcard"
UBOOT_CONFIG[eimnor] = "mx6dlsabreauto_eimnor_config"
UBOOT_CONFIG[nand] = "mx6dlsabreauto_nand_config,ubifs"
UBOOT_CONFIG[spinor] = "mx6dlsabreauto_spinor_config"
UBOOT_CONFIG[mfgtool] = "mx6dlsabreauto_config"
UBOOT_CONFIG[sd-optee] = "mx6dlsabreauto_optee_config,sdcard"

OPTEE_BIN_EXT = "6dlauto"
```

## meta-bsp/conf/machine/imx6dlsabresd.conf
```bitbake
#@TYPE: Machine
#@NAME: NXP i.MX6DL SABRE Smart Device
#@SOC: i.MX6DL
#@DESCRIPTION: Machine configuration for NXP i.MX6DL SABRE Smart Device
#@MAINTAINER: Otavio Salvador <otavio@ossystems.com.br>

MACHINEOVERRIDES =. "mx6:mx6dl:"

require conf/machine/include/imx6sabresd-common.inc

KERNEL_DEVICETREE = " \
    nxp/imx/imx6dl-sabresd.dtb \
    nxp/imx/imx6dl-sabresd-btwifi.dtb \
    nxp/imx/imx6dl-sabresd-enetirq.dtb \
    nxp/imx/imx6dl-sabresd-hdcp.dtb \
    nxp/imx/imx6dl-sabresd-ldo.dtb \
    nxp/imx/imx6dl-sabresd-pcie.dtb \
    nxp/imx/imx6dl-sabresd-pcie-ep.dtb \
"

MACHINE_FEATURES:append = " optee"

UBOOT_CONFIG ??= "${@bb.utils.contains('MACHINE_FEATURES', 'optee', 'sd-optee', 'sd', d)}"
UBOOT_CONFIG[sd] = "mx6dlsabresd_config,sdcard"
UBOOT_CONFIG[epdc] = "mx6dlsabresd_epdc_config"
UBOOT_CONFIG[sd-optee] = "mx6dlsabresd_optee_config,sdcard"

OPTEE_BIN_EXT = "6dlsdb"

MACHINE_FIRMWARE += "firmware-imx-epdc"
```

## meta-bsp/conf/machine/imx6qpdlsolox.conf
```bitbake
#@TYPE: Machine
#@NAME: i.MX 6 Combined Machine
#@SOC: i.MX6 Quad, Dual, Solo, and SoloX
#@DESCRIPTION: A combined machine for i.MX 6 and 7 testing and mfg tools, see comment below
#@MAINTAINER: Jun Zhu <junzhu@nxp.com>

#        ** WARNING - THIS MACHINE IS FOR TEST OR MFG TOOLS ONLY **
# The resulting image will contain the 6Q SabreSD u-boot, kernel, and rootfs, plus the DTBs for all
# i.MX 6QP, 6DL, and 6SX boards. The image can be used on other boards by replacing the u-boot
# image, but please note that certain application functionality will not work depending on the
# capabilities of the board.

MACHINEOVERRIDES =. "mx6:mx6q:"

include conf/machine/include/imx6sabresd-common.inc

# Add in QP DL and SoloX device trees
KERNEL_DEVICETREE = " \
    nxp/imx/imx6q-sabresd.dtb \
    nxp/imx/imx6q-sabresd-btwifi.dtb \
    nxp/imx/imx6q-sabresd-enetirq.dtb \
    nxp/imx/imx6q-sabresd-hdcp.dtb \
    nxp/imx/imx6q-sabresd-ldo.dtb \
    nxp/imx/imx6q-sabresd-pcie.dtb \
    nxp/imx/imx6q-sabresd-pcie-ep.dtb \
    nxp/imx/imx6q-sabresd-uart.dtb \
    nxp/imx/imx6qp-sabresd.dtb \
    nxp/imx/imx6qp-sabresd-btwifi.dtb \
    nxp/imx/imx6qp-sabresd-hdcp.dtb \
    nxp/imx/imx6qp-sabresd-ldo.dtb \
    nxp/imx/imx6qp-sabresd-pcie-ep.dtb \
    nxp/imx/imx6dl-sabresd.dtb \
    nxp/imx/imx6dl-sabresd-btwifi.dtb \
    nxp/imx/imx6dl-sabresd-enetirq.dtb \
    nxp/imx/imx6dl-sabresd-hdcp.dtb \
    nxp/imx/imx6dl-sabresd-ldo.dtb \
    nxp/imx/imx6dl-sabresd-pcie.dtb \
    nxp/imx/imx6dl-sabresd-pcie-ep.dtb \
    nxp/imx/imx6sx-sdb.dtb \
    nxp/imx/imx6sx-sdb-btwifi.dtb \
    nxp/imx/imx6sx-sdb-emmc.dtb \
    nxp/imx/imx6sx-sdb-lcdif1.dtb \
    nxp/imx/imx6sx-sdb-ldo.dtb \
    nxp/imx/imx6sx-sdb-m4.dtb \
    nxp/imx/imx6sx-sdb-mqs.dtb \
    nxp/imx/imx6sx-sdb-pcie-ep.dtb \
    nxp/imx/imx6sx-sdb-reva.dtb \
    nxp/imx/imx6sx-sdb-reva-ldo.dtb \
    nxp/imx/imx6sx-sdb-sai.dtb \
"

MACHINE_FEATURES:append = " optee"

UBOOT_CONFIG ??= "${@bb.utils.contains('MACHINE_FEATURES', 'optee', 'sd-optee', 'sd', d)}"
UBOOT_CONFIG[sd] = "mx6qsabresd_config,sdcard"
UBOOT_CONFIG[sata] = "mx6qsabresd_sata_config"
UBOOT_CONFIG[sd-optee] = "mx6qsabresd_optee_config,sdcard"

# build all vpu firmware packages into the image
MACHINE_FIRMWARE:append:mx6-nxp-bsp = " firmware-imx-vpu-imx6q firmware-imx-vpu-imx6d firmware-imx-epdc"

OPTEE_BIN_EXT = "6qsdb"
```

## meta-bsp/conf/machine/imx6qpsabresd.conf
```bitbake
#@TYPE: Machine
#@NAME: NXP i.MX6Q Plus SABRE Smart Device
#@SOC: i.MX6QP
#@DESCRIPTION: Machine configuration for NXP i.MX6QP SABRE Smart Device
#@MAINTAINER: Lauren Post <lauren.post@nxp.com>

MACHINEOVERRIDES =. "mx6:mx6q:"

include conf/machine/include/imx6sabresd-common.inc

KERNEL_DEVICETREE = " \
    nxp/imx/imx6qp-sabresd.dtb \
    nxp/imx/imx6qp-sabresd-btwifi.dtb \
    nxp/imx/imx6qp-sabresd-hdcp.dtb \
    nxp/imx/imx6qp-sabresd-ldo.dtb \
    nxp/imx/imx6qp-sabresd-pcie-ep.dtb \
"

MACHINE_FEATURES:append = " optee"

UBOOT_CONFIG ??= "${@bb.utils.contains('MACHINE_FEATURES', 'optee', 'sd-optee', 'sd', d)}"
UBOOT_CONFIG[sd] = "mx6qpsabresd_config,sdcard"
UBOOT_CONFIG[sata] = "mx6qpsabresd_sata_config"
UBOOT_CONFIG[sd-optee] = "mx6qpsabresd_optee_config,sdcard"

OPTEE_BIN_EXT = "6qpsdb"
```
