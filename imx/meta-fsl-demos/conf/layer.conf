## imx/meta-sdk/conf/distro/include/fsl-imx-providers.inc
```bitbake
# Use i.MX Kernel, U-Boot and Gstreamer 1.0 providers
PREFERRED_PROVIDER_u-boot_mx5 = "u-boot-fslc"
PREFERRED_PROVIDER_u-boot_mx6 = "u-boot-imx"
PREFERRED_PROVIDER_u-boot_mx7 = "u-boot-imx"

PREFERRED_PROVIDER_virtual/kernel_mx6 = "linux-imx"
PREFERRED_PROVIDER_virtual/kernel_mx7 = "linux-imx"

MACHINE_GSTREAMER_1_0_PLUGIN_mx6 = "gst1.0-fsl-plugin"
MACHINE_GSTREAMER_1_0_PLUGIN_mx6q = "gst1.0-fsl-plugin"
MACHINE_GSTREAMER_1_0_PLUGIN_mx6dl = "gst1.0-fsl-plugin"
MACHINE_GSTREAMER_1_0_PLUGIN_mx6sl = "gst1.0-fsl-plugin"
MACHINE_GSTREAMER_1_0_PLUGIN_mx6sx = "gst1.0-fsl-plugin"
MACHINE_GSTREAMER_1_0_PLUGIN_mx7 = "gst1.0-fsl-plugin"

MACHINE_GSTREAMER_PLUGIN_mx6ul = ""
MACHINE_GSTREAMER_PLUGIN_mx6qp = ""
MACHINE_GSTREAMER_PLUGIN_mx7 = ""

# Default toolchains used in testing i.MX BSPs
DEFAULTTUNE_mx6   = "cortexa9hf-neon"
DEFAULTTUNE_mx6ul = "cortexa7hf-neon"
DEFAULTTUNE_mx7   = "cortexa7hf-neon"
```

## imx/meta-sdk/conf/layer.conf
```bitbake
# We have a conf and classes directory, add to BBPATH
BBPATH .= ":${LAYERDIR}"

# We have a packages directory, add to BBFILES
BBFILES += "${LAYERDIR}/recipes-*/*/*.bb \
            ${LAYERDIR}/recipes-*/*/*.bbappend"

BBFILE_COLLECTIONS += "fsl-sdk-release"
BBFILE_PATTERN_fsl-sdk-release := "^${LAYERDIR}"
BBFILE_PRIORITY_fsl-sdk-release = "8"
LAYERSERIES_COMPAT_fsl-sdk-release = "warrior"

# Add warrior to LAYERSERIERS_COMPAT for genivi layers until warrior branch
# is created in upstream
LAYERSERIES_COMPAT_ivi_append = " warrior"
LAYERSERIES_COMPAT_ivitest_append = " warrior"
LAYERSERIES_COMPAT_ivibsp_append = " warrior"

BBFILES_DYNAMIC += " \
    browser-layer:${LAYERDIR}/dynamic-layers/browser-layer/*/*/*.bb \
    browser-layer:${LAYERDIR}/dynamic-layers/browser-layer/*/*/*.bbappend \
    \
    openembedded-layer:${LAYERDIR}/dynamic-layers/openembedded-layer/*/*/*.bb \
    openembedded-layer:${LAYERDIR}/dynamic-layers/openembedded-layer/*/*/*.bbappend \
    \
    qt5-layer:${LAYERDIR}/dynamic-layers/qt5-layer/*/*/*.bb \
    qt5-layer:${LAYERDIR}/dynamic-layers/qt5-layer/*/*/*.bbappend \
    \
    ivi:${LAYERDIR}/dynamic-layers/ivi/*/*/*.bb \
    ivi:${LAYERDIR}/dynamic-layers/ivi/*/*/*.bbappend \
    \
    ivitest:${LAYERDIR}/dynamic-layers/ivitest/*/*/*.bb \
    ivitest:${LAYERDIR}/dynamic-layers/ivitest/*/*/*.bbappend \
"
BBMASK += "meta-freescale/dynamic-layers/qt5-layer/recipes-qt/qt5/qtbase_%.bbappend"
BBMASK += "meta-freescale-distro/recipes-fsl/packagegroups/packagegroup-fsl-tools-gpu-external.bb"
BBMASK += "meta-ivi/meta-ivi/recipes-graphics/wayland/weston_%.bbappend"
```
