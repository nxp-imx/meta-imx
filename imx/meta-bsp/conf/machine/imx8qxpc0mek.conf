## imx/meta-fsl-arm/conf/layer.conf
```bitbake
# We have a conf and classes directory, add to BBPATH
BBPATH .= ":${LAYERDIR}"

# We have a packages directory, add to BBFILES
BBFILES += "${LAYERDIR}/recipes-*/*/*.bb \
            ${LAYERDIR}/recipes-*/*/*.bbappend"

BBFILE_COLLECTIONS += "fsl-bsp-release"
BBFILE_PATTERN_fsl-bsp-release := "^${LAYERDIR}"
BBFILE_PRIORITY_fsl-bsp-release = "8"

# Preferred Providers
PREFERRED_PROVIDER_u-boot_mx6 = "u-boot-imx"
PREFERRED_PROVIDER_u-boot_mx5 = "u-boot-fslc"

PREFERRED_PROVIDER_virtual/libgal-x11_mx6 = "imx-gpu-viv"
PREFERRED_PROVIDER_virtual/kernel_mx6 = "linux-imx"

PREFERRED_PROVIDER_virtual/libgl_mx6q = "imx-gpu-viv"
PREFERRED_PROVIDER_virtual/libgl_mx6dl = "imx-gpu-viv"
PREFERRED_PROVIDER_virtual/libgl_mx6sx = "imx-gpu-viv"
PREFERRED_PROVIDER_virtual/libgl_mx6sl= "mesa"

PREFERRED_PROVIDER_virtual/libgles1_mx6q = "imx-gpu-viv"
PREFERRED_PROVIDER_virtual/libgles2_mx6q = "imx-gpu-viv"
PREFERRED_PROVIDER_virtual/libgles1_mx6dl = "imx-gpu-viv"
PREFERRED_PROVIDER_virtual/libgles2_mx6dl = "imx-gpu-viv"
PREFERRED_PROVIDER_virtual/libgles1_mx6sx = "imx-gpu-viv"
PREFERRED_PROVIDER_virtual/libgles2_mx6sx = "imx-gpu-viv"
PREFERRED_PROVIDER_virtual/libgles1_mx6sl = "mesa"
PREFERRED_PROVIDER_virtual/libgles2_mx6sl = "mesa"

PREFERRED_PROVIDER_virtual/egl_mx6q = "imx-gpu-viv"
PREFERRED_PROVIDER_virtual/egl_mx6dl = "imx-gpu-viv"
PREFERRED_PROVIDER_virtual/egl_mx6sx = "imx-gpu-viv"
PREFERRED_PROVIDER_virtual/egl_mx6sl = "imx-gpu-viv"

PREFERRED_PROVIDER_virtual/libopenvg_mx6q = "imx-gpu-viv"
PREFERRED_PROVIDER_virtual/libopenvg_mx6dl = "imx-gpu-viv"
PREFERRED_PROVIDER_virtual/libopenvg_mx6sx = "imx-gpu-viv"
PREFERRED_PROVIDER_virtual/libopenvg_mx6sl = "imx-gpu-viv"

PREFERRED_PROVIDER_virtual/libg2d_mx6 = "imx-gpu-viv"

# Preferred Versions
PREFERRED_VERSION_xserver-xorg_mx6 = "1.17"
PREFERRED_VERSION_linux-libc-headers = "3.14"

# set these because of meta-fsl-arm override
PREFERRED_VERSION_xserver-xorg_mx6q = "2:1.17.0"
PREFERRED_VERSION_xserver-xorg_mx6dl = "2:1.17.0"
PREFERRED_VERSION_xserver-xorg_mx6s = "2:1.17.0"
PREFERRED_VERSION_xserver-xorg_mx6sl = "2:1.17.0"
PREFERRED_VERSION_xserver-xorg_mx6sx = "2:1.17.0"

PREFERRED_VERSION_xtrans = "1.3.5"


FP_TAG = "${@base_contains("TUNE_FEATURES", "callconvention-hard", "-hfp", "-sfp", d)}"

PREFERRED_VERSION_imx-gpu-viv = "5.0.11.p6.1${FP_TAG}"
PREFERRED_VERSION_xf86-video-imxfb-vivante = "5.0.11.p6.1"

PREFERRED_VERSION_imx-gpu-viv-kernel = "5.0.11.p6.1"

# Use Wayland new version
BBMASK = "meta-fsl-arm/recipes-graphics/wayland/weston_%.bbappend"
PREFERRED_VERSION_wayland_mx6 = "1.7.0"
PREFERRED_VERSION_weston_mx6 = "1.7.0"
PREFERRED_VERSION_wayland-native = "1.7.0"
PREFERRED_VERSION_libinput_mx6 = "0.11.0"

PREFERRED_VERSION_imx-lib_mx6 = "3.14.28-1.0.0"
PREFERRED_VERSION_imx-test = "3.14.28-1.0.0"
PREFERRED_VERSION_imx-vpu_mx6 = "5.4.28"
PREFERRED_VERSION_linux-imx_mx6 = "3.14.28"
PREFERRED_VERSION_linux-mfgtool_mx6 = "3.14.28"
PREFERRED_VERSION_u-boot-imx_mx6 = "2014.04"
PREFERRED_VERSION_u-boot-imx-mfgtool_mx6 = "2014.04"
PREFERRED_VERSION_imx-uuc_mx6 = "0.5"

PREFERRED_VERSION_gst-fsl-plugin = "4.0.3"
PREFERRED_VERSION_libfslcodec = "4.0.4"
PREFERRED_VERSION_libfslparser = "4.0.4"
PREFERRED_VERSION_libfslvpuwrap = "1.0.58"

PREFERRED_VERSION_gst1.0-fsl-plugin = "4.0.4"

PREFERRED_VERSION_fsl-alsa-plugins = "1.0.25"
PREFERRED_VERSION_gst-plugins-gl = "0.10.3"

PREFERRED_VERSION_fslqtapplications = "1.0.1"

PREFERRED_VERSION_imx-kobs_mx6 = "3.14.28-1.0.0"
PREFERRED_VERSION_firmware-imx_mx6 = "3.14.28-1.0.0"
PREFERRED_VERSION_firmware-imx_mx5 = "3.0.35-4.0.0"

DEFAULTTUNE_mx6 ?= "cortexa9hf-neon"

PREFERRED_VERSION_imx-lib_mx5 = "11.09.02"
PREFERRED_VERSION_imx-vpu_mx5 = "11.09.02"
```

## imx/meta-fsl-arm/conf/machine/imx6dlsabreauto-eim-nor.conf
```bitbake
#@TYPE: Machine
#@NAME: Freescale i.MX6DL SABRE Automotive
#@SOC: i.MX6DL
#@DESCRIPTION: Machine configuration for Freescale i.MX6DL SABRE Automotive EIM-NOR boot

include conf/machine/include/imx-base.inc
include conf/machine/include/tune-cortexa9.inc
include conf/machine/include/fsl-mx6-common.inc

SOC_FAMILY = "mx6:mx6dl"

KERNEL_DEVICETREE = "${S}/arch/arm/boot/dts/imx6dl-sabreauto.dts"

UBOOT_MACHINE = "mx6dlsabreauto_eimnor_config"

SERIAL_CONSOLE = "115200 ttymxc3"

IMAGE_FSTYPES = "tar.bz2"
```

## imx/meta-fsl-arm/conf/machine/imx6qdlsolo.conf
```bitbake
#@TYPE: Machine
#@NAME: Freescale i.MX6 Common rootfs machine
#@SOC: i.MX6Q

#@DESCRIPTION: Machine configuration for Freescale i.MX6 boards

# this machine is a common machine type that will build all the device trees for all
# the mx6 boards into one rootfs.  This is used for testing only to consolidate images.
# Used for our test process to speed up daily builds

require conf/machine/include/imx6sabresd-common.inc

SOC_FAMILY = "mx6:mx6q"

KERNEL_DEVICETREE = "imx6q-sabresd.dtb imx6q-sabresd-ldo.dtb imx6q-sabresd-hdcp.dtb imx6q-sabresd-enetirq.dtb "
KERNEL_DEVICETREE += "imx6dl-sabreauto.dtb imx6dl-sabreauto-gpmi-weim.dtb imx6dl-sabreauto-ecspi.dtb "
KERNEL_DEVICETREE += "imx6dl-sabresd.dtb imx6dl-sabresd-ldo.dtb imx6dl-sabresd-hdcp.dtb"
KERNEL_DEVICETREE += "imx6dl-sabresd-pf200.dtb imx6dl-sabresd-enetirq.dtb"
KERNEL_DEVICETREE += "imx6q-sabreauto.dtb imx6q-sabreauto-gpmi-weim.dtb imx6q-sabreauto-ecspi.dtb "
KERNEL_DEVICETREE += "imx6q-sabreauto-flexcan1.dtb imx6dl-sabreauto-flexcan1.dtb "
KERNEL_DEVICETREE += "imx6sl-evk.dtb imx6sl-evk-csi.dtb imx6sl-evk-ldo.dtb"
KERNEL_DEVICETREE += "imx6sl-evk-pf200.dtb"
KERNEL_DEVICETREE += "imx6sx-sdb.dtb imx6sx-sdb-emmc.dtb imx6sx-sdb-m4.dtb"
KERNEL_DEVICETREE += "imx6sx-sdb-sai.dtb imx6sx-sdb-lcdif1.dtb imx6sx-sdb-canfd.dtb"
KERNEL_DEVICETREE += "imx6sx-17x17-arm2.dtb imx6sx-17x17-arm2-mlb.dtb imx6sx-17x17-arm2-sai.dtb"
KERNEL_DEVICETREE += "imx6sx-17x17-arm2-spdif.dtb imx6sx-17x17-arm2-ssi.dtb"
KERNEL_DEVICETREE += "imx6sx-19x19-arm2.dtb imx6sx-19x19-arm2-lcdif1.dtb imx6sx-19x19-arm2-sai.dtb"
KERNEL_DEVICETREE += "imx6sx-19x19-arm2-csi.dtb"

KERNEL_IMAGETYPE = "zImage"

UBOOT_MACHINE = "mx6qsabresd_config"

# build all vpu firmware packages into the image
MACHINE_FIRMWARE_append_mx6 = " firmware-imx-vpu-imx6q firmware-imx-vpu-imx6d"
```

## imx/meta-fsl-arm/conf/machine/imx6qpsabreauto.conf
```bitbake
#@TYPE: Machine
#@NAME: Freescale i.MX6Q Plus SABRE Automotive
#@SOC: i.MX6QP
#@DESCRIPTION: Machine configuration for Freescale i.MX6QP SABRE Automotive
#@MAINTAINER: Lauren Post <lauren.post@freescale.com>

require conf/machine/include/imx6sabreauto-common.inc

SOC_FAMILY = "mx6:mx6q"

KERNEL_DEVICETREE = "imx6qp-sabreauto.dtb "

UBOOT_CONFIG ??= "sd"
UBOOT_CONFIG[sd] = "mx6qpsabreauto_config,sdcard"
UBOOT_CONFIG[eimnor] = "mx6qpsabreauto_eimnor_config"
UBOOT_CONFIG[nand] = "mx6qpsabreauto_nand_config,ubifs"
UBOOT_CONFIG[spinor] = "mx6qpsabreauto_spinor_config"
UBOOT_CONFIG[sata] = "mx6qpsabreauto_sata_config"
UBOOT_CONFIG[mfgtool] = "mx6qpsabreauto_config"
```

## imx/meta-fsl-arm/conf/machine/imx6qsabreauto.conf
```bitbake
#@TYPE: Machine
#@NAME: Freescale i.MX6Q SABRE Automotive
#@SOC: i.MX6Q
#@DESCRIPTION: Machine configuration for Freescale i.MX6Q SABRE Automotive

require conf/machine/include/imx6sabreauto-common.inc

SOC_FAMILY = "mx6:mx6q"

KERNEL_DEVICETREE = "imx6q-sabreauto.dtb imx6q-sabreauto-gpmi-weim.dtb"

UBOOT_MACHINE = "mx6qsabreauto_config"
```

## imx/meta-fsl-arm/conf/machine/imx6slevk.conf
```bitbake
#@TYPE: Machine
#@NAME: Freescale i.MX6SL Evaluation Kit
#@SOC: i.MX6SL
#@DESCRIPTION: Machine configuration for Freescale i.MX6SL Evaluation Kit

require conf/machine/include/imx6sabresd-common.inc

SOC_FAMILY = "mx6:mx6sl"

KERNEL_DEVICETREE = "imx6sl-evk.dtb imx6sl-evk-ldo.dtb"

UBOOT_CONFIG ??= "sd"
UBOOT_CONFIG[sd] = "mx6slevk_config,sdcard"
```

## imx/meta-fsl-arm/conf/machine/imx6solosabreauto-spi-nor.conf
```bitbake
#@TYPE: Machine
#@NAME: Freescale i.MX6Solo SABRE Automotive
#@SOC: i.MX6S
#@DESCRIPTION: Machine configuration for Freescale i.MX6Solo SABRE Automotive SPI-NOR boot

include conf/machine/include/imx-base.inc
include conf/machine/include/tune-cortexa9.inc
include conf/machine/include/fsl-mx6-common.inc

SOC_FAMILY = "mx6:mx6s"

KERNEL_DEVICETREE = "${S}/arch/arm/boot/dts/imx6dl-sabreauto.dts"

UBOOT_MACHINE = " mx6solosabreauto_spinor_config"

SERIAL_CONSOLE = "115200 ttymxc3"

IMAGE_FSTYPES = ""
```

## imx/meta-fsl-arm/conf/machine/imx6sx.conf
```bitbake
#@TYPE: Machine
#@NAME: Freescale i.MX6SX
#@SOC: i.MX6SL
#@DESCRIPTION: Machine configuration for Freescale i.MX6SX

include conf/machine/include/imx-base.inc
include conf/machine/include/tune-cortexa9.inc

SOC_FAMILY = "mx6:mx6sl:mx6sx"

KERNEL_DEVICETREE = "imx6sx-17x17-arm2.dtb"

UBOOT_ENTRYPOINT = "0x80008000"

SERIAL_CONSOLE = "115200 ttymxc0"

MACHINE_FEATURES += " pci wifi bluetooth"

MACHINE_FIRMWARE += " linux-firmware-ath6k"

UBOOT_CONFIG ??= "sd"
UBOOT_CONFIG[sd] = "mx6sxsabresd_config,sdcard"
UBOOT_CONFIG[17x17_arm2_sd] = "mx6sx_17x17_arm2_config,sdcard"
UBOOT_CONFIG[19x19_ddr3_arm2_sd] = "mx6sx_19x19_ddr3_arm2_config,sdcard"
UBOOT_CONFIG[qspi2] = "mx6sxsabresd_qspi2_config"
UBOOT_CONFIG[17x17_arm2_qspi2] = "mx6sx_17x17_arm2_qspi2_config"
UBOOT_CONFIG[19x19_ddr3_arm2_qspi2] = "mx6sx_19x19_ddr3_arm2_qspi2_config"
```

## imx/meta-fsl-arm/conf/machine/imx6sx14x14arm2.conf
```bitbake
#@TYPE: Machine
#@NAME: Freescale i.MX6SX 14x14 lpddr2 arm2 board
#@SOC: i.MX6SX
#@DESCRIPTION: Machine configuration for Freescale i.MX6SX 14x14 lpddr2 arm2 board

include conf/machine/include/imx-base.inc
include conf/machine/include/tune-cortexa9.inc

SOC_FAMILY = "mx6:mx6sx"

KERNEL_DEVICETREE = "imx6sx-14x14-arm2.dtb"

UBOOT_ENTRYPOINT = "0x80008000"

SERIAL_CONSOLE = "115200 ttymxc0"

MACHINE_FEATURES += " pci wifi bluetooth"

MACHINE_FIRMWARE += " linux-firmware-ath6k"

UBOOT_CONFIG ??= "sd"
UBOOT_CONFIG[sd] = "mx6sx_14x14_lpddr2_arm2_config,sdcard"
UBOOT_CONFIG[nand] = "mx6sx_14x14_lpddr2_arm2_nand_config,ubifs"
```

## imx/meta-fsl-arm/conf/machine/imx6sx19x19lpddr2arm2.conf
```bitbake
#@TYPE: Machine
#@NAME: Freescale i.MX6SX 19x19 LPDDR2 ARM2 board
#@SOC: i.MX6SX
#@DESCRIPTION: Machine configuration for Freescale i.MX6SX LPDDR2 ARM2 Board

include conf/machine/include/imx-base.inc
include conf/machine/include/tune-cortexa9.inc

SOC_FAMILY = "mx6:mx6sx"

KERNEL_DEVICETREE = "imx6sx-19x19-arm2.dtb imx6sx-19x19-arm2-lcdif1.dtb imx6sx-19x19-arm2-sai.dtb"
KERNEL_DEVICETREE += "imx6sx-19x19-arm2-csi.dtb imx6sx-19x19-arm2-gpmi-weim.dtb imx6sx-19x19-arm2-mqs.dtb"

KERNEL_IMAGETYPE = "zImage"

UBOOT_ENTRYPOINT = "0x80008000"

SERIAL_CONSOLE = "115200 ttymxc0"

MACHINE_FEATURES += " pci wifi bluetooth"

MACHINE_FIRMWARE += " linux-firmware-ath6k"

UBOOT_CONFIG ??= "sd"
UBOOT_CONFIG[sd] = "mx6sx_19x19_lpddr2_arm2_config,sdcard"
UBOOT_CONFIG[qspi2] = "mx6sx_19x19_lpddr2_arm2_qspi2_config"
```

## imx/meta-fsl-arm/conf/machine/imx6sxsabresd.conf
```bitbake
#@TYPE: Machine
#@NAME: Freescale i.MX6SX SabreSD 
#@SOC: i.MX6SX
#@DESCRIPTION: Machine configuration for Freescale i.MX6SX Sabre SD

include conf/machine/include/imx-base.inc
include conf/machine/include/tune-cortexa9.inc

SOC_FAMILY = "mx6:mx6sx"

KERNEL_DEVICETREE = "imx6sx-sdb.dtb"

UBOOT_ENTRYPOINT = "0x80008000"

SERIAL_CONSOLE = "115200 ttymxc0"

MACHINE_FEATURES += " pci wifi bluetooth"

MACHINE_FIRMWARE += " linux-firmware-ath6k"

UBOOT_CONFIG ??= "sd"
UBOOT_CONFIG[sd] = "mx6sxsabresd_config,sdcard"
UBOOT_CONFIG[qspi2] = "mx6sxsabresd_qspi2_config"
```

## imx/meta-fsl-arm/conf/machine/imx7d19x19lpddr3arm2.conf
```bitbake
#@TYPE: Machine
#@NAME: Freescale i.MX7D 19x19 LPDDR3 ARM2 Evaluation Kit
#@SOC: i.MX7D
#@DESCRIPTION: Machine configuration for Freescale i.MX7D 19x19 LPDDR3 ARM2 Evaluation Kit
#@MAINTAINER: Lauren Post <Lauren.Post@freescale.com>

require conf/machine/include/imx7dsabresd-common.inc

SOC_FAMILY = "mx7:mx7d"

KERNEL_DEVICETREE = "imx7d-12x12-lpddr3-arm2.dtb imx7d-12x12-lpddr3-arm2-enet.dtb imx7d-12x12-lpddr3-arm2-flexcan.dtb \
                     imx7d-12x12-lpddr3-arm2-m4.dtb imx7d-12x12-lpddr3-arm2-mqs.dtb imx7d-12x12-lpddr3-arm2-qspi.dtb \
                     imx7d-12x12-lpddr3-arm2-sai.dtb"

UBOOT_CONFIG ??= "sd"
UBOOT_CONFIG[sd] = "mx7d_19x19_lpddr3_arm2_config,sdcard"
UBOOT_CONFIG[eimnor] = "mx7d_19x19_lpddr3_arm2_config"
UBOOT_CONFIG[mfgtool] = "mx7d_19x19_lpddr3_arm2_config"
```

## imx/meta-fsl-arm/conf/machine/imx7d_12x12_ddr3_arm2.conf
```bitbake
#@TYPE: Machine
#@NAME: Freescale i.MX7D 12x12 DDR3 ARM2 Evaluation Kit
#@SOC: i.MX7D
#@DESCRIPTION: Machine configuration for Freescale i.MX7D 12x12 LPDDR3 ARM2 Evaluation Kit
#@MAINTAINER: Lauren Post <Lauren.Post@freescale.com>

require conf/machine/include/imx6sabresd-common.inc

SOC_FAMILY = "mx7:mx7d"

KERNEL_DEVICETREE = "imx7d-12x12-arm2.dtb imx7d-12x12-arm2-enet.dtb imx7d-12x12-arm2-flexcan.dtb \
                     imx7d-12x12-arm2-sai.dtb"

UBOOT_CONFIG ??= "sd"
UBOOT_CONFIG[sd] = "mx7d_12x12_lpddr3_arm2_config,sdcard"
UBOOT_CONFIG[qspi] = "mx7d_12x12_lpddr3_arm2_qspi_config"
UBOOT_CONFIG[spinor] = "mx7d_12x12_lpddr3_arm2_spinor_config"
UBOOT_CONFIG[mfgtool] = "mx7d_12x12_lpddr3_arm2_config"
```

## imx/meta-fsl-arm/conf/machine/imx7dsabresd.conf
```bitbake
#@TYPE: Machine
#@NAME: Freescale i.MX7D SABRE Smart Device
#@SOC: i.MX7D
#@DESCRIPTION: Machine configuration for Freescale i.MX7D SABRE Smart Device
#@MAINTAINER: Lauren Post <Lauren.Post@freescale.com>

require conf/machine/include/imx6sabresd-common.inc

SOC_FAMILY = "mx7:mx7d"

KERNEL_DEVICETREE = "imx7d-sdb.dtb imx7d-sdb-enet.dtb"

UBOOT_CONFIG ??= "sd"
UBOOT_CONFIG[sd] = "mx7dsabresd_config,sdcard"
UBOOT_CONFIG[mfgtool] = "mx7dsabresd_config_config"
```

## imx/meta-fsl-arm/conf/machine/include/fsl-mx6-common.inc
```bitbake
# Provides the i.MX mx6 Freescale board common settings

# set to hardware floating point
DEFAULTTUNE_mx6 ?= "cortexa9hf-neon"

## Note the imx-base appends vpu firmware so not including it here
## Note sdma firmware from firmware-imx is not needed on mx6
MACHINE_FIRMWARE = " linux-firmware-ath6k"

MACHINE_FEATURES += " pci wifi bluetooth"
```

## imx/meta-fsl-arm/conf/machine/include/imx7dsabresd-common.inc
```bitbake
# Provides the i.MX7D SABRE SD common settings

require conf/machine/include/imx-base.inc
require conf/machine/include/tune-cortexa7.inc

DEFAULTTUNE_mx7 ?= "cortexa7hf-neon"

UBOOT_ENTRYPOINT_mx7 = "0x80008000"

SDCARD_GENERATION_COMMAND_mx7 = "generate_imx_sdcard"

SERIAL_CONSOLE = "115200 ttymxc0"

#MACHINE_FIRMWARE_append_mx6 = " linux-firmware-ath6k"

MACHINE_FEATURES += " pci wifi bluetooth"
```

## imx/meta-fsl-bluez/conf/layer.conf
```bitbake
# We have a conf and classes directory, add to BBPATH
BBPATH .= ":${LAYERDIR}"

# We have a packages directory, add to BBFILES
BBFILES += "${LAYERDIR}/recipes-*/*/*.bb \
            ${LAYERDIR}/recipes-*/*/*.bbappend"

BBFILE_COLLECTIONS += "fsl-bsp-release"
BBFILE_PATTERN_fsl-bsp-release := "^${LAYERDIR}"
BBFILE_PRIORITY_fsl-bsp-release = "8"

PREFERRED_PROVIDER_bluez4_mx6 = ""

# Default bluez install to bluez5.
PREFERRED_PROVIDER_virtual/bluez_mx6 ?= "bluez5"
VIRTUAL-RUNTIME_virtual/bluez_mx6 ?= "bluez5"
PREFERRED_PROVIDER_bluez-hcidump_mx6 ?= "bluez5"
# the following bluez5 tools include obex tools
IMAGE_INSTALL_append = " packagegroup-fsl-bluez5-tools"

# To build with bluez4, copy and uncomment the following two lines and put into local.conf
#PREFERRED_PROVIDER_virtual/bluez_mx6 = "bluez4"
#VIRTUAL-RUNTIME_virtual/bluez_mx6 = "bluez4"
#PREFERRED_PROVIDER_bluez-hcidump_mx6 = "bluez-hcidump"
# comment out the IMAGE_INSTALL above
```
