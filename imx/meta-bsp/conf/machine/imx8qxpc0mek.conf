## imx/meta-bsp/conf/machine/imx8qxpc0mek.conf
```bitbake
#@TYPE: Machine
#@NAME: i.MX 8QXP MEK
#@DESCRIPTION: i.MX 8QXP C0 Multisensory Enablement Kit (MEK) board

require conf/machine/imx8qxpmek.conf
```

## imx/meta-bsp/conf/machine/imx8qxplpddr4arm2.conf
```bitbake
#@TYPE: Machine
#@NAME: i.MX 8QXP LPDDR4 ARM2
#@DESCRIPTION: i.MX 8QXP LPDDR4 ARM2 Development board

MACHINEOVERRIDES =. "mx8:mx8x:mx8qxp:"

require conf/machine/include/imx-base.inc
require conf/machine/include/arm/arch-arm64.inc

# Don't include kernels in standard images
RDEPENDS_${KERNEL_PACKAGE_NAME}-base = ""
RDEPENDS_${KERNEL_PACKAGE_NAME}-image = ""

LOADADDR = ""

# Disable the serial console due to auto-serial-console
SERIAL_CONSOLES = "115200;ttyAMA0"

# we do not want to have getty running on tty1 as we run
# auto-serial-console there
USE_VT = "0"

KERNEL_DEVICETREE = "freescale/fsl-imx8qxp-lpddr4-arm2.dtb freescale/fsl-imx8qxp-lpddr4-arm2-enet2.dtb"
KERNEL_DEVICETREE += "freescale/fsl-imx8qxp-lpddr4-arm2-dsi-rm67191.dtb freescale/fsl-imx8qxp-lpddr4-arm2-enet2-tja1100.dtb "
KERNEL_DEVICETREE += "freescale/fsl-imx8qxp-lpddr4-arm2-dsp.dtb"
KERNEL_DEVICETREE += "freescale/fsl-imx8qxp-lpddr4-arm2-gpmi-nand.dtb"
KERNEL_DEVICETREE += "freescale/fsl-imx8qxp-lpddr4-arm2-lpspi.dtb freescale/fsl-imx8qxp-lpddr4-arm2-lpspi-slave.dtb"
KERNEL_DEVICETREE += "freescale/fsl-imx8qxp-lpddr4-arm2-mlb.dtb freescale/fsl-imx8qxp-lpddr4-arm2-mqs.dtb"
KERNEL_DEVICETREE += "freescale/fsl-imx8qxp-lpddr4-arm2-spdif.dtb freescale/fsl-imx8qxp-lpddr4-arm2-wm8962.dtb"
KERNEL_DEVICETREE += "freescale/fsl-imx8qxp-lpddr4-arm2-a0.dtb"

UBOOT_MAKE_TARGET = "u-boot.bin"
UBOOT_CONFIG ??= "sd"
UBOOT_CONFIG[sd] = "imx8qxp_lpddr4_arm2_config,sdcard"
UBOOT_CONFIG[fspi] = "imx8qxp_lpddr4_arm2_fspi_config"
UBOOT_CONFIG[nand] = "imx8qxp_lpddr4_arm2_nand_config,ubifs"

IMAGE_BOOTLOADER = "imx-boot"
IMX_BOOT_SEEK = "32"

IMXBOOT_TARGETS = "${@bb.utils.contains('UBOOT_CONFIG', 'fspi', 'flash_flexspi', \
                      bb.utils.contains('UBOOT_CONFIG', 'nand', 'flash_nand flash_nand_fw', \
                                                                'flash_regression_linux_m4 flash', d), d)}"

BOARD_TYPE = "val"
```

## imx/meta-bsp/conf/machine/imx8qxpmek.conf
```bitbake
#@TYPE: Machine
#@NAME: i.MX 8QXP MEK
#@DESCRIPTION: i.MX 8QXP Multisensory Enablement Kit (MEK) board

MACHINEOVERRIDES =. "mx8:mx8x:mx8qxp:"

require conf/machine/include/imx-base.inc
require conf/machine/include/arm/arch-arm64.inc

MACHINE_FEATURES_append = " optee bcm43455 bcm4356 bcm4359"

# Don't include kernels in standard images
RDEPENDS_${KERNEL_PACKAGE_NAME}-base = ""
RDEPENDS_${KERNEL_PACKAGE_NAME}-image = ""

LOADADDR = ""

# Disable the serial console due to auto-serial-console
SERIAL_CONSOLES = "115200;ttyAMA0"

# we do not want to have getty running on tty1 as we run
# auto-serial-console there
USE_VT = "0"

KERNEL_DEVICETREE = "freescale/fsl-imx8qxp-mek.dtb freescale/fsl-imx8qxp-mek-dom0.dtb"
KERNEL_DEVICETREE += "freescale/fsl-imx8qxp-mek-dsi-rm67191.dtb freescale/fsl-imx8qxp-mek-dsp.dtb"
KERNEL_DEVICETREE += "freescale/fsl-imx8qxp-mek-enet2.dtb freescale/fsl-imx8qxp-mek-enet2-tja1100.dtb"
KERNEL_DEVICETREE += "freescale/fsl-imx8qxp-mek-it6263-lvds0-dual-channel.dtb freescale/fsl-imx8qxp-mek-it6263-lvds1-dual-channel.dtb"
KERNEL_DEVICETREE += "freescale/fsl-imx8qxp-mek-inmate.dtb"
KERNEL_DEVICETREE += "freescale/fsl-imx8qxp-mek-lcdif.dtb"
KERNEL_DEVICETREE += "freescale/fsl-imx8qxp-mek-jdi-wuxga-lvds1-panel.dtb freescale/fsl-imx8qxp-mek-jdi-wuxga-lvds0-panel.dtb"
KERNEL_DEVICETREE += "freescale/fsl-imx8qxp-mek-ov5640.dtb"
KERNEL_DEVICETREE += "freescale/fsl-imx8qxp-mek-rpmsg.dtb freescale/fsl-imx8qxp-mek-root.dtb"

UBOOT_MAKE_TARGET = \
    "${@bb.utils.contains('COMBINED_FEATURES', 'optee', '', \
                                                        'u-boot.bin', d)}"
SPL_BINARY = \
    "${@bb.utils.contains('COMBINED_FEATURES', 'optee', 'spl/u-boot-spl.bin', \
                                                        '', d)}"
UBOOT_CONFIG ??= "sd"
UBOOT_CONFIG[sd]   = "imx8qxp_mek_defconfig,sdcard"
UBOOT_CONFIG[fspi] = "imx8qxp_mek_fspi_defconfig"

IMAGE_BOOTLOADER = "imx-boot"
IMX_BOOT_SEEK = "32"

IMXBOOT_TARGETS_SD = \
    "${@bb.utils.contains('COMBINED_FEATURES', 'optee', 'flash_linux_m4 flash_spl', \
                                                        'flash flash_regression_linux_m4', d)}"
IMXBOOT_TARGETS_FSPI = \
    "${@bb.utils.contains('COMBINED_FEATURES', 'optee', 'flash_spl_flexspi', \
                                                        'flash_flexspi', d)}"
IMXBOOT_TARGETS = \
    "${@bb.utils.contains('UBOOT_CONFIG',         'sd', '${IMXBOOT_TARGETS_SD}', \
                                                        '${IMXBOOT_TARGETS_FSPI}', d)}"

BOARD_TYPE = "mek"
```

## imx/meta-bsp/conf/machine/imx_mfgtools_nogpu.conf
```bitbake
#@TYPE: Machine
#@NAME: Freescale i.MX Common rootfs machine for mfg tools without gpu
#@SOC: i.MX6UL and i.MX7D 

#@DESCRIPTION: Machine configuration for Freescale i.MX 6 and 7  boards without a gpu

# this machine is a common machine type that will build all the device trees for all
# the mx6 boards into one rootfs.  This is used for testing only to consolidate images.
# Used for our test process to speed up daily builds

include conf/machine/include/imx-base.inc
require conf/machine/include/imx7dsabresd-common.inc
require conf/machine/include/imx6ul-common.inc

SOC_FAMILY = "mx7:mx7d"

# Add in mx7 device trees
KERNEL_DEVICETREE = "imx7d-sdb.dtb imx7d-sdb-enet.dtb imx7d-sdb-epdc.dtb \
                     imx7d-sdb-gpmi-weim.dtb imx7d-sdb-hdmi-audio.dtb imx7d-sdb-m4.dtb \
                     imx7d-sdb-qspi.dtb imx7d-sdb-touch.dtb imx7d-sdb-wm8960.dtb"
KERNEL_DEVICETREE += "imx7d-12x12-lpddr3-arm2.dtb imx7d-12x12-lpddr3-arm2-enet.dtb imx7d-12x12-lpddr3-arm2-flexcan.dtb \
                     imx7d-12x12-lpddr3-arm2-m4.dtb imx7d-12x12-lpddr3-arm2-mqs.dtb imx7d-12x12-lpddr3-arm2-pcie.dtb \
                     imx7d-12x12-lpddr3-arm2-qspi.dtb imx7d-12x12-lpddr3-arm2-sai.dtb imx7d-12x12-lpddr3-arm2-sim.dtb"
KERNEL_DEVICETREE += "imx7d-19x19-ddr3-arm2.dtb imx7d-19x19-ddr3-arm2-csi.dtb imx7d-19x19-ddr3-arm2-sai.dtb "


#Add in mx6ul device trees
KERNEL_DEVICETREE += "imx6ul-evk.dtb"
KERNEL_DEVICETREE += "imx6ul-ddr3-arm2.dtb imx6ul-ddr3-arm2-flexcan2.dtb imx6ul-ddr3-arm2-lcdif.dtb \
                      imx6ul-ddr3-arm2-mqs.dtb imx6ul-ddr3-arm2-spdif.dtb imx6ul-ddr3-arm2-wm8958.dtb"

UBOOT_MACHINE = "mx7dsabresd_config"

BOOT_SPACE = "32768"
```
