## imx/meta-bsp/conf/machine/imx8dxlphantommek.conf
```bitbake
#@TYPE: Machine
#@NAME: i.MX 8DXL Phantom MEK
#@DESCRIPTION: i.MX 8DXL Phantom Multisensory Enablement Kit (MEK) board

MACHINEOVERRIDES =. "mx8:mx8x:mx8dxl-phantom:"

require conf/machine/include/imx-base.inc
require conf/machine/include/arm/arch-arm64.inc

MACHINE_FEATURES_append = " bcm43455 bcm4356 bcm4359"

# Don't include kernels in standard images
RDEPENDS_${KERNEL_PACKAGE_NAME}-base = ""
RDEPENDS_${KERNEL_PACKAGE_NAME}-image = ""

LOADADDR = ""

# Disable the serial console due to auto-serial-console
SERIAL_CONSOLES = "115200;ttyAMA0"

# we do not want to have getty running on tty1 as we run
# auto-serial-console there
USE_VT = "0"

KERNEL_DEVICETREE = "freescale/fsl-imx8dxl-phantom-mek.dtb "

UBOOT_MAKE_TARGET = \
    "${@bb.utils.contains('COMBINED_FEATURES', 'optee', '', \
                                                        'u-boot.bin', d)}"
SPL_BINARY = \
    "${@bb.utils.contains('COMBINED_FEATURES', 'optee', 'spl/u-boot-spl.bin', \
                                                        '', d)}"
UBOOT_CONFIG ??= "sd"
UBOOT_CONFIG[sd]   = "imx8dxl_phantom_mek_defconfig,sdcard"
UBOOT_CONFIG[fspi] = "imx8dxl_phantom_mek_fspi_defconfig"

IMAGE_BOOTLOADER = "imx-boot"
IMX_BOOT_SEEK = "32"

IMXBOOT_TARGETS_SD = \
    "${@bb.utils.contains('COMBINED_FEATURES', 'optee', 'flash_spl', \
                                                        'flash', d)}"
IMXBOOT_TARGETS_FSPI = \
    "${@bb.utils.contains('COMBINED_FEATURES', 'optee', 'flash_spl_flexspi', \
                                                        'flash_flexspi', d)}"
IMXBOOT_TARGETS = \
    "${@bb.utils.contains('UBOOT_CONFIG',         'sd', '${IMXBOOT_TARGETS_SD}', \
                                                        '${IMXBOOT_TARGETS_FSPI}', d)}"

BOARD_TYPE = "mek"
```

## imx/meta-bsp/conf/machine/imx8mmddr4evk.conf
```bitbake
#@TYPE: Machine
#@NAME: NXP i.MX8MM DDR4 Evaluation Kit
#@SOC: i.MX8MM
#@DESCRIPTION: Machine configuration for NXP i.MX8MMini DDR4 EVK
#@MAINTAINER: Jun Zhu <junzhu@nxp.com>

MACHINEOVERRIDES =. "mx8:mx8m:mx8mm:"

require conf/machine/include/imx-base.inc
require conf/machine/include/arm/arch-arm64.inc

MACHINE_FEATURES += " pci wifi bluetooth optee qca9377 qca6174 bcm43455 bcm4356 bcm4359"

KERNEL_DEVICETREE = "freescale/fsl-imx8mm-ddr4-evk.dtb freescale/fsl-imx8mm-ddr4-evk-rm67191.dtb"
KERNEL_DEVICETREE += "freescale/fsl-imx8mm-ddr4-qca9377-evk.dtb "

WKS_FILE_DEPENDS += "imx-m4-demos"
IMAGE_BOOT_FILES += "imx8mm_m4_TCM_hello_world.bin \
                    imx8mm_m4_TCM_rpmsg_lite_pingpong_rtos_linux_remote.bin \
                    imx8mm_m4_TCM_rpmsg_lite_str_echo_rtos.bin \
                    imx8mm_m4_TCM_sai_low_power_audio.bin \
"

UBOOT_CONFIG ??= "sd"
UBOOT_CONFIG[sd] = "imx8mm_ddr4_evk_config,sdcard"
UBOOT_CONFIG[nand] = "imx8mm_ddr4_evk_nand_defconfig,ubifs"

SPL_BINARY = "spl/u-boot-spl.bin"

# Set DDR FIRMWARE
DDR_FIRMWARE_NAME = "ddr4_imem_1d.bin ddr4_dmem_1d.bin ddr4_imem_2d.bin ddr4_dmem_2d.bin"

# Set u-boot DTB
UBOOT_DTB_NAME = "fsl-imx8mm-ddr4-evk.dtb"

# Set imx-mkimage boot target
IMXBOOT_TARGETS = "flash_ddr4_evk"

SERIAL_CONSOLES = "115200;ttymxc1"

IMAGE_BOOTLOADER = "imx-boot"

LOADADDR = ""
UBOOT_MAKE_TARGET = ""
IMX_BOOT_SEEK = "33"
```

## imx/meta-bsp/conf/machine/imx8mmddr4val.conf
```bitbake
#@TYPE: Machine
#@NAME: NXP i.MX8MM DDR4 Validation Board
#@SOC: i.MX8MM
#@DESCRIPTION: Machine configuration for NXP i.MX8MMini DDR4 validation board
#@MAINTAINER: Carol Zhu <carol.zhu@nxp.com>

MACHINEOVERRIDES =. "mx8:mx8m:mx8mm:"

require conf/machine/include/imx-base.inc
require conf/machine/include/arm/arch-arm64.inc

MACHINE_FEATURES += " pci wifi bluetooth qca9377 qca6174"

MACHINE_SOCARCH_FILTER_append_mx8mm = "virtual/libopenvg virtual/libgles1 virtual/libgles2 virtual/egl virtual/mesa virtual/libgl virtual/libg2d"

KERNEL_DEVICETREE = "freescale/fsl-imx8mm-ddr4-val.dtb"

IMAGE_BOOTFILES_DEPENDS += "imx-m4-demos:do_deploy"
IMAGE_BOOTFILES += "imx8mm_m4_TCM_hello_world.bin imx8mm_m4_TCM_rpmsg_lite_pingpong_rtos_linux_remote.bin imx8mm_m4_TCM_rpmsg_lite_str_echo_rtos.bin"

UBOOT_CONFIG ??= "sd"
UBOOT_CONFIG[sd] = "imx8mm_ddr4_val_config,sdcard"
UBOOT_CONFIG[mfgtool] = "imx8mm_ddr4_val_config"
SPL_BINARY = "spl/u-boot-spl.bin"

# Set DDR FIRMWARE
DDR_FIRMWARE_NAME = "ddr4_imem_1d.bin ddr4_dmem_1d.bin ddr4_imem_2d.bin ddr4_dmem_2d.bin"

# Set u-boot DTB
UBOOT_DTB_NAME = "fsl-imx8mm-ddr4-val.dtb"

# Set imx-mkimage boot target
IMXBOOT_TARGETS = "flash_ddr4_val"

# Set Serial console
SERIAL_CONSOLE = "115200 ttymxc1"

IMAGE_BOOTLOADER = "imx-boot"

BOOT_SPACE = "65536"

LOADADDR = ""
UBOOT_SUFFIX = "bin"
UBOOT_MAKE_TARGET = ""
IMX_BOOT_SEEK = "33"

OPTEE_BIN_EXT = "8mm"
```

## imx/meta-bsp/conf/machine/imx8mmevk.conf
```bitbake
#@TYPE: Machine
#@NAME: NXP i.MX8MM Evaluation Kit
#@SOC: i.MX8MM
#@DESCRIPTION: Machine configuration for NXP i.MX8MMini EVK
#@MAINTAINER: Jun Zhu <junzhu@nxp.com>

MACHINEOVERRIDES =. "mx8:mx8m:mx8mm:"

require conf/machine/include/imx-base.inc
require conf/machine/include/arm/arch-arm64.inc

MACHINE_FEATURES += " pci wifi bluetooth qca9377 qca6174"

MACHINE_SOCARCH_FILTER_append_mx8mm = "virtual/libopenvg virtual/libgles1 virtual/libgles2 virtual/egl virtual/mesa virtual/libgl virtual/libg2d"

KERNEL_DEVICETREE = "freescale/fsl-imx8mm-evk.dtb freescale/fsl-imx8mm-evk-ak4497.dtb "

IMAGE_BOOTFILES_DEPENDS += "imx-m4-demos:do_deploy"
IMAGE_BOOTFILES += ""

UBOOT_CONFIG ??= "sd"
UBOOT_CONFIG[sd] = "imx8mm_evk_config,sdcard"
UBOOT_CONFIG[fspi] = "imx8mm_evk_fspi_defconfig"
UBOOT_CONFIG[mfgtool] = "imx8mm_evk_config"
SPL_BINARY = "spl/u-boot-spl.bin"

# Set DDR FIRMWARE
DDR_FIRMWARE_NAME = "lpddr4_pmu_train_1d_imem.bin lpddr4_pmu_train_1d_dmem.bin lpddr4_pmu_train_2d_imem.bin lpddr4_pmu_train_2d_dmem.bin"

# Set u-boot DTB
UBOOT_DTB_NAME = "fsl-imx8mm-evk.dtb"

# Set imx-mkimage boot target
IMXBOOT_TARGETS = "flash_evk"

# Set Serial console
SERIAL_CONSOLE = "115200 ttymxc0"

IMAGE_BOOTLOADER = "imx-boot"

BOOT_SPACE = "65536"

LOADADDR = ""
UBOOT_SUFFIX = "bin"
UBOOT_MAKE_TARGET = ""
IMX_BOOT_SEEK = "33"

OPTEE_BIN_EXT = "8mm"
```

## imx/meta-bsp/conf/machine/imx8mnevk.conf
```bitbake
#@TYPE: Machine
#@NAME: NXP i.MX8MN Evaluation Kit
#@SOC: i.MX8MN
#@DESCRIPTION: Machine configuration for NXP i.MX8MN EVK
#@MAINTAINER: Jun Zhu <junzhu@nxp.com>

require conf/machine/imx8mnddr4evk.conf

# KERNEL_DEVICETREE of i.MX 8MN LPDDR4
KERNEL_DEVICETREE += "freescale/fsl-imx8mn-evk.dtb"
```

## imx/meta-bsp/conf/machine/imx8mpevk.conf
```bitbake
#@TYPE: Machine
#@NAME: NXP i.MX8MP Evaluation Kit and i.MX8MP Evaluation Kit
#@SOC: i.MX8MP
#@DESCRIPTION: Machine configuration for NXP i.MX8MP EVK
#@MAINTAINER: Alexandru Palalau <ioan-alexandru.palalau@nxp.com>

MACHINEOVERRIDES =. "mx8:mx8m:mx8mp:"

require conf/machine/include/imx-base.inc
require conf/machine/include/tune-cortexa53.inc

#Remove optee as it's not ready
MACHINE_FEATURES += " pci wifi bluetooth qca9377"

KERNEL_DEVICETREE = " \
                     freescale/imx8mp-evk.dtb"

UBOOT_CONFIG ??= "sd"
UBOOT_CONFIG[sd] = "imx8mp_evk_defconfig,sdcard"
UBOOT_CONFIG[mfgtool] = "imx8mp_evk_defconfig"
SPL_BINARY = "spl/u-boot-spl.bin"

# Set DDR FIRMWARE
DDR_FIRMWARE_NAME = "lpddr4_pmu_train_1d_dmem_201904.bin lpddr4_pmu_train_1d_imem_201904.bin lpddr4_pmu_train_2d_dmem_201904.bin lpddr4_pmu_train_2d_imem_201904.bin"

# Set u-boot DTB
UBOOT_DTB_NAME = "fsl-imx8mp-evk.dtb"

# Set imx-mkimage boot target
IMXBOOT_TARGETS = "flash_evk flash_evk_no_hdmi"

# Set Serial console
SERIAL_CONSOLES = "115200;ttymxc0"

IMAGE_BOOTLOADER = "imx-boot"

LOADADDR = ""
UBOOT_SUFFIX = "bin"
UBOOT_MAKE_TARGET = ""
IMX_BOOT_SEEK = "32"

OPTEE_BIN_EXT = "8mp"

# Add additional firmware
MACHINE_FIRMWARE_append = " linux-firmware-ath10k"

IMX_KERNEL_VERSION = "5.4.8mp"

PREFERRED_VERSION_linux-imx = "5.4.8mp"
PREFERRED_VERSION_linux-imx-headers = "5.4.8mp"
PREFERRED_VERSION_u-boot-imx = "2019.04.8mp"
PREFERRED_VERSION_u-boot-imx-mfgtool = "2019.04.8mp"
```

## imx/meta-bsp/conf/machine/imx8mqddr4arm2.conf
```bitbake
#@TYPE: Machine
#@NAME: NXP i.MX8MQ DDR4 ARM2
#@SOC: i.MX8MQ
#@DESCRIPTION: Machine configuration for NXP i.MX8MQ DDR4 ARM2 validation board
#@MAINTAINER: Carol Zhu <carol.zhu@nxp.com>

MACHINEOVERRIDES =. "mx8:mx8mq:"

require conf/machine/include/imx-base.inc
require conf/machine/include/arm/arch-arm64.inc

MACHINE_SOCARCH_FILTER_append_mx8mq = "virtual/libopenvg virtual/libgles1 virtual/libgles2 virtual/egl virtual/mesa virtual/libgl virtual/libg2d"

KERNEL_DEVICETREE = "freescale/fsl-imx8mq-ddr4-arm2.dtb freescale/fsl-imx8mq-ddr4-arm2-gpmi-nand.dtb "

IMAGE_BOOTFILES_DEPENDS += "imx-m4-demos:do_deploy"
IMAGE_BOOTFILES += "imx8mq_m4_TCM_hello_world.bin imx8mq_m4_TCM_rpmsg_lite_pingpong_rtos_linux_remote.bin imx8mq_m4_TCM_rpmsg_lite_str_echo_rtos.bin"

UBOOT_CONFIG ??= "sd"
UBOOT_CONFIG[sd] = "imx8mq_ddr4_arm2_config,sdcard"
UBOOT_CONFIG[nand] = "imx8mq_ddr4_arm2_nand_config,ubifs"
SPL_BINARY = "spl/u-boot-spl.bin"

# Set DDR FIRMWARE
DDR_FIRMWARE_NAME = "ddr4_imem_1d.bin ddr4_dmem_1d.bin ddr4_imem_2d.bin ddr4_dmem_2d.bin"

# Set u-boot DTB
UBOOT_DTB_NAME = "fsl-imx8mq-ddr4-arm2.dtb"

# Set imx-mkimage boot target
IMXBOOT_TARGETS = "flash_ddr4_arm2 flash_ddr4_arm2_no_hdmi"

# Set Serial console
SERIAL_CONSOLE = "115200 ttymxc0"

IMAGE_BOOTLOADER = "imx-boot"

BOOT_SPACE = "65536"

LOADADDR = ""
UBOOT_SUFFIX = "bin"
UBOOT_MAKE_TARGET = ""
IMX_BOOT_SEEK = "33"
```

## imx/meta-bsp/conf/machine/imx8mqevk.conf
```bitbake
#@TYPE: Machine
#@NAME: NXP i.MX8MQ Evaluation Kit
#@SOC: i.MX8MQ
#@DESCRIPTION: Machine configuration for NXP i.MX8MQ EVK
#@MAINTAINER: Jun Zhu <junzhu@nxp.com>

require conf/machine/include/arm/arch-arm64.inc
require conf/machine/include/imx-base.inc

MACHINE_FEATURES += " pci wifi bluetooth"

MACHINEOVERRIDES =. "mx8:mx8mq:"
MACHINEOVERRIDES =. "imx:"

MACHINE_SOCARCH_FILTER_append_mx8mq = "virtual/libopenvg virtual/libgles1 virtual/libgles2 virtual/egl virtual/mesa virtual/libgl virtual/libg2d"

KERNEL_DEVICETREE = "freescale/fsl-imx8mq-evk.dtb "
KERNEL_DEVICETREE += "freescale/fsl-imx8mq-evk-lcdif-adv7535.dtb freescale/fsl-imx8mq-evk-lcdif-rm67191.dtb"
KERNEL_DEVICETREE += "freescale/fsl-imx8mq-evk-m4.dtb freescale/fsl-imx8mq-evk-mipi-csi2.dtb"
KERNEL_DEVICETREE += "freescale/fsl-imx8mq-evk-pcie1-m2.dtb "

IMAGE_M4LOADER = "imx-m4-demos"
IMAGE_M4 = "imx8mq_m4_TCM_hello_world.bin imx8mq_m4_TCM_rpmsg_lite_pingpong_rtos_linux_remote.bin imx8mq_m4_TCM_rpmsg_lite_str_echo_rtos.bin"

UBOOT_CONFIG ??= "sd"
UBOOT_CONFIG[sd] = "imx8mq_evk_config,sdcard"
UBOOT_CONFIG[mfgtool] = "imx8mq_evk_config"
SPL_BINARY = "spl/u-boot-spl.bin"

# Set Serial console
SERIAL_CONSOLE = "115200 ttymxc0"

IMAGE_BOOTLOADER = "imx-boot"

SDCARD_GENERATION_COMMAND_mx8 = "generate_imx_sdcard"

DEFAULTTUNE_mx8 = "aarch64"

IMX_DEFAULT_KERNEL_mx8mq = "linux-imx"

BOOT_SPACE = "32768"

KERNEL_IMAGETYPE = "Image"
LOADADDR = ""
UBOOT_SUFFIX = "bin"
UBOOT_MAKE_TARGET = ""
IMX_BOOT_SEEK = "33"
```

## imx/meta-bsp/conf/machine/imx8qma0ddr4arm2.conf
```bitbake
#@TYPE: Machine
#@NAME: i.MX 8QM A0 DDR4 ARM2
#@DESCRIPTION: i.MX 8QuadMax DDR4 ARM2 Development board
#@MAINTAINER: Carol Zhu <carol.zhu@nxp.com>

MACHINEOVERRIDES =. "mx8:mx8qm:"

require conf/machine/include/imx-base.inc
require conf/machine/include/arm/arch-arm64.inc

# Don't include kernels in standard images
RDEPENDS_${KERNEL_PACKAGE_NAME}-base = ""
RDEPENDS_${KERNEL_PACKAGE_NAME}-image = ""

LOADADDR = ""

# Disable the serial console due to auto-serial-console
SERIAL_CONSOLES = "115200;ttyAMA0"

# we do not want to have getty running on tty1 as we run
# auto-serial-console there
USE_VT = "0"

KERNEL_DEVICETREE = "freescale/fsl-imx8qm-ddr4-arm2.dtb"

UBOOT_MAKE_TARGET = "u-boot.bin"
UBOOT_SUFFIX = "bin"
UBOOT_CONFIG ??= "sd"
UBOOT_CONFIG[sd] = "imx8qm_ddr4_arm2_config,sdcard"

BOOT_SPACE = "65536"
IMAGE_BOOTLOADER = "imx-boot"
IMX_BOOT_SEEK = "33"

IMAGE_BOOTFILES_DEPENDS += "firmware-imx:do_deploy"
IMAGE_BOOTFILES += "hdmitxfw.bin hdmirxfw.bin dpfw.bin"

BOARD_TYPE = "ddr4"

# Set imx-mkimage boot target
IMXBOOT_TARGETS = "flash_a0_dcd"
```

## imx/meta-bsp/conf/machine/imx8qmddr4arm2.conf
```bitbake
#@TYPE: Machine
#@NAME: i.MX 8QM DDR4 ARM2
#@DESCRIPTION: i.MX 8QuadMax DDR4 ARM2 Development board
#@MAINTAINER: Carol Zhu <carol.zhu@nxp.com>

MACHINEOVERRIDES =. "mx8:mx8qm:"

require conf/machine/include/imx-base.inc
require conf/machine/include/arm/arch-arm64.inc

# Don't include kernels in standard images
RDEPENDS_kernel-base = ""

LOADADDR = ""

# Set imx-mkimage boot target
IMXBOOT_TARGETS = "flash"

# We have to disable SERIAL_CONSOLE due to auto-serial-console
SERIAL_CONSOLE = "115200 ttyAMA0"

# we do not want to have getty running on tty1 as we run
# auto-serial-console there
USE_VT = "0"

KERNEL_DEVICETREE = "freescale/fsl-imx8qm-ddr4-arm2.dtb"

UBOOT_MAKE_TARGET = "u-boot.bin"
UBOOT_SUFFIX = "bin"
UBOOT_CONFIG ??= "sd"
UBOOT_CONFIG[sd] = "imx8qm_ddr4_arm2_config,sdcard"

BOOT_SPACE = "65536"
IMAGE_BOOTLOADER = "imx-boot"
IMX_BOOT_SEEK = "33"

IMAGE_BOOTFILES_DEPENDS += "firmware-imx:do_deploy"
IMAGE_BOOTFILES += "hdmitxfw.bin dpfw.bin"

BOARD_TYPE = "ddr4"
```

## imx/meta-bsp/conf/machine/imx8qmlpddr4arm2.conf
```bitbake
#@TYPE: Machine
#@NAME: i.MX 8QM B0 LPDDR4 ARM2
#@DESCRIPTION: i.MX 8QuadMax LPDDR4 ARM2 Development board
#@MAINTAINER: Carol Zhu <carol.zhu@nxp.com>

MACHINEOVERRIDES =. "mx8:mx8qm:"

require conf/machine/include/imx-base.inc
require conf/machine/include/arm/arch-arm64.inc

# Don't include kernels in standard images
RDEPENDS_${KERNEL_PACKAGE_NAME}-base = ""
RDEPENDS_${KERNEL_PACKAGE_NAME}-image = ""

LOADADDR = ""

# Disable the serial console due to auto-serial-console
SERIAL_CONSOLES = "115200;ttyAMA0"

# we do not want to have getty running on tty1 as we run
# auto-serial-console there
USE_VT = "0"

KERNEL_DEVICETREE = "freescale/fsl-imx8qm-lpddr4-arm2.dtb freescale/fsl-imx8qm-lpddr4-arm2_ca53.dtb"
KERNEL_DEVICETREE += "freescale/fsl-imx8qm-lpddr4-arm2_ca72.dtb "
KERNEL_DEVICETREE += "freescale/fsl-imx8qm-lpddr4-arm2-8cam.dtb "
KERNEL_DEVICETREE += "freescale/fsl-imx8qm-lpddr4-arm2-hsic.dtb "
KERNEL_DEVICETREE += "freescale/fsl-imx8qm-lpddr4-arm2-hdmi.dtb freescale/fsl-imx8qm-lpddr4-arm2-hdmi-in.dtb"
KERNEL_DEVICETREE += "freescale/fsl-imx8qm-lpddr4-arm2-it6263-dual-channel.dtb"
KERNEL_DEVICETREE += "freescale/fsl-imx8qm-lpddr4-arm2-mqs.dtb freescale/fsl-imx8qm-lpddr4-arm2-spdif.dtb"
KERNEL_DEVICETREE += "freescale/fsl-imx8qm-lpddr4-arm2-usb3.dtb freescale/fsl-imx8qm-lpddr4-arm2-lpspi.dtb"
KERNEL_DEVICETREE += "freescale/fsl-imx8qm-lpddr4-arm2-dsi-rm67191.dtb"
KERNEL_DEVICETREE += "freescale/fsl-imx8qm-lpddr4-arm2-dp.dtb freescale/fsl-imx8qm-lpddr4-arm2-jdi-wuxga-lvds1-panel.dtb"
KERNEL_DEVICETREE += "freescale/fsl-imx8qm-lpddr4-arm2-enet2-tja1100.dtb "
KERNEL_DEVICETREE += "freescale/fsl-imx8qm-lpddr4-arm2-dp-dig-pll.dtb"
KERNEL_DEVICETREE += "freescale/fsl-imx8qm-lpddr4-arm2-dom0.dtb freescale/fsl-imx8qm-lpddr4-arm2-domu.dtb"
KERNEL_DEVICETREE += "freescale/fsl-imx8qm-lpddr4-arm2-lpspi-slave.dtb"

UBOOT_MAKE_TARGET = "u-boot.bin"
UBOOT_CONFIG ??= "sd"
UBOOT_CONFIG[sd] = "imx8qm_lpddr4_arm2_config,sdcard"
UBOOT_CONFIG[fspi] = "imx8qm_lpddr4_arm2_fspi_config"

IMAGE_BOOTLOADER = "imx-boot"
IMX_BOOT_SEEK = "32"

IMAGE_BOOT_FILES += "hdmitxfw.bin hdmirxfw.bin dpfw.bin"

BOARD_TYPE = "val"

IMXBOOT_TARGETS = "${@bb.utils.contains('UBOOT_CONFIG', 'fspi', 'flash_flexspi', \
                                                                'flash flash_regression_linux_m4', d)}"
```
