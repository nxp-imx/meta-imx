## imx/meta-bsp/conf/machine/imx7d12x12ddr3arm2.conf
```bitbake
#@TYPE: Machine
#@NAME: NXP i.MX7D 12x12 DDR3 ARM2 Evaluation Kit
#@SOC: i.MX7D
#@DESCRIPTION: Machine configuration for NXP i.MX7D 12x12 DDR3 ARM2 Evaluation Kit
#@MAINTAINER: Lauren Post <Lauren.Post@nxp.com>

MACHINEOVERRIDES =. "mx7:mx7d:"

require conf/machine/include/imx-base.inc
require conf/machine/include/tune-cortexa7.inc

MACHINE_FEATURES += " pci wifi bluetooth"

KERNEL_DEVICETREE = "imx7d-12x12-ddr3-arm2.dtb"

UBOOT_CONFIG ??= "sd"
UBOOT_CONFIG[sd] = "mx7d_12x12_ddr3_arm2_config,sdcard"
UBOOT_CONFIG[mfgtool] = "mx7d_12x12_ddr3_arm2_config"
```

## imx/meta-bsp/conf/machine/imx7d19x19ddr3arm2.conf
```bitbake
#@TYPE: Machine
#@NAME: Freescale i.MX7D 19x19 DDR3 ARM2 Evaluation Kit
#@SOC: i.MX7D
#@DESCRIPTION: Machine configuration for Freescale i.MX7D 19x19 DDR3 ARM2 Evaluation Kit
#@MAINTAINER: Lauren Post <Lauren.Post@freescale.com>

require conf/machine/include/imx7dsabresd-common.inc

SOC_FAMILY = "mx7:mx7d"

KERNEL_DEVICETREE = "imx7d-19x19-ddr3-arm2.dtb imx7d-19x19-ddr3-arm2-sai.dtb imx7d-19x19-ddr3-arm2-csi.dtb \
                     imx7d-19x19-ddr3-arm2-mipi.dtb"

UBOOT_CONFIG ??= "sd"
UBOOT_CONFIG[sd] = "mx7d_19x19_ddr3_arm2_config,sdcard"
UBOOT_CONFIG[mfgtool] = "mx7d_19x10_ddr3_arm2_config"
```

## imx/meta-bsp/conf/machine/imx7d19x19lpddr2arm2.conf
```bitbake
#@TYPE: Machine
#@NAME: NXP i.MX7D 19x19 LPDDR ARM2 Board
#@SOC: i.MX7D
#@DESCRIPTION: Machine configuration for NXP i.MX7D 19x19 LPDDR3 ARM2 Board
#@MAINTAINER: Lauren Post <Lauren.Post@nxp.com>

MACHINEOVERRIDES =. "mx7:mx7d:"

require conf/machine/include/imx-base.inc
require conf/machine/include/tune-cortexa7.inc

MACHINE_FEATURES += " pci wifi bluetooth"

KERNEL_DEVICETREE = "imx7d-19x19-lpddr2-arm2.dtb"

UBOOT_CONFIG ??= "sd"
UBOOT_CONFIG[sd] = "mx7d_19x19_lpddr2_arm2_config,sdcard"
UBOOT_CONFIG[mfgtool] = "mx7d_19x19_lpddr2_arm2_config"
```

## imx/meta-bsp/conf/machine/imx7d19x19lpddr3arm2.conf
```bitbake
#@TYPE: Machine
#@NAME: NXP i.MX7D 19x19 LPDDR3 ARM2 Evaluation Kit
#@SOC: i.MX7D
#@DESCRIPTION: Machine configuration for NXP i.MX7D 19x19 LPDDR3 ARM2 Evaluation Kit
#@MAINTAINER: Lauren Post <Lauren.Post@nxp.com>

MACHINEOVERRIDES =. "mx7:mx7d:"

require conf/machine/include/imx-base.inc
require conf/machine/include/tune-cortexa7.inc

MACHINE_FEATURES += " pci wifi bluetooth"

KERNEL_DEVICETREE = "imx7d-19x19-lpddr3-arm2.dtb"

UBOOT_CONFIG ??= "sd"
UBOOT_CONFIG[sd] = "mx7d_19x19_lpddr3_arm2_config,sdcard"
UBOOT_CONFIG[eimnor] = "mx7d_19x19_lpddr3_arm2_eimnor_config"
UBOOT_CONFIG[nand] = "mx7d_19x19_lpddr3_arm2_nand_config,ubifs"
UBOOT_CONFIG[mfgtool] = "mx7d_19x19_lpddr3_arm2_config"
```

## imx/meta-bsp/conf/machine/imx7dsabresd.conf
```bitbake
#@TYPE: Machine
#@NAME: NXP i.MX7D SABRE Smart Device
#@SOC: i.MX7D
#@DESCRIPTION: Machine configuration for NXP i.MX7D SABRE Smart Device
#@MAINTAINER: Lauren Post <Lauren.Post@nxp.com>

MACHINEOVERRIDES =. "mx7:mx7d:"

require conf/machine/include/imx-base.inc
require conf/machine/include/tune-cortexa7.inc

MACHINE_FEATURES += " pci wifi bluetooth"

KERNEL_DEVICETREE = "imx7d-sdb.dtb imx7d-sdb-epdc.dtb imx7d-sdb-gpmi-weim.dtb \
                     imx7d-sdb-m4.dtb imx7d-sdb-mipi-dsi.dtb imx7d-sdb-qspi.dtb \
                     imx7d-sdb-reva.dtb imx7d-sdb-reva-epdc.dtb imx7d-sdb-reva-gpmi-weim.dtb \
                     imx7d-sdb-reva-hdmi-audio.dtb imx7d-sdb-reva-m4.dtb imx7d-sdb-reva-qspi.dtb \
                     imx7d-sdb-reva-touch.dtb imx7d-sdb-reva-wm8960.dtb"

IMAGE_M4LOADER = "imx-m4-demos"
IMAGE_M4 = "imx7d_sabresd_m4_TCM_Pingpang.bin imx7d_sabresd_m4_TCM_helloworld.bin imx7d_sabresd_m4_TCM_mcctty.bin"

UBOOT_CONFIG ??= "sd"
UBOOT_CONFIG[sd] = "mx7dsabresd_config,sdcard"
UBOOT_CONFIG[qspi1] = "mx7dsabresd_qspi1_config"
UBOOT_CONFIG[nand] = "mx7dsabresd_nand_config,ubifs"
UBOOT_CONFIG[epdc] = "mx7dsabresd_epdc_config"
UBOOT_CONFIG[nonsec] = "mx7dsabresd_nonsec_config,sdcard"
UBOOT_CONFIG[mfgtool] = "mx7dsabresd_config"

XSERVER += "mesa-driver-swrast"

# Install brcm firmware
MACHINE_FIRMWARE_append = " firmware-imx-brcm"

BOOT_SPACE_WITHOUT_OPTEE = "8192"
BOOT_SPACE_WITH_OPTEE = "10240"
BOOT_SPACE = '${@bb.utils.contains("COMBINED_FEATURES", "optee", ${BOOT_SPACE_WITH_OPTEE}, ${BOOT_SPACE_WITHOUT_OPTEE}, d)}'
```

## imx/meta-bsp/conf/machine/imx7ulp14x14arm2.conf
```bitbake
#@TYPE: Machine
#@NAME: NXP i.MX7ULP Evaluation Kit
#@SOC: i.MX7ULP
#@DESCRIPTION: Machine configuration for NXP i.MX7ULP EVK
#@MAINTAINER: Lauren Post <Lauren.Post@nxp.com>

MACHINEOVERRIDES =. "mx7:mx7ulp:"

require conf/machine/include/imx-base.inc
require conf/machine/include/tune-cortexa7.inc

MACHINE_FEATURES += " pci wifi bluetooth"

KERNEL_DEVICETREE = "imx7ulp-14x14-arm2.dtb"

UBOOT_CONFIG ??= "sd"
UBOOT_CONFIG[sd] = "mx7ulp_14x14_arm2_config,sdcard"
UBOOT_CONFIG[mfgtool] = "mx7ulp_14x14_arm2_config"

MACHINE_SOCARCH_SUFFIX = "-mx7ulp"
MACHINE_SOCARCH_FILTER_append_mx7ulp = "virtual/libopenvg virtual/libgles1 virtual/libgles2 virtual/egl virtual/mesa virtual/libgl virtual/libg2d"
IMX_DEFAULT_KERNEL_mx7ulp = "linux-imx"

# Install brcm firmware
MACHINE_FIRMWARE_append = " firmware-imx-brcm"

# Set Serial console
SERIAL_CONSOLE = "115200 ttyLP0"
```

## imx/meta-bsp/conf/machine/imx7ulp_all.conf
```bitbake
#@TYPE: Machine
#@NAME: NXP i.MX7ULP Evaluation Kit
#@SOC: i.MX7ULP
#@DESCRIPTION: Machine configuration for NXP i.MX7ULP EVK
#@MAINTAINER: Lauren Post <Lauren.Post@nxp.com>

MACHINEOVERRIDES =. "mx7:mx7ulp:"

require conf/machine/include/imx-base.inc
require conf/machine/include/tune-cortexa7.inc

MACHINE_FEATURES += " pci wifi bluetooth"

KERNEL_DEVICETREE = "imx7ulp-evk.dtb imx7ulp-evk-emmc.dtb imx7ulp-evk-emmc-qspi.dtb imx7ulp-evk-ft5416.dtb imx7ulp-evk-mipi.dtb"
KERNEL_DEVICETREE += "imx7ulp-evk-lpuart.dtb imx7ulp-evk-qspi.dtb imx7ulp-evk-sd1.dtb imx7ulp-evk-sensors-to-i2c5.dtb"
KERNEL_DEVICETREE += "imx7ulp-evk-wm8960.dtb"
KERNEL_DEVICETREE += "imx7ulp-14x14-arm2.dtb"

UBOOT_CONFIG ??= "sd"
UBOOT_CONFIG[sd] = "mx7ulp_evk_config,sdcard"
UBOOT_CONFIG[emmc] = "mx7ulp_evk_emmc_config,sdcard"
UBOOT_CONFIG[mfgtool] = "mx7ulp_evk_config"

MACHINE_SOCARCH_SUFFIX = "-mx7ulp"
MACHINE_SOCARCH_FILTER_append_mx7ulp = "virtual/libopenvg virtual/libgles1 virtual/libgles2 virtual/egl virtual/mesa virtual/libgl virtual/libg2d"
IMX_DEFAULT_KERNEL_mx7ulp = "linux-imx"

# Install brcm firmware
MACHINE_FIRMWARE_append = " firmware-imx-brcm"

# Set Serial console
SERIAL_CONSOLE = "115200 ttyLP0"
```

## imx/meta-bsp/conf/machine/imx7ulp_zebu.conf
```bitbake
#@TYPE: Machine
#@NAME: NXP i.MX7ULP Zebu
#@SOC: i.MX7ULP
#@DESCRIPTION: Machine configuration for NXP i.MX7ULP Zebu
#@MAINTAINER: Lauren Post <Lauren.Post@nxp.com>

MACHINE_SOCARCH_SUFFIX = "-mx7ulp"

require conf/machine/include/imx-base.inc
require conf/machine/include/tune-cortexa7.inc

MACHINE_FEATURES = ""

# comment out for zebu now - later use what is in imx-base.inc
#MACHINE_FEATURES += " pci wifi bluetooth"

MACHINEOVERRIDES =. "mx7:mx7ulp:"

KERNEL_DEVICETREE = "imx7ulp-zebu.dtb"

UBOOT_CONFIG ??= "basic"
UBOOT_CONFIG[basic] = "mx7ulp_zebu_config"

IMAGE_FSTYPES = "ext3"

MACHINE_SOCARCH_SUFFIX = "-mx7ulp"
MACHINE_SOCARCH_FILTER_append_mx7ulp = "virtual/libopenvg virtual/libgles1 virtual/libgles2 virtual/egl virtual/mesa virtual/libgl virtual/libg2d"
IMX_DEFAULT_KERNEL_mx7ulp = "linux-imx"

# Set Serial console
SERIAL_CONSOLE = "115200 ttyLP0"
```

## imx/meta-bsp/conf/machine/imx7ulpevk.conf
```bitbake
#@TYPE: Machine
#@NAME: NXP i.MX7ULP Evaluation Kit
#@SOC: i.MX7ULP
#@DESCRIPTION: Machine configuration for NXP i.MX7ULP EVK
#@MAINTAINER: Lauren Post <Lauren.Post@nxp.com>

MACHINEOVERRIDES =. "mx7:mx7ulp:"

require conf/machine/include/imx-base.inc
require conf/machine/include/tune-cortexa7.inc

MACHINE_FEATURES += " pci wifi bluetooth optee bcm43430"

KERNEL_DEVICETREE = "imx7ulp-evk.dtb imx7ulp-evkb-emmc.dtb imx7ulp-evk-emmc-qspi.dtb imx7ulp-evk-ft5416.dtb imx7ulp-evk-mipi.dtb"
KERNEL_DEVICETREE += "imx7ulp-evkb-lpuart.dtb imx7ulp-evk-qspi.dtb imx7ulp-evkb-sd1.dtb imx7ulp-evkb-sensors-to-i2c5.dtb"
KERNEL_DEVICETREE += "imx7ulp-evkb-spi-slave.dtb imx7ulp-evk-wm8960.dtb"
KERNEL_DEVICETREE += "imx7ulp-evkb.dtb imx7ulp-evkb-mipi.dtb"
KERNEL_DEVICETREE += "imx7ulp-evkb-rm68200-wxga.dtb imx7ulp-evkb-rm68191-qhd.dtb"
## imx7ulp doesn't have a dtb file for optee

WKS_FILE_DEPENDS += "imx-m4-demos"
IMAGE_BOOT_FILES += "imx7ulp_m4_demo.img imx7ulp_wireless_uart_bridge.img imx7ulp_erpc_matrix_multiply_rpmsg_rtos_imxcm4.img imx7ulp_rpmsg_lite_pingpong_rtos.img imx7ulp_rpmsg_lite_str_echo_rtos.img"

UBOOT_CONFIG ??= "${@bb.utils.contains('COMBINED_FEATURES', 'optee', 'sd-optee', 'sd', d)}"
UBOOT_CONFIG[sd] = "mx7ulp_evk_config,sdcard"
UBOOT_CONFIG[emmc] = "mx7ulp_evk_emmc_config,sdcard"
UBOOT_CONFIG[mfgtool] = "mx7ulp_evk_config"
UBOOT_CONFIG[sd-optee] = "mx7ulp_evk_optee_config,sdcard"

OPTEE_BIN_EXT = "7ulp"

SERIAL_CONSOLES = "115200;ttyLP0"
```

## imx/meta-bsp/conf/machine/imx8_all.conf
```bitbake
#@TYPE: Machine
#@NAME: i.MX 8 Common rootfs machine
#@SOC: i.MX 8QM and 8QXP
#@DESCRIPTION: Machine configuration for i.MX 8QM and 8QXP boards
#@MAINTAINER: Jun Zhu <junzhu@nxp.com>

MACHINEOVERRIDES =. "mx8:mx8qm:"

require conf/machine/include/imx-base.inc
require conf/machine/include/arm/arch-arm64.inc

MACHINE_FEATURES_append = " optee bcm43455 bcm4356 bcm4359"

# Don't include kernels in standard images
RDEPENDS_${KERNEL_PACKAGE_NAME}-base = ""
RDEPENDS_${KERNEL_PACKAGE_NAME}-image = ""

LOADADDR = ""

# Disable the serial console due to auto-serial-console
SERIAL_CONSOLES = "115200;ttyAMA0"

# we do not want to have getty running on tty1 as we run
# auto-serial-console there
USE_VT = "0"

KERNEL_DEVICETREE = "freescale/imx8mm-evk.dtb freescale/imx8mm-evk-ak4497.dtb freescale/imx8mm-evk-ak5558.dtb \
                     freescale/imx8mm-evk-audio-tdm.dtb freescale/imx8mm-evk-inmate.dtb \
                     freescale/imx8mm-evk-revb.dtb freescale/imx8mm-evk-rm67191.dtb freescale/imx8mm-evk-root.dtb \
                     freescale/imx8mm-evk-rpmsg.dtb \
                     freescale/imx8mm-ddr4-evk.dtb \
                     freescale/imx8mm-ddr4-evk-rm67191.dtb \
                     freescale/imx8mm-ddr4-evk-revb.dtb freescale/imx8mm-ddr4-evk-revb-rm67191.dtb \
                      \
                     freescale/imx8mn-evk.dtb \
                     freescale/imx8mn-ddr4-evk-ak5558.dtb freescale/imx8mn-ddr4-evk-inmate.dtb \
                     freescale/imx8mn-ddr4-evk-rm67191.dtb \
                     freescale/imx8mn-ddr4-evk-root.dtb freescale/imx8mn-ddr4-evk-rpmsg.dtb \
                     freescale/imx8mn-ddr4-evk.dtb \
                      \
                     freescale/imx8mq-evk-ak4497.dtb freescale/imx8mq-evk-audio-tdm.dtb \
                     freescale/imx8mq-evk-dcss-adv7535.dtb freescale/imx8mq-evk-dcss-rm67191.dtb \
                     freescale/imx8mq-evk-dp.dtb freescale/imx8mq-evk-inmate.dtb \
                     freescale/imx8mq-evk-lcdif-adv7535.dtb freescale/imx8mq-evk-lcdif-rm67191.dtb \
                     freescale/imx8mq-evk-pcie1-m2.dtb freescale/imx8mq-evk-pdm.dtb \
                     freescale/imx8mq-evk-root.dtb freescale/imx8mq-evk-rpmsg.dtb \
                     freescale/imx8mq-evk.dtb \
                      \
                     freescale/imx8qm-mek.dtb \
                     freescale/imx8qm-mek-ca53.dtb freescale/imx8qm-mek-ca72.dtb \
                     freescale/imx8qm-mek-dom0.dtb freescale/imx8qm-mek-domu.dtb \
                     freescale/imx8qm-mek-dsi-rm67191.dtb freescale/imx8qm-mek-dsp.dtb \
                     freescale/imx8qm-mek-enet2-tja1100.dtb freescale/imx8qm-mek-hdmi.dtb \
                     freescale/imx8qm-mek-jdi-wuxga-lvds1-panel.dtb \
                     freescale/imx8qm-mek-ov5640.dtb freescale/imx8qm-mek-rpmsg.dtb \
                      \
                     freescale/imx8qm-lpddr4-val.dtb \
                     freescale/imx8qm-lpddr4-val-ca53.dtb freescale/imx8qm-lpddr4-val-ca72.dtb \
                     freescale/imx8qm-lpddr4-val-lpspi.dtb freescale/imx8qm-lpddr4-val-lpspi-slave.dtb \
                     freescale/imx8qm-lpddr4-val-mqs.dtb freescale/imx8qm-lpddr4-val-spdif.dtb \
                      \
                     freescale/imx8qxp-mek.dtb freescale/imx8qxp-mek-a0.dtb \
                     freescale/imx8qxp-mek-dom0.dtb freescale/imx8qxp-mek-dsi-rm67191.dtb \
                     freescale/imx8qxp-mek-dsp.dtb \
                     freescale/imx8qxp-mek-enet2-tja1100.dtb freescale/imx8qxp-mek-enet2.dtb \
                     freescale/imx8qxp-mek-it6263-lvds0-dual-channel.dtb freescale/imx8qxp-mek-it6263-lvds1-dual-channel.dtb \
                     freescale/imx8qxp-mek-jdi-wuxga-lvds0-panel.dtb freescale/imx8qxp-mek-jdi-wuxga-lvds1-panel.dtb \
                     freescale/imx8qxp-mek-ov5640.dtb \
                     freescale/imx8qxp-mek-rpmsg.dtb freescale/imx8qxp-mek-sof.dtb \
                      \
                      \
                     freescale/imx8qxp-lpddr4-val.dtb \
                     freescale/imx8qxp-lpddr4-val-a0.dtb freescale/imx8qxp-lpddr4-val-gpmi-nand.dtb \
                     freescale/imx8qxp-lpddr4-val-lpspi.dtb freescale/imx8qxp-lpddr4-val-lpspi-slave.dtb \
                     freescale/imx8qxp-lpddr4-val-mlb.dtb \
                     freescale/imx8qxp-lpddr4-val-mqs.dtb freescale/imx8qxp-lpddr4-val-spdif.dtb \
                      \
                     freescale/imx8dxl-phantom-mek.dtb freescale/imx8dxl-phantom-mek-rpmsg.dtb \
"

UBOOT_MAKE_TARGET = \
    "${@bb.utils.contains('MACHINE_FEATURES', 'optee', '', \
                                                        'u-boot.bin', d)}"
SPL_BINARY = \
    "${@bb.utils.contains('MACHINE_FEATURES', 'optee', 'spl/u-boot-spl.bin', \
                                                        '', d)}"
UBOOT_CONFIG ??= "sd"
UBOOT_CONFIG[sd]   = "imx8qm_mek_defconfig,sdcard"
UBOOT_CONFIG[fspi] = "imx8qm_mek_fspi_defconfig"

IMAGE_BOOTLOADER = "imx-boot"
IMX_BOOT_SEEK = "32"

IMAGE_BOOT_FILES += "hdmitxfw.bin hdmirxfw.bin dpfw.bin"

BOARD_TYPE = "mek"

IMXBOOT_TARGETS_SD = \
    "${@bb.utils.contains('MACHINE_FEATURES', 'optee', 'flash_b0_spl_container', \
                                                        'flash_b0', d)}"
IMXBOOT_TARGETS_FSPI = \
    "${@bb.utils.contains('MACHINE_FEATURES', 'optee', 'flash_b0_spl_flexspi_container', \
                                                        'flash_b0_flexspi', d)}"
IMXBOOT_TARGETS = \
    "${@bb.utils.contains('UBOOT_CONFIG',         'sd', '${IMXBOOT_TARGETS_SD}', \
                                                        '${IMXBOOT_TARGETS_FSPI}', d)}"
```
