## imx/meta-bsp/conf/machine/imx8qmmek.conf
```bitbake
#@TYPE: Machine
#@NAME: i.MX 8QM B0 MEK
#@DESCRIPTION: i.MX 8QuadMax Multisensory Enablement Kit (MEK) board
#@MAINTAINER: Jun Zhu <junzhu@nxp.com>

MACHINEOVERRIDES =. "mx8:mx8qm:"

require conf/machine/include/imx-base.inc
require conf/machine/include/arm/arch-arm64.inc

MACHINE_FEATURES_append = " optee bcm43455 bcm4356 bcm4359"

# Don't include kernels in standard images
RDEPENDS_${KERNEL_PACKAGE_NAME}-base = ""
RDEPENDS_${KERNEL_PACKAGE_NAME}-image = ""

LOADADDR = ""

# Disable the serial console due to auto-serial-console
SERIAL_CONSOLES = "115200;ttyAMA0"

# we do not want to have getty running on tty1 as we run
# auto-serial-console there
USE_VT = "0"

KERNEL_DEVICETREE = "freescale/fsl-imx8qm-mek.dtb"
KERNEL_DEVICETREE += "freescale/fsl-imx8qm-mek_ca53.dtb freescale/fsl-imx8qm-mek_ca72.dtb "
KERNEL_DEVICETREE += "freescale/fsl-imx8qm-mek-dom0.dtb freescale/fsl-imx8qm-mek-dom0-dpu2.dtb"
KERNEL_DEVICETREE += "freescale/fsl-imx8qm-mek-domu-car.dtb"
KERNEL_DEVICETREE += "freescale/fsl-imx8qm-mek-domu-dpu1.dtb freescale/fsl-imx8qm-mek-domu-dpu1-hdmi.dtb"
KERNEL_DEVICETREE += "freescale/fsl-imx8qm-mek-domu.dtb "
KERNEL_DEVICETREE += "freescale/fsl-imx8qm-mek-dsi-rm67191.dtb freescale/fsl-imx8qm-mek-dsp.dtb"
KERNEL_DEVICETREE += "freescale/fsl-imx8qm-mek-enet2-tja1100.dtb"
KERNEL_DEVICETREE += "freescale/fsl-imx8qm-mek-hdmi.dtb freescale/fsl-imx8qm-mek-hdmi-in.dtb"
KERNEL_DEVICETREE += "freescale/fsl-imx8qm-mek-inmate.dtb freescale/fsl-imx8qm-mek-jdi-wuxga-lvds1-panel.dtb"
KERNEL_DEVICETREE += "freescale/fsl-imx8qm-mek-ov5640.dtb "
KERNEL_DEVICETREE += "freescale/fsl-imx8qm-mek-root.dtb "
KERNEL_DEVICETREE += "freescale/fsl-imx8qm-mek-rpmsg.dtb "

UBOOT_MAKE_TARGET = \
    "${@bb.utils.contains('COMBINED_FEATURES', 'optee', '', \
                                                        'u-boot.bin', d)}"
SPL_BINARY = \
    "${@bb.utils.contains('COMBINED_FEATURES', 'optee', 'spl/u-boot-spl.bin', \
                                                        '', d)}"
UBOOT_CONFIG ??= "sd"
UBOOT_CONFIG[sd]   = "imx8qm_mek_defconfig,sdcard"
UBOOT_CONFIG[fspi] = "imx8qm_mek_fspi_defconfig"

IMAGE_BOOTLOADER = "imx-boot"
IMX_BOOT_SEEK = "32"

IMAGE_BOOT_FILES += "hdmitxfw.bin hdmirxfw.bin dpfw.bin"

BOARD_TYPE = "mek"

IMXBOOT_TARGETS_SD = \
    "${@bb.utils.contains('COMBINED_FEATURES', 'optee', 'flash_linux_m4 flash_spl', \
                                                        'flash flash_ca72', d)}"
IMXBOOT_TARGETS_FSPI = \
    "${@bb.utils.contains('COMBINED_FEATURES', 'optee', 'flash_spl_flexspi', \
                                                        'flash_flexspi', d)}"
IMXBOOT_TARGETS = \
    "${@bb.utils.contains('UBOOT_CONFIG',         'sd', '${IMXBOOT_TARGETS_SD}', \
                                                        '${IMXBOOT_TARGETS_FSPI}', d)}"
```

## imx/meta-bsp/conf/machine/imx8qmqxp.conf
```bitbake
#@TYPE: Machine
#@NAME: i.MX 8 and 8X Combined Machine
#@SOC: i.MX 8QM and 8QXP
#@DESCRIPTION: A combined machine for i.MX 8 and 8X boards, see comment below
#@MAINTAINER: Jun Zhu <junzhu@nxp.com>

#        ** WARNING - THIS MACHINE IS FOR TEST ONLY **
# The resulting image will contain the 8QM MEK u-boot, kernel, and rootfs, plus the DTBs for all
# i.MX 8 and 8X boards. The image can be used on other boards by replacing the u-boot
# image, but please note that certain application functionality will not work depending on the
# capabilities of the board. For example, functionality that depends on OpenVX will not work on
# i.MX 8X boards.

require conf/machine/imx8qmmek.conf

# DEVICETREE of i.MX 8QM
KERNEL_DEVICETREE += "freescale/fsl-imx8qm-lpddr4-arm2.dtb freescale/fsl-imx8qm-lpddr4-arm2_ca53.dtb"
KERNEL_DEVICETREE += "freescale/fsl-imx8qm-lpddr4-arm2_ca72.dtb "
KERNEL_DEVICETREE += "freescale/fsl-imx8qm-lpddr4-arm2-8cam.dtb "
KERNEL_DEVICETREE += "freescale/fsl-imx8qm-lpddr4-arm2-hsic.dtb "
KERNEL_DEVICETREE += "freescale/fsl-imx8qm-lpddr4-arm2-hdmi.dtb freescale/fsl-imx8qm-lpddr4-arm2-hdmi-in.dtb"
KERNEL_DEVICETREE += "freescale/fsl-imx8qm-lpddr4-arm2-it6263-dual-channel.dtb"
KERNEL_DEVICETREE += "freescale/fsl-imx8qm-lpddr4-arm2-mqs.dtb freescale/fsl-imx8qm-lpddr4-arm2-spdif.dtb"
KERNEL_DEVICETREE += "freescale/fsl-imx8qm-lpddr4-arm2-usb3.dtb freescale/fsl-imx8qm-lpddr4-arm2-lpspi.dtb"
KERNEL_DEVICETREE += "freescale/fsl-imx8qm-lpddr4-arm2-dsi-rm67191.dtb"
KERNEL_DEVICETREE += "freescale/fsl-imx8qm-lpddr4-arm2-dp.dtb freescale/fsl-imx8qm-lpddr4-arm2-jdi-wuxga-lvds1-panel.dtb"
KERNEL_DEVICETREE += "freescale/fsl-imx8qm-lpddr4-arm2-enet2-tja1100.dtb "
KERNEL_DEVICETREE += "freescale/fsl-imx8qm-lpddr4-arm2-dp-dig-pll.dtb"
KERNEL_DEVICETREE += "freescale/fsl-imx8qm-lpddr4-arm2-dom0.dtb freescale/fsl-imx8qm-lpddr4-arm2-domu.dtb"
KERNEL_DEVICETREE += "freescale/fsl-imx8qm-lpddr4-arm2-lpspi-slave.dtb"

KERNEL_DEVICETREE += "freescale/fsl-imx8qm-ddr4-arm2.dtb freescale/fsl-imx8qm-ddr4-arm2-hdmi.dtb"

# DEVICETREE of i.MX 8QXP
KERNEL_DEVICETREE += "freescale/fsl-imx8qxp-lpddr4-arm2.dtb freescale/fsl-imx8qxp-lpddr4-arm2-enet2.dtb"
KERNEL_DEVICETREE += "freescale/fsl-imx8qxp-lpddr4-arm2-dsi-rm67191.dtb freescale/fsl-imx8qxp-lpddr4-arm2-enet2-tja1100.dtb "
KERNEL_DEVICETREE += "freescale/fsl-imx8qxp-lpddr4-arm2-dsp.dtb"
KERNEL_DEVICETREE += "freescale/fsl-imx8qxp-lpddr4-arm2-gpmi-nand.dtb"
KERNEL_DEVICETREE += "freescale/fsl-imx8qxp-lpddr4-arm2-lpspi.dtb freescale/fsl-imx8qxp-lpddr4-arm2-lpspi-slave.dtb"
KERNEL_DEVICETREE += "freescale/fsl-imx8qxp-lpddr4-arm2-mlb.dtb freescale/fsl-imx8qxp-lpddr4-arm2-mqs.dtb"
KERNEL_DEVICETREE += "freescale/fsl-imx8qxp-lpddr4-arm2-spdif.dtb freescale/fsl-imx8qxp-lpddr4-arm2-wm8962.dtb"

KERNEL_DEVICETREE += "freescale/fsl-imx8qxp-mek.dtb freescale/fsl-imx8qxp-mek-dom0.dtb"
KERNEL_DEVICETREE += "freescale/fsl-imx8qxp-mek-dsi-rm67191.dtb freescale/fsl-imx8qxp-mek-dsp.dtb"
KERNEL_DEVICETREE += "freescale/fsl-imx8qxp-mek-enet2.dtb freescale/fsl-imx8qxp-mek-enet2-tja1100.dtb"
KERNEL_DEVICETREE += "freescale/fsl-imx8qxp-mek-it6263-lvds0-dual-channel.dtb freescale/fsl-imx8qxp-mek-it6263-lvds1-dual-channel.dtb"
KERNEL_DEVICETREE += "freescale/fsl-imx8qxp-mek-inmate.dtb"
KERNEL_DEVICETREE += "freescale/fsl-imx8qxp-mek-lcdif.dtb"
KERNEL_DEVICETREE += "freescale/fsl-imx8qxp-mek-a0.dtb freescale/fsl-imx8qxp-lpddr4-arm2-a0.dtb"
KERNEL_DEVICETREE += "freescale/fsl-imx8qxp-mek-jdi-wuxga-lvds1-panel.dtb freescale/fsl-imx8qxp-mek-jdi-wuxga-lvds0-panel.dtb"
KERNEL_DEVICETREE += "freescale/fsl-imx8qxp-mek-ov5640.dtb"
KERNEL_DEVICETREE += "freescale/fsl-imx8qxp-mek-rpmsg.dtb freescale/fsl-imx8qxp-mek-root.dtb"

KERNEL_DEVICETREE += "freescale/fsl-imx8qxp-ddr3l-val.dtb"
```

## imx/meta-bsp/conf/machine/imx8qxpa0mek.conf
```bitbake
#@TYPE: Machine
#@NAME: i.MX 8QXP A0 MEK
#@DESCRIPTION: i.MX 8QXP A0 Multisensory Enablement Kit (MEK) board

MACHINEOVERRIDES =. "mx8:mx8qxp:mx8qxpa0:"

require conf/machine/include/imx-base.inc
require conf/machine/include/arm/arch-arm64.inc

# Don't include kernels in standard images
RDEPENDS_${KERNEL_PACKAGE_NAME}-base = ""
RDEPENDS_${KERNEL_PACKAGE_NAME}-image = ""

LOADADDR = ""

# Disable the serial console due to auto-serial-console
SERIAL_CONSOLES = "115200;ttyAMA0"

# we do not want to have getty running on tty1 as we run
# auto-serial-console there
USE_VT = "0"

KERNEL_DEVICETREE = "freescale/fsl-imx8qxp-mek-a0.dtb freescale/fsl-imx8qxp-mek-dom0.dtb"
KERNEL_DEVICETREE += "freescale/fsl-imx8qxp-mek-dsi-rm67191.dtb"
KERNEL_DEVICETREE += "freescale/fsl-imx8qxp-mek-enet2.dtb freescale/fsl-imx8qxp-mek-enet2-tja1100.dtb"
KERNEL_DEVICETREE += "freescale/fsl-imx8qxp-mek-csi.dtb"
KERNEL_DEVICETREE += "freescale/fsl-imx8qxp-mek-mipi-ov5640.dtb"

UBOOT_MAKE_TARGET = "u-boot.bin"
UBOOT_SUFFIX = "bin"
UBOOT_CONFIG ??= "sd"
UBOOT_CONFIG[sd] = "imx8qxp_mek_config,sdcard"
UBOOT_CONFIG[fspi] = "imx8qxp_mek_fspi_defconfig"

BOOT_SPACE = "65536"
IMAGE_BOOTLOADER = "imx-boot"
IMX_BOOT_SEEK = "33"

IMXBOOT_TARGETS = "${@bb.utils.contains('UBOOT_CONFIG', 'fspi', 'flash_flexspi_a0', \
                                        'flash_multi_cores_a0 flash_a0 flash_dcd_a0', d)}"

BOARD_TYPE = "a0-mek"
```

## imx/meta-bsp/conf/machine/imx8qxpc0lpddr4arm2.conf
```bitbake
#@TYPE: Machine
#@NAME: i.MX 8QXP MEK
#@DESCRIPTION: i.MX 8QXP C0 LPDDR4 ARM2 Development board

require conf/machine/imx8qxpc0lpddr4arm2.conf
```
