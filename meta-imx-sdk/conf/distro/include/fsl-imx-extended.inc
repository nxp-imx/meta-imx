## meta-imx-sdk/conf/distro/include/fsl-imx-extended.inc
```bitbake
POKY_DEFAULT_DISTRO_FEATURES:append = " \
    qt \
    ${POKY_DEFAULT_DISTRO_FEATURES_IMX_APPEND}"
POKY_DEFAULT_DISTRO_FEATURES_IMX_APPEND             ?= "jailhouse xen"
POKY_DEFAULT_DISTRO_FEATURES_IMX_APPEND:mx6-nxp-bsp ?= ""
POKY_DEFAULT_DISTRO_FEATURES_IMX_APPEND:mx7-nxp-bsp ?= ""
```

## meta-imx-sdk/conf/layer.conf
```bitbake
# We have a conf and classes directory, add to BBPATH
BBPATH .= ":${LAYERDIR}"

# We have a packages directory, add to BBFILES
BBFILES += "${LAYERDIR}/recipes-*/*/*.bb \
            ${LAYERDIR}/recipes-*/*/*.bbappend"

BBFILE_COLLECTIONS += "fsl-sdk-release"
BBFILE_PATTERN_fsl-sdk-release := "^${LAYERDIR}/"
BBFILE_PRIORITY_fsl-sdk-release = "8"

LAYERDEPENDS_fsl-sdk-release = "freescale-distro fsl-bsp-release perl-layer"

LAYERSERIES_COMPAT_fsl-sdk-release = "walnascar"

# Currently using meta-flutter scarthgap layer
LAYERSERIES_COMPAT_flutter-layer:append = " walnascar"
LAYERSERIES_COMPAT_flutter-apps-layer:append = " walnascar"
LAYERSERIES_COMPAT_meta-flutter-apps:append = " walnascar"
ERROR_QA:remove:layer-flutter-layer = "patch-status"
ERROR_QA:remove:layer-flutter-apps-layer = "buildpaths patch-status"

BBFILES_DYNAMIC += " \
    chromium-browser-layer:${LAYERDIR}/dynamic-layers/chromium-browser-layer/*/*/*.bb \
    chromium-browser-layer:${LAYERDIR}/dynamic-layers/chromium-browser-layer/*/*/*.bbappend \
    clang-layer:${LAYERDIR}/dynamic-layers/clang-layer/*/*/*.bb \
    clang-layer:${LAYERDIR}/dynamic-layers/clang-layer/*/*/*.bbappend \
    flutter-layer:${LAYERDIR}/dynamic-layers/flutter-layer/*/*/*.bb \
    flutter-layer:${LAYERDIR}/dynamic-layers/flutter-layer/*/*/*.bbappend \
    multimedia-layer:${LAYERDIR}/dynamic-layers/multimedia-layer/*/*/*.bb \
    multimedia-layer:${LAYERDIR}/dynamic-layers/multimedia-layer/*/*/*.bbappend \
    nxp-matter-baseline:${LAYERDIR}/dynamic-layers/matter-layer/*/*/*.bb \
    nxp-matter-baseline:${LAYERDIR}/dynamic-layers/matter-layer/*/*/*.bbappend \
    nxp-openthread:${LAYERDIR}/dynamic-layers/nxp-openthread/*/*/*.bb \
    nxp-openthread:${LAYERDIR}/dynamic-layers/nxp-openthread/*/*/*.bbappend \
    openembedded-layer:${LAYERDIR}/dynamic-layers/openembedded-layer/*/*/*.bb \
    openembedded-layer:${LAYERDIR}/dynamic-layers/openembedded-layer/*/*/*.bbappend \
    qt6-layer:${LAYERDIR}/dynamic-layers/qt6-layer/*/*/*.bb \
    qt6-layer:${LAYERDIR}/dynamic-layers/qt6-layer/*/*/*.bbappend \
    virtualization-layer:${LAYERDIR}/dynamic-layers/virtualization-layer/*/*/*.bb \
    virtualization-layer:${LAYERDIR}/dynamic-layers/virtualization-layer/*/*/*.bbappend \
    networking-layer:${LAYERDIR}/dynamic-layers/networking-layer/*/*/*.bbappend \
"

BBMASK += " \
    meta-freescale-distro/recipes-fsl/packagegroups/packagegroup-fsl-tools-gpu-external.bb \
"
```
