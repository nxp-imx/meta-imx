## conf/layer.conf
```bitbake
# We have a conf and classes directory, add to BBPATH
BBPATH .= ":${LAYERDIR}"

# We have a packages directory, add to BBFILES
BBFILES += "${LAYERDIR}/imx/meta-fsl-arm/recipes-*/*/*.bb \
            ${LAYERDIR}/imx/meta-fsl-arm/recipes-*/*/*.bbappend"

BBFILES += "${LAYERDIR}/imx/meta-fsl-demos/recipes-*/*/*.bb \
            ${LAYERDIR}/imx/meta-fsl-demos/recipes-*/*/*.bbappend"

BBFILE_COLLECTIONS += "fsl-bsp-release"
BBFILE_PATTERN_fsl-bsp-release := "^${LAYERDIR}"
BBFILE_PRIORITY_fsl-bsp-release = "7"

# Preferred Versions
PREFERRED_PROVIDER_u-boot_mx6 = "u-boot-imx"
PREFERRED_PROVIDER_virtual/libgal_mx6 = "gpu-viv-bin-mx6q"
```

## imx/conf/layer.conf
```bitbake
# We have a conf and classes directory, add to BBPATH
BBPATH .= ":${LAYERDIR}"

# We have a packages directory, add to BBFILES
BBFILES += "${LAYERDIR}/meta-fsl-arm/recipes-*/*/*.bb \
            ${LAYERDIR}/meta-fsl-arm/recipes-*/*/*.bbappend"

BBFILES += "${LAYERDIR}/meta-fsl-demos/recipes-*/*/*.bb \
            ${LAYERDIR}/meta-fsl-demos/recipes-*/*/*.bbappend"

BBFILE_COLLECTIONS += "fsl-bsp-release"
BBFILE_PATTERN_fsl-bsp-release := "^${LAYERDIR}"
BBFILE_PRIORITY_fsl-bsp-release = "7"
```

## imx/meta-bsp/conf/distro/fsl-imx-release-fb.conf
```bitbake
require conf/distro/fsl-imx-release.conf

DISTRO = "fsl-imx-release-fb"

# Remove conflicting backends.
DISTRO_FEATURES_remove = "x11 wayland directfb "

PREFERRED_PROVIDER_virtual/mesa = ""
```

## imx/meta-bsp/conf/distro/fsl-imx-release-wayland.conf
```bitbake
require conf/distro/fsl-imx-release.conf

DISTRO = "fsl-imx-release-wayland"


# Remove conflicting backends
DISTRO_FEATURES_remove = "x11 directfb "


PREFERRED_PROVIDER_virtual/mesa = ""
```

## imx/meta-bsp/conf/layer.conf
```bitbake
# We have a conf and classes directory, add to BBPATH
BBPATH .= ":${LAYERDIR}"

# We have a packages directory, add to BBFILES
BBFILES += "${LAYERDIR}/recipes-*/*/*.bb \
            ${LAYERDIR}/recipes-*/*/*.bbappend"

BBFILE_COLLECTIONS += "fsl-bsp-release"
BBFILE_PATTERN_fsl-bsp-release := "^${LAYERDIR}"
BBFILE_PRIORITY_fsl-bsp-release = "8"
LAYERSERIES_COMPAT_fsl-bsp-release = "warrior zeus"

HOSTTOOLS_NONFATAL_append = " bc sha384sum xxd"

# Enable optee for all builds using this layer, assuming the machine supports it.
# To remove optee from the build, add the following line to local.conf:
# DISTRO_FEATURES_remove = "optee"
# DEPRECATED: The ability to remove optee from the build is deprecated and
# will be removed in some future release.
DISTRO_FEATURES_append = " optee"

DISTRO_FEATURES_FILTER_NATIVESDK += "wayland"

# Overrides for imx-base.inc
IMAGE_CLASSES += "image_types_create_sdcard_symlink"
UBOOT_ENTRYPOINT_mx6ulz = "0x10008000"
DEFAULTTUNE_mx6ulz ?= "cortexa7thf-neon"

MACHINEOVERRIDES_EXTENDER_mx6ulz = "imxfbdev:imxpxp:imxepdc"
#FIXME: MACHINEOVERRIDES_EXTENDER_mx8mm/mq failed to do override as meta-freescale already have the setting with same filter
MACHINEOVERRIDES_EXTENDER_imx8mqevk  = "imxdrm:imxdcss:imxvpu:imxvpuhantro:imxgpu:imxgpu3d"
MACHINEOVERRIDES_EXTENDER_imx8mmevk  = "imxdrm:imxvpu:imxvpuhantro:imxgpu:imxgpu2d:imxgpu3d"
MACHINEOVERRIDES_EXTENDER_mx8mn  = "imxdrm:imxgpu:imxgpu3d"
MACHINEOVERRIDES_EXTENDER_mx8dxl = "imxfbdev"

MACHINE_SOCARCH_SUFFIX_mx6ulz = "-mx6ul"
MACHINE_SOCARCH_SUFFIX_mx8mn  = "-mx8mn"
MACHINE_SOCARCH_SUFFIX_mx8dxl = "-mx8l"

MACHINE_SOCARCH_FILTER_append_imxgpu = " opencv"
MACHINE_SOCARCH_FILTER_append_mx8    = " virtual/libopenvx"

# Use latest SDMA firmware from firmware-imx instead of upstream linux-firmware
MACHINE_FIRMWARE_remove_mx6  = "linux-firmware-imx-sdma-imx6q"
MACHINE_FIRMWARE_remove_mx7d = "linux-firmware-imx-sdma-imx7d"
MACHINE_FIRMWARE_append_mx6  = " firmware-imx-sdma"
MACHINE_FIRMWARE_append_mx7  = " firmware-imx-sdma"

MACHINE_FIRMWARE_append_mx6ulz = " firmware-imx-epdc"
MACHINE_FIRMWARE_append_mx8    = " linux-firmware-ath10k firmware-imx-sdma"
MACHINE_FIRMWARE_append_mx8qm  = " firmware-imx-vpu-imx8"
MACHINE_FIRMWARE_remove_mx8qxp = "firmware-imx-vpu-imx8qxp"
MACHINE_FIRMWARE_append_mx8qxp = " firmware-imx-vpu-imx8"
MACHINE_FIRMWARE_append = " ${@bb.utils.contains('MACHINE_FEATURES', 'bcm4339', 'linux-firmware-bcm4339', '', d)}"
MACHINE_FIRMWARE_append = " ${@bb.utils.contains('MACHINE_FEATURES', 'bcm43430', 'linux-firmware-bcm43430', '', d)}"
MACHINE_FIRMWARE_append = " ${@bb.utils.contains('MACHINE_FEATURES', 'bcm43455', 'linux-firmware-bcm43455', '', d)}"
MACHINE_FIRMWARE_append = " ${@bb.utils.contains('MACHINE_FEATURES', 'bcm4356', 'linux-firmware-bcm4356-pcie', '', d)}"
MACHINE_FIRMWARE_append = " ${@bb.utils.contains('MACHINE_FEATURES', 'bcm4359', 'linux-firmware-bcm4359-pcie', '', d)}"

MACHINE_GSTREAMER_1_0_PLUGIN_mx6dl ?= "imx-gst1.0-plugin"
MACHINE_GSTREAMER_1_0_PLUGIN_mx6q ?= "imx-gst1.0-plugin"
MACHINE_GSTREAMER_1_0_PLUGIN_mx6sl ?= "imx-gst1.0-plugin"
MACHINE_GSTREAMER_1_0_PLUGIN_mx6sll ?= "imx-gst1.0-plugin"
MACHINE_GSTREAMER_1_0_PLUGIN_mx6sx ?= "imx-gst1.0-plugin"
MACHINE_GSTREAMER_1_0_PLUGIN_mx6ul ?= "imx-gst1.0-plugin"
MACHINE_GSTREAMER_1_0_PLUGIN_mx7d ?= "imx-gst1.0-plugin"
MACHINE_GSTREAMER_1_0_PLUGIN_mx7ulp ?= "imx-gst1.0-plugin"
MACHINE_GSTREAMER_1_0_PLUGIN_mx8 ?= "imx-gst1.0-plugin"

PREFERRED_VERSION_weston_mx6 ?= "6.0.1.imx"
PREFERRED_VERSION_weston_mx7 ?= "6.0.1.imx"
PREFERRED_VERSION_weston_mx8 ?= "6.0.1.imx"
PREFERRED_VERSION_libdrm_mx6 ?= "2.4.99.imx"
PREFERRED_VERSION_libdrm_mx7 ?= "2.4.99.imx"
PREFERRED_VERSION_libdrm_mx8 ?= "2.4.99.imx"

IMX_DEFAULT_KERNEL_mx6ulz = "linux-imx"

SOC_DEFAULT_IMAGE_FSTYPES_remove = "wic.gz"
SOC_DEFAULT_IMAGE_FSTYPES_append = " wic.bz2 tar.bz2"

# Remove from upstream
SDCARD_ROOTFS = "NO_LONGER_USED"

IMAGE_BOOT_FILES_OPTEE     = "tee.bin uTee-${OPTEE_BIN_EXT}"
IMAGE_BOOT_FILES_OPTEE_mx8 = "tee.bin"
IMAGE_BOOT_FILES_append = " \
    ${@bb.utils.contains('COMBINED_FEATURES', 'optee', '${IMAGE_BOOT_FILES_OPTEE}', '', d)} \
    ${@bb.utils.contains('COMBINED_FEATURES', 'xen', 'xen', '', d)} \
"

IMAGE_INSTALL_append = " \
    ${@bb.utils.contains('COMBINED_FEATURES', 'jailhouse', 'jailhouse', '', d)} \
    ${@bb.utils.contains('COMBINED_FEATURES', 'optee', 'packagegroup-fsl-optee-imx', '', d)} \
    ${@bb.utils.contains('COMBINED_FEATURES', 'xen', 'imx-xen-base imx-xen-hypervisor', '', d)} \
"

SOC_DEFAULT_WKS_FILE_mx8 ?= "imx-imx-boot-bootpart2.wks.in"

MACHINE_FEATURES_append_mx8qm  = " xen"
MACHINE_FEATURES_append_mx8qxp = " xen"

# Overrides for all MACHINE.conf with optee support
UBOOT_CONFIG_OPTEE_CONFIG = "mx${OPTEE_BIN_EXT}_optee_config"
UBOOT_CONFIG[sd-optee] = "${UBOOT_CONFIG_OPTEE_CONFIG},sdcard"

# Overrides for imx6slevk.conf
UBOOT_CONFIG_imx6slevk = "${@bb.utils.contains('COMBINED_FEATURES', 'optee', 'sd-optee', 'sd', d)}"
OPTEE_BIN_EXT_imx6slevk = "6slevk"
MACHINE_FEATURES_append_imx6slevk = " optee bcm4339 bcm43455"

# Overrides for imx6sllevk.conf
MACHINE_FIRMWARE_remove_imx6sllevk = "firmware-imx-brcm"
UBOOT_CONFIG_imx6sllevk = "${@bb.utils.contains('COMBINED_FEATURES', 'optee', 'sd-optee', 'sd', d)}"
OPTEE_BIN_EXT_imx6sllevk = "6sllevk"
MACHINE_FEATURES_remove_imx6sllevk = "pci"
MACHINE_FEATURES_append_imx6sllevk = " optee bcm4339 bcm43455"

# Overrides for imx6sxsabreauto.conf
UBOOT_CONFIG_imx6sxsabreauto = "${@bb.utils.contains('COMBINED_FEATURES', 'optee', 'sd-optee', 'sd', d)}"
UBOOT_CONFIG_OPTEE_CONFIG_imx6sxsabreauto = "mx6sxsabreauto_optee_config"
OPTEE_BIN_EXT_imx6sxsabreauto = "6sxauto"
MACHINE_FEATURES_append_imx6sxsabreauto = " optee"

# Overrides for imx6sxsabresd.conf
UBOOT_CONFIG_imx6sxsabresd = "${@bb.utils.contains('COMBINED_FEATURES', 'optee', 'sd-optee', 'sd', d)}"
UBOOT_CONFIG_OPTEE_CONFIG_imx6sxsabresd = "mx6sxsabresd_optee_config"
OPTEE_BIN_EXT_imx6sxsabresd = "6sxsdb"
MACHINE_FEATURES_append_imx6sxsabresd = " optee bcm4339 bcm43455"

# Overrides for imx6ulevk.conf
KERNEL_DEVICETREE_append_imx6ulevk = " \
    imx6ul-14x14-evk-btwifi-oob.dtb \
    imx6ul-14x14-evk-ecspi.dtb \
    imx6ul-14x14-evk-ecspi-slave.dtb \
    imx6ul-14x14-evk-pf1550.dtb"
UBOOT_CONFIG_imx6ulevk = "${@bb.utils.contains('COMBINED_FEATURES', 'optee', 'sd-optee', 'sd', d)}"
UBOOT_CONFIG_OPTEE_CONFIG_imx6ulevk = "mx6ul_14x14_evk_optee_config"
OPTEE_BIN_EXT_imx6ulevk = "6ulevk"
MACHINE_FEATURES_remove_imx6ulevk = "pci"
MACHINE_FEATURES_append_imx6ulevk = " optee bcm4339 bcm43455"
SPL_BINARY_imx6ulevk = ""
UBOOT_SUFFIX_imx6ulevk = "imx"
UBOOT_MAKE_TARGET_imx6ulevk = "u-boot.imx"
WKS_FILE_imx6ulevk = "imx-uboot-bootpart.wks.in"

# Overrides for imx7dsabresd.conf
UBOOT_CONFIG_NONSEC = "UNSUPPORTED"
UBOOT_CONFIG[nonsec] = "${UBOOT_CONFIG_NONSEC}"
UBOOT_CONFIG_imx7dsabresd = "${@bb.utils.contains('COMBINED_FEATURES', 'optee', 'sd-optee', 'sd', d)}"
UBOOT_CONFIG_NONSEC_imx7dsabresd = "mx7dsabresd_nonsec_config,sdcard"
UBOOT_CONFIG_OPTEE_CONFIG_imx7dsabresd = "mx7dsabresd_optee_config"
OPTEE_BIN_EXT_imx7dsabresd = "7dsdb"
MACHINE_FEATURES_append_imx7dsabresd = " optee bcm4339 bcm43455"
XSERVER_append_imx7dsabresd = " mesa-driver-swrast"
WKS_FILE_DEPENDS_append_imx7dsabresd = " imx-m4-demos"
IMAGE_BOOT_FILES_append_imx7dsabresd = " imx7d_sabresd_m4_TCM_Pingpang.bin imx7d_sabresd_m4_TCM_helloworld.bin imx7d_sabresd_m4_TCM_mcctty.bin"

# Overrides for imx7ulpevk.conf
MACHINE_FIRMWARE_remove_imx7ulpevk = "firmware-imx-brcm"
UBOOT_CONFIG_imx7ulpevk = "${@bb.utils.contains('COMBINED_FEATURES', 'optee', 'sd-optee', 'sd', d)}"
UBOOT_CONFIG_OPTEE_CONFIG_imx7ulpevk = "mx7ulp_evk_optee_config"
OPTEE_BIN_EXT_imx7ulpevk = "7ulp"
MACHINE_FEATURES_remove_imx7ulpevk = "qca9377"
MACHINE_FEATURES_append_imx7ulpevk = " optee bcm43430"
WKS_FILE_DEPENDS_append_imx7ulpevk = " imx-m4-demos"
IMAGE_BOOT_FILES_append_imx7ulpevk = " imx7ulp_m4_demo.img imx7ulp_wireless_uart_bridge.img imx7ulp_erpc_matrix_multiply_rpmsg_rtos_imxcm4.img imx7ulp_rpmsg_lite_pingpong_rtos.img imx7ulp_rpmsg_lite_str_echo_rtos.img"

# Overrides for imx8mmevk.conf
KERNEL_DEVICETREE_append_imx8mmevk = " freescale/fsl-imx8mm-evk-drm.dtb "
KERNEL_DEVICETREE_append_imx8mmevk = " freescale/fsl-imx8mm-evk-revb.dtb freescale/fsl-imx8mm-evk-revb-rm67191.dtb "
# Remove from upstream
# UBOOT_CONFIG[mfgtool] = "imx8mm_evk_config"
# BOOT_SPACE = "65536"
# UBOOT_SUFFIX = "bin"
# UBOOT_MAKE_TARGET = ""
# OPTEE_BIN_EXT = "8mm"
MACHINE_FEATURES_remove_imx8mmevk = "qca6174"
MACHINE_FEATURES_append_imx8mmevk = " bcm43455 bcm4356 bcm4359 jailhouse"
WKS_FILE_DEPENDS_append_imx8mmevk = " imx-m4-demos"
IMAGE_BOOT_FILES_append_imx8mmevk = " imx8mm_m4_TCM_hello_world.bin \
                    imx8mm_m4_TCM_rpmsg_lite_pingpong_rtos_linux_remote.bin \
                    imx8mm_m4_TCM_rpmsg_lite_str_echo_rtos.bin \
                    imx8mm_m4_TCM_sai_low_power_audio.bin \
"

# Overrides for imx8mqevk.conf
KERNEL_DEVICETREE_append_imx8mqevk = " freescale/fsl-imx8mq-evk-lcdif-rm67191.dtb"
# Remove from upstream
# UBOOT_CONFIG[mfgtool] = "imx8mq_evk_config"
# BOOT_SPACE = "65536"
# UBOOT_SUFFIX = "bin"
# UBOOT_MAKE_TARGET = ""
# OPTEE_BIN_EXT = "8mq"
MACHINE_FEATURES_remove_imx8mqevk = "qca6174"
MACHINE_FEATURES_append_imx8mqevk = " bcm43455 bcm4356 bcm4359 jailhouse"
WKS_FILE_DEPENDS_append_imx8mqevk = " imx-m4-demos"
IMAGE_BOOT_FILES_append_imx8mqevk = " imx8mq_m4_TCM_hello_world.bin imx8mq_m4_TCM_rpmsg_lite_pingpong_rtos_linux_remote.bin imx8mq_m4_TCM_rpmsg_lite_str_echo_rtos.bin"
# Upstream machine config needs this update:
# PREFERRED_VERSION_gstreamer1.0 ?= "1.16.imx"
# PREFERRED_VERSION_gstreamer1.0-plugins-base ?= "1.16.imx"
# PREFERRED_VERSION_gstreamer1.0-plugins-good ?= "1.16.imx"
# PREFERRED_VERSION_gstreamer1.0-plugins-bad ?= "1.16.imx"
# PREFERRED_VERSION_gstreamer1.0-libav ?= "1.16.0"

# Overrides for imx8qmmek.conf
# Remove from upstream
# UBOOT_CONFIG[mfgtool] = "imx8qm_mek_defconfig"
# BOOT_SPACE = "65536"
MACHINE_FEATURES_remove_imx8qmmek = "qca6174"
MACHINE_FEATURES_append_imx8qmmek = " optee bcm43455 bcm4356 bcm4359"
RDEPENDS_${KERNEL_PACKAGE_NAME}-image_imx8qmmek = ""
UBOOT_MAKE_TARGET_imx8qmmek = \
    "${@bb.utils.contains('COMBINED_FEATURES', 'optee', '', \
                                                        'u-boot.bin', d)}"
SPL_BINARY_imx8qmmek = \
    "${@bb.utils.contains('COMBINED_FEATURES', 'optee', 'spl/u-boot-spl.bin', \
                                                        '', d)}"
IMX_BOOT_SEEK_imx8qmmek = "32"
WKS_FILE_DEPENDS_remove_imx8qmmek = "firmware-imx-8"
IMXBOOT_TARGETS_SD_imx8qmmek = \
    "${@bb.utils.contains('COMBINED_FEATURES', 'optee', 'flash_linux_m4 flash_spl', \
                                                        'flash_regression_linux_m4 flash flash_ca72', d)}"
IMXBOOT_TARGETS_FSPI_imx8qmmek = \
    "${@bb.utils.contains('COMBINED_FEATURES', 'optee', 'flash_spl_flexspi', \
                                                        'flash_flexspi', d)}"
IMXBOOT_TARGETS_imx8qmmek = \
    "${@bb.utils.contains('UBOOT_CONFIG',         'sd', '${IMXBOOT_TARGETS_SD}', \
                                                        '${IMXBOOT_TARGETS_FSPI}', d)}"

# Overrides for imx8qxpmek.conf
# Update DESCRIPTION to specify rev B0
# Remove from upstream
# BOOT_SPACE = "65536"
MACHINE_FEATURES_remove_imx8qxpmek = "qca6174"
MACHINE_FEATURES_append_imx8qxpmek = " optee bcm43455 bcm4356 bcm4359"
RDEPENDS_${KERNEL_PACKAGE_NAME}-image_imx8qxpmek = ""
KERNEL_DEVICETREE_remove_imx8qxpmek = "freescale/fsl-imx8qxp-mek-ov5640-rpmsg.dtb"
UBOOT_MAKE_TARGET_imx8qxpmek = \
    "${@bb.utils.contains('COMBINED_FEATURES', 'optee', '', \
                                                        'u-boot.bin', d)}"
SPL_BINARY_imx8qxpmek = \
    "${@bb.utils.contains('COMBINED_FEATURES', 'optee', 'spl/u-boot-spl.bin', \
                                                        '', d)}"
UBOOT_CONFIG_imx8qxpmek ??= "sd"
UBOOT_CONFIG_imx8qxpmek[sd]   = "imx8qxp_mek_defconfig,sdcard"
UBOOT_CONFIG_imx8qxpmek[fspi] = "imx8qxp_mek_fspi_defconfig"
IMXBOOT_TARGETS_SD_imx8qxpmek = \
    "${@bb.utils.contains('COMBINED_FEATURES', 'optee', 'flash_linux_m4 flash_spl', \
                                                        'flash_regression_linux_m4 flash', d)}"
IMXBOOT_TARGETS_FSPI_imx8qxpmek = \
    "${@bb.utils.contains('COMBINED_FEATURES', 'optee', 'flash_spl_flexspi', \
                                                        'flash_flexspi', d)}"
IMXBOOT_TARGETS_imx8qxpmek = \
    "${@bb.utils.contains('UBOOT_CONFIG',         'sd', '${IMXBOOT_TARGETS_SD}', \
                                                        '${IMXBOOT_TARGETS_FSPI}', d)}"

# imx8qxpc0mek.conf requires imx8qxpmek.conf, so use the same overrides
# as from above
# Remove from upstream
# BOOT_SPACE = "65536"
MACHINE_FEATURES_remove_imx8qxpc0mek = "qca6174"
MACHINE_FEATURES_append_imx8qxpc0mek = " optee bcm43455 bcm4356 bcm4359"
RDEPENDS_${KERNEL_PACKAGE_NAME}-image_imx8qxpc0mek = ""
KERNEL_DEVICETREE_remove_imx8qxpc0mek = "freescale/fsl-imx8qxp-mek-ov5640-rpmsg.dtb"
UBOOT_MAKE_TARGET_imx8qxpc0mek = \
    "${@bb.utils.contains('COMBINED_FEATURES', 'optee', '', \
                                                        'u-boot.bin', d)}"
SPL_BINARY_imx8qxpc0mek = \
    "${@bb.utils.contains('COMBINED_FEATURES', 'optee', 'spl/u-boot-spl.bin', \
                                                        '', d)}"
UBOOT_CONFIG_imx8qxpc0mek ??= "sd"
UBOOT_CONFIG_imx8qxpc0mek[sd]   = "imx8qxp_mek_defconfig,sdcard"
UBOOT_CONFIG_imx8qxpc0mek[fspi] = "imx8qxp_mek_fspi_defconfig"
IMXBOOT_TARGETS_SD_imx8qxpc0mek = \
    "${@bb.utils.contains('COMBINED_FEATURES', 'optee', 'flash_linux_m4 flash_spl', \
                                                        'flash flash_regression_linux_m4', d)}"
IMXBOOT_TARGETS_FSPI_imx8qxpc0mek = \
    "${@bb.utils.contains('COMBINED_FEATURES', 'optee', 'flash_spl_flexspi', \
                                                        'flash_flexspi', d)}"
IMXBOOT_TARGETS_imx8qxpc0mek = \
    "${@bb.utils.contains('UBOOT_CONFIG',         'sd', '${IMXBOOT_TARGETS_SD}', \
                                                        '${IMXBOOT_TARGETS_FSPI}', d)}"
```
