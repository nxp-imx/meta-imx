## imx/meta-bsp/conf/machine/imx6ul7d.conf
```bitbake
#@TYPE: Machine
#@NAME: NXP i.MX Common rootfs machine for mfg tools without gpu
#@SOC: i.MX6UL, i.MX6ULL and i.MX7D

#@DESCRIPTION: Machine configuration for NXP i.MX 6 and 7  boards without a gpu

# this machine builds both for 6ul/6ull and 7D in same rootfs with all device trees

MACHINEOVERRIDES =. "mx6:mx6ul:"

require conf/machine/include/imx-base.inc
require conf/machine/include/tune-cortexa7.inc

# Install epdc firmware for i.MX7D
MACHINE_FIRMWARE_append = " firmware-imx-epdc"

KERNEL_DEVICETREE = "imx6ul-14x14-evk-csi.dtb imx6ul-14x14-evk.dtb \
                     imx6ul-14x14-evk-btwifi.dtb imx6ul-14x14-evk-btwifi-oob.dtb \
                     imx6ul-14x14-evk-ecspi.dtb imx6ul-14x14-evk-ecspi-slave.dtb \
                     imx6ul-14x14-evk-emmc.dtb imx6ul-14x14-evk-gpmi-weim.dtb \
                     imx6ul-14x14-evk-pf1550.dtb imx6ul-14x14-evk-usb-certi.dtb \
                     imx6ul-9x9-evk-csi.dtb imx6ul-9x9-evk.dtb imx6ul-9x9-evk-ldo.dtb imx6ul-9x9-evk-btwifi.dtb imx6ul-9x9-evk-btwifi-oob.dtb \
                     imx7d-sdb.dtb imx7d-sdb-epdc.dtb imx7d-sdb-gpmi-weim.dtb \
                     imx7d-sdb-m4.dtb imx7d-sdb-mipi-dsi.dtb imx7d-sdb-qspi.dtb \
                     imx7d-sdb-reva.dtb imx7d-sdb-reva-epdc.dtb imx7d-sdb-reva-gpmi-weim.dtb \
                     imx7d-sdb-reva-hdmi-audio.dtb imx7d-sdb-reva-m4.dtb imx7d-sdb-reva-qspi.dtb \
                     imx7d-sdb-reva-touch.dtb imx7d-sdb-reva-wm8960.dtb \
                     imx7d-12x12-lpddr3-arm2.dtb imx7d-12x12-lpddr3-arm2-ecspi.dtb imx7d-12x12-lpddr3-arm2-enet2.dtb \
                     imx7d-12x12-lpddr3-arm2-m4.dtb imx7d-12x12-lpddr3-arm2-mipi_dsi.dtb \
                     imx7d-12x12-lpddr3-arm2-mqs.dtb imx7d-12x12-lpddr3-arm2-pcie.dtb imx7d-12x12-lpddr3-arm2-qspi.dtb \
                     imx7d-12x12-lpddr3-arm2-sai.dtb imx7d-12x12-lpddr3-arm2-flexcan.dtb \
"

#i.MX6ULL
KERNEL_DEVICETREE += "imx6ull-14x14-evk.dtb imx6ull-14x14-evk-btwifi.dtb \
                     imx6ull-14x14-evk-btwifi-oob.dtb imx6ull-14x14-evk-emmc.dtb \
                     imx6ull-14x14-evk-gpmi-weim.dtb imx6ull-14x14-evk-usb-certi.dtb \
                     imx6ull-9x9-evk.dtb imx6ull-9x9-evk-btwifi.dtb \
                     imx6ull-9x9-evk-btwifi-oob.dtb imx6ull-9x9-evk-ldo.dtb \
"

#i.MX6ULZ
KERNEL_DEVICETREE += "imx6ulz-14x14-evk.dtb imx6ulz-14x14-evk-btwifi.dtb imx6ulz-14x14-evk-btwifi-oob.dtb \
                     imx6ulz-14x14-evk-emmc.dtb imx6ulz-14x14-evk-gpmi-weim.dtb \
"

MACHINE_FEATURES_append = " pci wifi bluetooth optee bcm4339 bcm43455"

##UBOOT_MACHINE = "mx6ul_14x14_evk_config"
UBOOT_CONFIG ??= "${@bb.utils.contains('COMBINED_FEATURES', 'optee', 'sd-optee', 'sd', d)}"
UBOOT_CONFIG[sd] = "mx6ul_14x14_evk_config,sdcard"
UBOOT_CONFIG[sd-optee] = "mx6ul_14x14_evk_optee_config,sdcard"

OPTEE_BIN_EXT = "6ulevk"
```

## imx/meta-bsp/conf/machine/imx6ul9x9evk.conf
```bitbake
#@TYPE: Machine
#@NAME: NXP i.MX6UL Evaluation Kit
#@SOC: i.MX6UL
#@DESCRIPTION: Machine configuration for NXP i.MX6UL EVK 9x9
#@MAINTAINER: Lauren Post <lauren.post@nxp.com>

MACHINEOVERRIDES =. "mx6:mx6ul:"

include conf/machine/include/imx-base.inc
include conf/machine/include/tune-cortexa7.inc

KERNEL_DEVICETREE = "imx6ul-9x9-evk.dtb imx6ul-9x9-evk-ldo.dtb imx6ul-9x9-evk-btwifi.dtb"

UBOOT_CONFIG ??= "sd"
UBOOT_CONFIG[sd] = "mx6ul_9x9_evk_config,sdcard"
UBOOT_CONFIG[qspi1] = "mx6ul_9x9_evk_qspi1_config"
UBOOT_CONFIG[mfgtool] = "mx6ul_9x9_evk_config"
```

## imx/meta-bsp/conf/machine/imx6ulevk.conf
```bitbake
#@TYPE: Machine
#@NAME: NXP i.MX6UL Evaluation Kit
#@SOC: i.MX6UL
#@DESCRIPTION: Machine configuration for NXP i.MX6UL EVK
#@MAINTAINER: Lauren Post <lauren.post@nxp.com>

MACHINEOVERRIDES =. "mx6:mx6ul:"

include conf/machine/include/imx-base.inc
include conf/machine/include/tune-cortexa7.inc

MACHINE_FEATURES += " pci wifi bluetooth optee bcm4339 bcm43455"

KERNEL_DEVICETREE = "imx6ul-14x14-evk.dtb imx6ul-14x14-evk-btwifi.dtb \
                     imx6ul-14x14-evk-btwifi-oob.dtb imx6ul-14x14-evk-csi.dtb \
                     imx6ul-14x14-evk-ecspi.dtb imx6ul-14x14-evk-ecspi-slave.dtb \
                     imx6ul-14x14-evk-emmc.dtb imx6ul-14x14-evk-gpmi-weim.dtb \
                     imx6ul-14x14-evk-pf1550.dtb imx6ul-14x14-evk-usb-certi.dtb"

UBOOT_CONFIG ??= "${@bb.utils.contains('COMBINED_FEATURES', 'optee', 'sd-optee', 'sd', d)}"
UBOOT_CONFIG[sd] = "mx6ul_14x14_evk_config,sdcard"
UBOOT_CONFIG[emmc] = "mx6ul_14x14_evk_emmc_config,sdcard"
UBOOT_CONFIG[qspi1] = "mx6ul_14x14_evk_qspi1_config"
UBOOT_CONFIG[mfgtool] = "mx6ul_14x14_evk_config"
UBOOT_CONFIG[sd-optee] = "mx6ul_14x14_evk_optee_config,sdcard"

OPTEE_BIN_EXT = "6ulevk"
```

## imx/meta-bsp/conf/machine/imx6ull14x14ddr3arm2.conf
```bitbake
#@TYPE: Machine
#@NAME: NXP i.MX6ULL 14x14 DDR3 ARM2 Evaluation Kit
#@SOC: i.MX6ULL
#@DESCRIPTION: Machine configuration for NXP i.MX6ULL DDR3 ARM2 EVK
#@MAINTAINER: Lauren Post <lauren.post@nxp.com>

MACHINEOVERRIDES =. "mx6:mx6ul:mx6ull:"

include conf/machine/include/imx-base.inc
include conf/machine/include/tune-cortexa7.inc

MACHINE_FIRMWARE_append = " firmware-imx-epdc"

KERNEL_DEVICETREE = "imx6ull-14x14-ddr3-arm2.dtb imx6ull-14x14-ddr3-arm2-adc.dtb imx6ull-14x14-ddr3-arm2-cs42888.dtb \
                     imx6ull-14x14-ddr3-arm2-ecspi.dtb imx6ull-14x14-ddr3-arm2-emmc.dtb imx6ull-14x14-ddr3-arm2-epdc.dtb \
                     imx6ull-14x14-ddr3-arm2-flexcan2.dtb imx6ull-14x14-ddr3-arm2-gpmi-weim.dtb imx6ull-14x14-ddr3-arm2-lcdif.dtb \
                     imx6ull-14x14-ddr3-arm2-ldo.dtb imx6ull-14x14-ddr3-arm2-qspi.dtb imx6ull-14x14-ddr3-arm2-qspi-all.dtb \
                     imx6ull-14x14-ddr3-arm2-tsc.dtb \
                     imx6ull-14x14-ddr3-arm2-uart2.dtb imx6ull-14x14-ddr3-arm2-usb.dtb imx6ull-14x14-ddr3-arm2-wm8958.dtb \
"

UBOOT_CONFIG ??= "sd"
UBOOT_CONFIG[sd] = "mx6ull_14x14_ddr3_arm2_config,sdcard"
UBOOT_CONFIG[emmc] = "mx6ull_14x14_ddr3_arm2_emmc_config,sdcard"
UBOOT_CONFIG[epdc] = "mx6ull_14x14_ddr3_arm2_epdc_config,sdcard"
UBOOT_CONFIG[nand] = "mx6ull_14x14_ddr3_arm2_nand_config,ubifs"
UBOOT_CONFIG[qspi1] = "mx6ull_14x14_ddr3_arm2_qspi1_config"
UBOOT_CONFIG[spinor] = "mx6ull_14x14_ddr3_arm2_spinor_config"
UBOOT_CONFIG[tsc] = "mx6ull_14x14_ddr3_arm2_tsc_config"
UBOOT_CONFIG[mfgtool] = "mx6ull_14x14_ddr3_arm2_config"
```

## imx/meta-bsp/conf/machine/imx6ull14x14evk.conf
```bitbake
#@TYPE: Machine
#@NAME: NXP i.MX6ULL 14x14 Evaluation Kit
#@SOC: i.MX6ULL
#@DESCRIPTION: Machine configuration for NXP i.MX6ULL 14x14 EVK
#@MAINTAINER: Lauren Post <lauren.post@nxp.com>

MACHINEOVERRIDES =. "mx6:mx6ul:mx6ull:"

include conf/machine/include/imx-base.inc
include conf/machine/include/tune-cortexa7.inc

MACHINE_FIRMWARE_append = " firmware-imx-epdc"

KERNEL_DEVICETREE = "imx6ull-14x14-evk.dtb imx6ull-14x14-evk-btwifi.dtb \
                     imx6ull-14x14-evk-btwifi-oob.dtb imx6ull-14x14-evk-emmc.dtb \
                     imx6ull-14x14-evk-gpmi-weim.dtb imx6ull-14x14-evk-usb-certi.dtb \
"

MACHINE_FEATURES_append = " optee bcm4339 bcm43455"

UBOOT_CONFIG ??= "${@bb.utils.contains('COMBINED_FEATURES', 'optee', 'sd-optee', 'sd', d)}"
UBOOT_CONFIG[sd] = "mx6ull_14x14_evk_config,sdcard"
UBOOT_CONFIG[emmc] = "mx6ull_14x14_evk_emmc_config,sdcard"
UBOOT_CONFIG[nand] = "mx6ull_14x14_evk_nand_config,ubifs"
UBOOT_CONFIG[qspi1] = "mx6ull_14x14_evk_qspi1_config"
UBOOT_CONFIG[mfgtool] = "mx6ull_14x14_evk_config"
UBOOT_CONFIG[sd-optee] = "mx6ull_14x14_evk_optee_config,sdcard"

OPTEE_BIN_EXT = "6ullevk"
```

## imx/meta-bsp/conf/machine/imx6ull9x9evk.conf
```bitbake
#@TYPE: Machine
#@NAME: Freescale i.MX6ULL 9x9 Evaluation Kit
#@SOC: i.MX6ULL
#@DESCRIPTION: Machine configuration for Freescale i.MX6ULL 9x9 EVK

include conf/machine/include/imx-base.inc
include conf/machine/include/tune-cortexa7.inc
include conf/machine/include/imx6ul-common.inc

MACHINE_FIRMWARE_append = " firmware-imx-epdc firmware-imx-brcm"

SOC_FAMILY = "mx6ul:mx6ull"

KERNEL_DEVICETREE = "imx6ull-9x9-evk.dtb imx6ull-9x9-evk-btwifi.dtb \
"

UBOOT_CONFIG ??= "sd"
UBOOT_CONFIG[sd] = "mx6ull_9x9_evk_config,sdcard"
UBOOT_CONFIG[qspi1] = "mx6ull_9x9_evk_qspi1_config"
UBOOT_CONFIG[mfgtool] = "mx6ull_9x9_evk_config"
```

## imx/meta-bsp/conf/machine/imx6ulz14x14evk.conf
```bitbake
#@TYPE: Machine
#@NAME: NXP i.MX6ULZ 14x14 Evaluation Kit
#@SOC: i.MX6ULZ
#@DESCRIPTION: Machine configuration for NXP i.MX6ULZ 14x14 EVK
#@MAINTAINER: Jun Zhu <junzhu@nxp.com>

MACHINEOVERRIDES =. "mx6:mx6ul:mx6ull:mx6ulz:"

include conf/machine/include/imx-base.inc
include conf/machine/include/tune-cortexa7.inc

MACHINE_FIRMWARE_append = " firmware-imx-epdc"

KERNEL_DEVICETREE = "imx6ulz-14x14-evk.dtb \
"

UBOOT_CONFIG[sd] = "mx6ulz_14x14_evk_config,sdcard"
UBOOT_CONFIG[mfgtool] = "mx6ulz_14x14_evk_config"
```
