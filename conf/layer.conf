## imx/meta-bsp/conf/machine/imx6qdlsolo.conf
```bitbake
#@TYPE: Machine
#@NAME: Freescale i.MX Common rootfs machine for mfg tools
#@SOC: i.MX6 Quad Dual and Solo Rootfs

#@DESCRIPTION: Machine configuration for Freescale i.MX 6 and 7  boards

# Consolidated rootfs to support i.MX 6 QuadPlus, Quad, Dual and Solo SoC
# Removing SoloLite and SoloX which will not be supported on this rootfs

require conf/machine/include/imx6sabresd-common.inc

SOC_FAMILY = "mx6:mx6q"

# Add in DQ and DL device trees
KERNEL_DEVICETREE = "imx6q-sabresd.dtb imx6q-sabresd-btwifi.dtb imx6q-sabresd-enetirq.dtb \
                     imx6q-sabresd-hdcp.dtb imx6q-sabresd-ldo.dtb"
KERNEL_DEVICETREE += "imx6q-sabreauto.dtb imx6q-sabreauto-ecspi.dtb imx6q-sabreauto-enetirq.dtb \
                     imx6q-sabreauto-flexcan1.dtb imx6q-sabreauto-gpmi-weim.dtb"
KERNEL_DEVICETREE += "imx6qp-sabreauto.dtb imx6qp-sabreauto-ecspi.dtb imx6qp-sabreauto-flexcan1.dtb \
                     imx6qp-sabreauto-gpmi-weim.dtb"
KERNEL_DEVICETREE += "imx6qp-sabresd.dtb imx6qp-sabresd-btwifi.dtb imx6qp-sabresd-hdcp.dtb \
                     imx6qp-sabresd-ldo.dtb"
KERNEL_DEVICETREE += "imx6dl-sabreauto.dtb imx6dl-sabreauto-ecspi.dtb imx6dl-sabreauto-enetirq.dtb \
                     imx6dl-sabreauto-flexcan1.dtb imx6dl-sabreauto-gpmi-weim.dtb"
KERNEL_DEVICETREE += "imx6dl-sabresd.dtb imx6dl-sabresd-btwifi.dtb imx6dl-sabresd-enetirq.dtb"
KERNEL_DEVICETREE += "imx6dl-sabresd-hdcp.dtb imx6dl-sabresd-ldo.dtb"


UBOOT_MACHINE = "mx6qsabresd_config"

# build all vpu firmware packages into the image
MACHINE_FIRMWARE_append_mx6 = " firmware-imx-vpu-imx6q firmware-imx-vpu-imx6d firmware-imx-epdc"

BOOT_SPACE = "32768"
```

## imx/meta-bsp/conf/machine/imx6qpdlsolox.conf
```bitbake
#@TYPE: Machine
#@NAME: i.MX 6 Combined Machine
#@SOC: i.MX6 Quad, Dual, Solo, and SoloX
#@DESCRIPTION: A combined machine for i.MX 6 and 7 testing and mfg tools, see comment below
#@MAINTAINER: Jun Zhu <junzhu@nxp.com>

#        ** WARNING - THIS MACHINE IS FOR TEST OR MFG TOOLS ONLY **
# The resulting image will contain the 6Q SabreSD u-boot, kernel, and rootfs, plus the DTBs for all
# i.MX 6QP, 6DL, and 6SX boards. The image can be used on other boards by replacing the u-boot
# image, but please note that certain application functionality will not work depending on the
# capabilities of the board.

MACHINEOVERRIDES =. "mx6:mx6q:"

include conf/machine/include/imx6sabresd-common.inc

# Add in QP DL and SoloX device trees
KERNEL_DEVICETREE = "imx6q-sabresd.dtb imx6q-sabresd-btwifi.dtb imx6q-sabresd-enetirq.dtb \
                     imx6q-sabresd-hdcp.dtb imx6q-sabresd-ldo.dtb"
KERNEL_DEVICETREE += "imx6q-sabreauto.dtb imx6q-sabreauto-ecspi.dtb imx6q-sabreauto-enetirq.dtb \
                     imx6q-sabreauto-flexcan1.dtb imx6q-sabreauto-gpmi-weim.dtb"
KERNEL_DEVICETREE += "imx6qp-sabreauto.dtb imx6qp-sabreauto-ecspi.dtb imx6qp-sabreauto-flexcan1.dtb \
                     imx6qp-sabreauto-gpmi-weim.dtb"
KERNEL_DEVICETREE += "imx6qp-sabresd.dtb imx6qp-sabresd-btwifi.dtb imx6qp-sabresd-hdcp.dtb \
                     imx6qp-sabresd-ldo.dtb imx6qp-sabresd-ldo-pcie-cert.dtb"
KERNEL_DEVICETREE += "imx6dl-sabreauto.dtb imx6dl-sabreauto-ecspi.dtb imx6dl-sabreauto-enetirq.dtb \
                     imx6dl-sabreauto-flexcan1.dtb imx6dl-sabreauto-gpmi-weim.dtb"
KERNEL_DEVICETREE += "imx6dl-sabresd.dtb imx6dl-sabresd-btwifi.dtb imx6dl-sabresd-enetirq.dtb"
KERNEL_DEVICETREE += "imx6dl-sabresd-hdcp.dtb imx6dl-sabresd-ldo.dtb"
KERNEL_DEVICETREE += "imx6sx-sdb.dtb imx6sx-sdb-btwifi.dtb imx6sx-sdb-emmc.dtb \
                     imx6sx-sdb-lcdif1.dtb imx6sx-sdb-ldo.dtb imx6sx-sdb-m4.dtb \
                     imx6sx-sdb-mqs.dtb imx6sx-sdb-reva-ldo.dtb imx6sx-sdb-reva.dtb \
                     imx6sx-sdb-sai.dtb"
KERNEL_DEVICETREE += "imx6sx-sabreauto.dtb imx6sx-sabreauto-m4.dtb"

MACHINE_FEATURES_append = " optee"

UBOOT_CONFIG ??= "${@bb.utils.contains('COMBINED_FEATURES', 'optee', 'sd-optee', 'sd', d)}"
UBOOT_CONFIG[sd] = "mx6qsabresd_config,sdcard"
UBOOT_CONFIG[sata] = "mx6qsabresd_sata_config"
UBOOT_CONFIG[mfgtool] = "mx6qsabresd_config"
UBOOT_CONFIG[sd-optee] = "mx6qsabresd_optee_config,sdcard"

# build all vpu firmware packages into the image
MACHINE_FIRMWARE_append_mx6 = " firmware-imx-vpu-imx6q firmware-imx-vpu-imx6d firmware-imx-epdc"

OPTEE_BIN_EXT = "6qsdb"
```

## imx/meta-bsp/conf/machine/imx6qpsabresd.conf
```bitbake
#@TYPE: Machine
#@NAME: Freescale i.MX6Q Plus SABRE Smart Device
#@SOC: i.MX6QP
#@DESCRIPTION: Machine configuration for Freescale i.MX6QP SABRE Smart Device
#@MAINTAINER: Lauren Post <lauren.post@freescale.com>

require conf/machine/include/imx6sabresd-common.inc

SOC_FAMILY = "mx6:mx6q:mx6qp"

KERNEL_DEVICETREE = "imx6qp-sabresd.dtb imx6qp-sabresd-ldo.dtb"

UBOOT_CONFIG ??= "sd"
UBOOT_CONFIG[sd] = "mx6qsabresd_config,sdcard"
UBOOT_CONFIG[sata] = "mx6qsabresd_sata_config"
UBOOT_CONFIG[mfgtool] = "mx6qsabresd_config"
```

## imx/meta-bsp/conf/machine/imx6slevk.conf
```bitbake
#@TYPE: Machine
#@NAME: NXP i.MX6SL Evaluation Kit
#@SOC: i.MX6SL
#@DESCRIPTION: Machine configuration for NXP i.MX6SL Evaluation Kit
#@MAINTAINER: Otavio Salvador <otavio@ossystems.com.br>

MACHINEOVERRIDES =. "mx6:mx6sl:"

include conf/machine/include/imx-base.inc
include conf/machine/include/tune-cortexa9.inc

KERNEL_DEVICETREE = "imx6sl-evk.dtb imx6sl-evk-csi.dtb imx6sl-evk-ldo.dtb \
                     imx6sl-evk-uart.dtb imx6sl-evk-btwifi.dtb"

MACHINE_FEATURES += " pci wifi bluetooth optee bcm4339 bcm43455"

UBOOT_CONFIG ??= "${@bb.utils.contains('COMBINED_FEATURES', 'optee', 'sd-optee', 'sd', d)}"
UBOOT_CONFIG[sd] = "mx6slevk_config,sdcard"
UBOOT_CONFIG[epdc] = "mx6slevk_epdc_config"
UBOOT_CONFIG[spinor] = "mx6slevk_spinor_config"
UBOOT_CONFIG[mfgtool] = "mx6slevk_config"
UBOOT_CONFIG[sd-optee] = "mx6slevk_optee_config,sdcard"

OPTEE_BIN_EXT = "6slevk"

SERIAL_CONSOLES = "115200;ttymxc0"

MACHINE_FIRMWARE += "linux-firmware-ath6k firmware-imx-epdc"
```

## imx/meta-bsp/conf/machine/imx6sll_all.conf
```bitbake
#@TYPE: Machine
#@NAME: NXP i.MX6SLL Consolidated
#@SOC: i.MX6SLL
#@DESCRIPTION: Machine configuration for NXP i.MX6SLL Consolidated image

MACHINEOVERRIDES =. "mx6:mx6sll:"

include conf/machine/include/imx-base.inc
include conf/machine/include/tune-cortexa9.inc

MACHINE_FIRMWARE_append = " firmware-imx-epdc"

KERNEL_DEVICETREE = "imx6sll-evk.dtb imx6sll-evk-btwifi.dtb"
KERNEL_DEVICETREE += "imx6sll-evk-reva.dtb"
KERNEL_DEVICETREE += "imx6sll-lpddr2-arm2.dtb"
KERNEL_DEVICETREE += "imx6sll-lpddr3-arm2.dtb imx6sll-lpddr3-arm2-csi.dtb imx6sll-lpddr3-arm2-ecspi.dtb"
KERNEL_DEVICETREE += "imx6sll-lpddr3-arm2-spdif.dtb"

UBOOT_CONFIG ??= "sd"
UBOOT_CONFIG[sd] = "mx6sllevk_config,sdcard"
UBOOT_CONFIG[mfgtool] = "mx6sllevk_config"

SERIAL_CONSOLE = "115200 ttymxc0"

MACHINE_FEATURES += " pci wifi bluetooth"

DEFAULTTUNE_mx6sll ?= "cortexa9hf-neon"

# mx6 GPU libraries
PREFERRED_PROVIDER_virtual/egl_mx6sll = "mesa"
PREFERRED_PROVIDER_virtual/libgles1_mx6sll = "mesa"
PREFERRED_PROVIDER_virtual/libgles2_mx6sll = "mesa"
PREFERRED_PROVIDER_virtual/libgl_mx6sll = "mesa"
PREFERRED_PROVIDER_virtual/libg2d_mx6sll = ""

# MESA DRI library
XSERVER += "mesa-driver-swrast"

MACHINE_SOCARCH_FILTER_mx6sll = "imx-codec imx-parser"

UBOOT_ENTRYPOINT_mx6sll = "0x80008000"
MACHINE_SOCARCH_SUFFIX_mx6sll= "-mx6sll"
IMX_DEFAULT_KERNEL_mx6sll = "linux-imx"

SDCARD_GENERATION_COMMAND_mx6sll = "generate_imx_sdcard"
BOOT_SPACE = "32768"
```

## imx/meta-bsp/conf/machine/imx6sllevk.conf
```bitbake
#@TYPE: Machine
#@NAME: NXP i.MX6SLL Evaluation Kit
#@SOC: i.MX6SLL
#@DESCRIPTION: Machine configuration for NXP i.MX6SLL EVK

MACHINEOVERRIDES =. "mx6:mx6sll:"

include conf/machine/include/imx-base.inc
include conf/machine/include/tune-cortexa9.inc

MACHINE_FIRMWARE_append = " firmware-imx-epdc"

KERNEL_DEVICETREE = "imx6sll-evk.dtb imx6sll-evk-btwifi.dtb"
KERNEL_DEVICETREE += "imx6sll-evk-reva.dtb"

MACHINE_FEATURES += " pci wifi bluetooth optee bcm4339 bcm43455"

UBOOT_CONFIG ??= "${@bb.utils.contains('COMBINED_FEATURES', 'optee', 'sd-optee', 'sd', d)}"
UBOOT_CONFIG[sd] = "mx6sllevk_config,sdcard"
UBOOT_CONFIG[epdc] = "mx6sllevk_epdc_config"
UBOOT_CONFIG[mfgtool] = "mx6sllevk_config"
UBOOT_CONFIG[sd-optee] = "mx6sllevk_optee_config,sdcard"

OPTEE_BIN_EXT = "6sllevk"

SERIAL_CONSOLES = "115200;ttymxc0"

# MESA DRI library
XSERVER += "mesa-driver-swrast"
```

## imx/meta-bsp/conf/machine/imx6sx14x14arm2.conf
```bitbake
#@TYPE: Machine
#@NAME: NXP i.MX6SX 14x14 lpddr2 arm2 board
#@SOC: i.MX6SX
#@DESCRIPTION: Machine configuration for NXP i.MX6SX 14x14 lpddr2 arm2 board
#@MAINTAINER: Lauren Post <lauren.post@nxp.com>

MACHINEOVERRIDES =. "mx6:mx6sx:"

include conf/machine/include/imx-base.inc
include conf/machine/include/tune-cortexa9.inc

KERNEL_DEVICETREE = "imx6sx-14x14-arm2.dtb"

UBOOT_CONFIG ??= "sd"
UBOOT_CONFIG[sd] = "mx6sx_14x14_lpddr2_arm2_config,sdcard"
UBOOT_CONFIG[nand] = "mx6sx_14x14_lpddr2_arm2_nand_config,ubifs"
```

## imx/meta-bsp/conf/machine/imx6sx17x17arm2.conf
```bitbake
#@TYPE: Machine
#@NAME: NXP i.MX6SX 17x17 arm2 board
#@SOC: i.MX6SX
#@DESCRIPTION: Machine configuration for NXP i.MX6SX 17x17 arm2 board
#@MAINTAINER: Lauren Post <lauren.post@nxp.com>

MACHINEOVERRIDES =. "mx6:mx6sx:"

include conf/machine/include/imx-base.inc
include conf/machine/include/tune-cortexa9.inc

KERNEL_DEVICETREE = "imx6sx-17x17-arm2.dtb imx6sx-17x17-arm2-ecspi.dtb imx6sx-17x17-arm2-mlb.dtb \
                    imx6sx-17x17-arm2-sai.dtb imx6sx-17x17-arm2-spdif.dtb imx6sx-17x17-arm2-ssi.dtb \
                    imx6sx-17x17-arm2-gpmi-weim.dtb"

UBOOT_CONFIG ??= "sd"
UBOOT_CONFIG[sd] = "mx6sx_17x17_arm2_config,sdcard"
UBOOT_CONFIG[qspi2] = "mx6sx_17x17_arm2_qspi2_config"
UBOOT_CONFIG[spinor] = "mx6sx_17x17_arm2_spinor_config"
UBOOT_CONFIG[nand] = "mx6sx_17x17_arm2_nand_config,ubifs"
UBOOT_CONFIG[eimnor] = "mx6sx_17x17_arm2_eimnor_config"
```

## imx/meta-bsp/conf/machine/imx6sx19x19ddr3arm2.conf
```bitbake
#@TYPE: Machine
#@NAME: NXP i.MX6SX 19x19 DDR3 ARM2 board
#@SOC: i.MX6SX
#@DESCRIPTION: Machine configuration for NXP i.MX6SX DDR3 ARM2 Board

MACHINEOVERRIDES =. "mx6:mx6sx:"

include conf/machine/include/imx-base.inc
include conf/machine/include/tune-cortexa9.inc

KERNEL_DEVICETREE = "imx6sx-19x19-arm2.dtb imx6sx-19x19-arm2-csi.dtb imx6sx-19x19-arm2-ldo.dtb"

UBOOT_CONFIG ??= "sd"
UBOOT_CONFIG[sd] = "mx6sx_19x19_ddr3_arm2_config,sdcard"
UBOOT_CONFIG[qspi2] = "mx6sx_19x19_ddr3_arm2_qspi2_config"
UBOOT_CONFIG[spinor] = "mx6sx_19x19_ddr3_arm2_spinor_config"
UBOOT_CONFIG[nand] = "mx6sx_19x19_ddr3_arm2_nand_config,ubifs"
UBOOT_CONFIG[eimnor] = "mx6sx_19x19_ddr3_arm2_eimnor_config"
```

## imx/meta-bsp/conf/machine/imx6sx_all.conf
```bitbake
#@TYPE: Machine
#@NAME: Freescale i.MX6SoloX Consolidated
#@SOC: i.MX6SX
#@DESCRIPTION: Machine configuration for Freescale i.MX6SoloX Consolidated image
#@MAINTAINER: Lauren Post <Lauren.Post@freescale.com>

require conf/machine/include/imx6sabresd-common.inc

SOC_FAMILY = "mx6:mx6sx"

KERNEL_DEVICETREE = "imx6sx-sdb.dtb imx6sx-sdb-btwifi.dtb imx6sx-sdb-emmc.dtb \
                     imx6sx-sdb-lcdif1.dtb imx6sx-sdb-ldo.dtb imx6sx-sdb-m4.dtb \
                     imx6sx-sdb-mqs.dtb imx6sx-sdb-reva-ldo.dtb imx6sx-sdb-reva.dtb \
                     imx6sx-sdb-sai.dtb \
                     imx6sx-sabreauto.dtb imx6sx-sabreauto-m4.dtb \
                     imx6sx-14x14-arm2.dtb \
                     imx6sx-19x19-arm2.dtb imx6sx-19x19-arm2-csi.dtb imx6sx-19x19-arm2-ldo.dtb"

UBOOT_MACHINE = "mx6sxsabresd_config"
```

## imx/meta-bsp/conf/machine/imx6sxsabreauto.conf
```bitbake
#@TYPE: Machine
#@NAME: NXP i.MX6SoloX Sabre Automotive
#@SOC: i.MX6SX
#@DESCRIPTION: Machine configuration for NXP i.MX6SoloX Sabre Automotive
#@MAINTAINER: Lauren Post <Lauren.Post@nxp.com>

MACHINEOVERRIDES =. "mx6:mx6sx:"

require conf/machine/include/imx6sabreauto-common.inc

KERNEL_DEVICETREE = "imx6sx-sabreauto.dtb imx6sx-sabreauto-m4.dtb"

PREFERRED_PROVIDER_u-boot = "u-boot-imx"
PREFERRED_PROVIDER_virtual/bootloader = "u-boot-imx"

MACHINE_FEATURES_append = " optee"

UBOOT_CONFIG ??= "${@bb.utils.contains('COMBINED_FEATURES', 'optee', 'sd-optee', 'sd', d)}"
UBOOT_CONFIG[sd] = "mx6sxsabreauto_config,sdcard"
UBOOT_CONFIG[qspi1] = "mx6sxsabreauto_qspi1_config"
UBOOT_CONFIG[nand] = "mx6sxsabreauto_nand_config,ubifs"
UBOOT_CONFIG[mfgtool] = "mx6sxsabreauto_config"
UBOOT_CONFIG[sd-optee] = "mx6sxsabreauto_optee_config,sdcard"

OPTEE_BIN_EXT = "6sxauto"
```

## imx/meta-bsp/conf/machine/imx6ul14x14ddr3arm2.conf
```bitbake
#@TYPE: Machine
#@NAME: Freescale i.MX6UL 14x14 DDR3 ARM2 Evaluation Kit
#@SOC: i.MX6UL
#@DESCRIPTION: Machine configuration for Freescale i.MX6UL 14x14 DDR3 ARM2 EVK
#@MAINTAINER: Lauren Post <lauren.post@freescale.com>

include conf/machine/include/imx-base.inc
include conf/machine/include/tune-cortexa7.inc
include conf/machine/include/imx6ul-common.inc

SOC_FAMILY = "mx6ul"

KERNEL_DEVICETREE = "imx6ul-14x14-ddr3-arm2.dtb \
                    imx6ul-14x14-ddr3-arm2-mqs.dtb imx6ul-14x14-ddr3-arm2-spdif.dtb \
                    imx6ul-14x14-ddr3-arm2-wm8958.dtb imx6ul-14x14-ddr3-arm2-gpmi-weim.dtb \
                    imx6ul-14x14-ddr3-arm2-emmc.dtb imx6ul-14x14-ddr3-arm2-flexcan2.dtb"

UBOOT_CONFIG ??= "sd"
UBOOT_CONFIG[sd] = "mx6ul_14x14_ddr3_arm2_config,sdcard"
UBOOT_CONFIG[eimnor] = "mx6ul_14x14_ddr3_arm2_eimnor_config"
UBOOT_CONFIG[emmc] = "mx6ul_14x14_ddr3_arm2_emmc_config,sdcard"
UBOOT_CONFIG[nand] = "mx6ul_14x14_ddr3_arm2_nand_config,ubifs"
UBOOT_CONFIG[spinor] = "mx6ul_14x14_ddr3_arm2_spinor_config"
UBOOT_CONFIG[qspi1] = "mx6ul_14x14_ddr3_arm2_qspi1_config"
UBOOT_CONFIG[mfgtool] = "mx6ul_14x14_ddr3_arm2_config"
```

## imx/meta-bsp/conf/machine/imx6ul14x14lpddr2arm2.conf
```bitbake
#@TYPE: Machine
#@NAME: Freescale i.MX6UL 14x14 LPDDR2 ARM2 Evaluation Kit
#@SOC: i.MX6UL
#@DESCRIPTION: Machine configuration for Freescale i.MX6UL 14x14 LPDDR2 ARM2 EVK
#@MAINTAINER: Lauren Post <lauren.post@freescale.com>

include conf/machine/include/imx-base.inc
include conf/machine/include/tune-cortexa7.inc
include conf/machine/include/imx6ul-common.inc

SOC_FAMILY = "mx6ul"

KERNEL_DEVICETREE = "imx6ul-14x14-lpddr2-arm2.dtb"

UBOOT_CONFIG ??= "sd"
UBOOT_CONFIG[sd] = "mx6ul_14x14_lpddr2_arm2_config,sdcard"
UBOOT_CONFIG[eimnor] = "mx6ul_14x14_lpddr2_arm2_eimnor_config"
UBOOT_CONFIG[mfgtool] = "mx6ul_14x14_lpddr2_arm2_config"
```
