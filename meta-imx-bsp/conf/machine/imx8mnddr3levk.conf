## meta-imx-bsp/conf/machine/imx8mnddr3levk.conf
```bitbake
# DEPRECATED: Machine is renamed, please use imx8mnul-ddr3l-evk
MACHINEOVERRIDES =. "imx8mnul-ddr3l-evk:"
require conf/machine/imx8mnul-ddr3l-evk.conf

IMAGE_BOOT_FILES:append = " \
    mcore-demos/imx8mnddr3l_m7_DDR_hello_world.bin \
    mcore-demos/imx8mnddr3l_m7_DDR_rpmsg_lite_pingpong_rtos_linux_remote.bin \
    mcore-demos/imx8mnddr3l_m7_DDR_rpmsg_lite_str_echo_rtos.bin \
    mcore-demos/imx8mnddr3l_m7_DDR_sai_low_power_audio.bin \
"
```

## meta-imx-bsp/conf/machine/imx93-11x11-lpddr4x-frdm.conf
```bitbake
#@TYPE: Machine
#@NAME: NXP i.MX 93 11x11 FRDM with LPDDR4X
#@SOC: i.MX93
#@DESCRIPTION: Machine configuration for NXP i.MX 93 11x11 FRDM with LPDDR4X
#@MAINTAINER: Lei Xu <lei.xu@nxp.com>

require conf/machine/include/imx93-evk.inc

KERNEL_DEVICETREE_BASENAME = "imx93-11x11-frdm"

KERNEL_DEVICETREE:append:use-nxp-bsp = " \
    freescale/${KERNEL_DEVICETREE_BASENAME}-8mic-reve.dtb \
    freescale/${KERNEL_DEVICETREE_BASENAME}-aud-hat.dtb \
    freescale/${KERNEL_DEVICETREE_BASENAME}-ld.dtb \
    freescale/${KERNEL_DEVICETREE_BASENAME}-lpuart.dtb \
    freescale/${KERNEL_DEVICETREE_BASENAME}-mt9m114.dtb \
    freescale/${KERNEL_DEVICETREE_BASENAME}-ov5640.dtb \
    freescale/${KERNEL_DEVICETREE_BASENAME}-tianma-wvga-panel.dtb \
    freescale/${KERNEL_DEVICETREE_BASENAME}-waveshare-7inch-c-panel.dtb \
 "

UBOOT_CONFIG_BASENAME = "imx93_11x11_frdm"

DDR_FIRMWARE_NAME = " \
    lpddr4_dmem_1d_v202201.bin \
    lpddr4_dmem_2d_v202201.bin \
    lpddr4_imem_1d_v202201.bin \
    lpddr4_imem_2d_v202201.bin \
"
```

## meta-imx-bsp/conf/machine/include/imx-base-extend.inc
```bitbake
# This file is included from meta-freescale/conf/machine/include/imx-base.inc
# and provides a simple mechanism to override settings in the file

IMX_DEFAULT_BSP = "nxp"

# The default bootloader and kernel set in meta-freescale is for fslc
IMX_DEFAULT_BOOTLOADER:imx-nxp-bsp = "u-boot-imx"
IMX_DEFAULT_KERNEL:imx-nxp-bsp     = "linux-imx"

# IMXBOOT_VARIANT infrastructure
IMXBOOT_VARIANT  ?= ""
IMXBOOT_VARIANTS ?= "NONE"
BOOT_VARIANT = "${@bb.utils.contains_any('IMXBOOT_VARIANT', '${IMXBOOT_VARIANTS}', '-variant-${IMXBOOT_VARIANT}', '', d)}"

MACHINEOVERRIDES_EXTENDER_FILTER_OUT += "mx8mpul mx93w mx952"

# Add new Soc i.MX 93W
MACHINEOVERRIDES_EXTENDER:mx93w:use-nxp-bsp  = "mx93w-generic-bsp:mx93w-nxp-bsp"

# Add new Soc i.MX 952
MACHINEOVERRIDES_EXTENDER:mx952:use-nxp-bsp  = "imx-generic-bsp:imx-nxp-bsp:imxdrm:imxdpu:imxgpu:imxmali:imxgpu2d:imxgpu3d:mx9-generic-bsp:mx9-nxp-bsp:mx95-generic-bsp:mx95-nxp-bsp:mx952-generic-bsp:mx952-nxp-bsp"
MACHINE_SOCARCH_SUFFIX:mx952-nxp-bsp = "-mx952"
SECO_FIRMWARE_NAME:mx952-generic-bsp ?= "mx952${IMX_SOC_REV_LOWER}-ahab-container.img"
IMX_SOC_REV:mx952-generic-bsp   ??= "A0"
IMX_EXTRA_FIRMWARE:mx952-nxp-bsp = "imx-boot-firmware-files firmware-ele-imx virtual/imx-system-manager virtual/imx-oei"
PREFERRED_VERSION_imx-m7-demos:mx952-nxp-bsp = "25.12.00"

# Add new SoC i.MX 943
IMX_SOC_REV:mx943-generic-bsp ?= "A1"
MACHINEOVERRIDES_EXTENDER:mx943:use-nxp-bsp  = "imx-generic-bsp:imx-nxp-bsp:imxdrm:imxpxp:mx9-generic-bsp:mx9-nxp-bsp:mx94-generic-bsp:mx94-nxp-bsp:mx943-generic-bsp:mx943-nxp-bsp"
MACHINE_SOCARCH_SUFFIX:mx943-nxp-bsp = "-mx943"
IMX_EXTRA_FIRMWARE:mx943-nxp-bsp = "imx-boot-firmware-files firmware-ele-imx virtual/imx-system-manager virtual/imx-oei"
SECO_FIRMWARE_NAME:mx943-nxp-bsp ?= "mx943a1-ahab-container.img mx943a0-ahab-container.img"
PREFERRED_PROVIDER_virtual/libg2d:mx943-nxp-bsp ?= "imx-pxp-g2d"

# Update i.MX 95
IMX_SOC_REV:mx95-generic-bsp ?= "B0"
IMX_EXTRA_FIRMWARE:mx95-nxp-bsp = "imx-boot-firmware-files firmware-ele-imx virtual/imx-system-manager virtual/imx-oei"
# The System Manager Firmware Name corresponds to a particular binary implementation
# in the Yocto deploy folder. The default name is comprised of the Firmware Basename
# and the default system manager Config name, e.g., m33_image-mx95evk.bin and
# m33_image-mx95evk_fusa.bin for the standard BSP version and FuSa version, respectively
SYSTEM_MANAGER_FIRMWARE_NAME                  ?= "${SYSTEM_MANAGER_FIRMWARE_BASENAME}-${SYSTEM_MANAGER_CONFIG}"
# The System Manager Firmware Basename is an alias used by imx-boot instead of using
# a unique name for each implementation, e.g., m33_image.bin for i.MX 95
SYSTEM_MANAGER_FIRMWARE_BASENAME              ?= "INVALID"
SYSTEM_MANAGER_FIRMWARE_BASENAME:mx95-nxp-bsp ?= "m33_image"
SYSTEM_MANAGER_FIRMWARE_BASENAME:mx952-nxp-bsp ?= "m33_image"

# Add new machine i.MX 8M Plus UltraLite
MACHINEOVERRIDES_EXTENDER:mx8mpul:use-nxp-bsp = "imx-generic-bsp:imx-nxp-bsp:imxfbdev:mx8-generic-bsp:mx8-nxp-bsp:mx8m-generic-bsp:mx8m-nxp-bsp:mx8mpul-generic-bsp:mx8mpul-nxp-bsp"
MACHINEOVERRIDES_EXTENDER:mx8mpul:use-mainline-bsp = "imx-generic-bsp:imx-mainline-bsp:mx8-generic-bsp:mx8-mainline-bsp:mx8m-generic-bsp:mx8m-mainline-bsp:mx8mpul-generic-bsp:mx8mpul-mainline-bsp"
MACHINE_SOCARCH_SUFFIX:mx8mpul-nxp-bsp = "-mx8mpul"

# ELE extra/runtime firmware, to be installed and accessed from userspace.
# Note that multiple names can be given in order to install multiple versions
# to a single rootfs.
SECOEXT_FIRMWARE_NAME                     = ""
SECOEXT_FIRMWARE_NAME:mx8ulp-generic-bsp ?= "mx8ulp${IMX_SOC_REV_LOWER}ext-ahab-container.img"
SECOEXT_FIRMWARE_NAME:mx95-generic-bsp   ?= "mx95a0runtime-ahab-container.img mx95b0runtime-ahab-container.img"
SECOEXT_FIRMWARE_NAME:mx952-generic-bsp  ?= "mx952${IMX_SOC_REV_LOWER}runtime-ahab-container.img"
SECOEXT_FIRMWARE_NAME:mx943-nxp-bsp  ?= "mx943a0runtime-ahab-container.img mx943a1runtime-ahab-container.img"

# Set preferred OpenCL ICD runtime
PREFERRED_RPROVIDER_virtual-opencl-icd         ?= "libopencl-mesa"
PREFERRED_RPROVIDER_virtual-opencl-icd:imxviv  ?= "libopencl-imx"
PREFERRED_RPROVIDER_virtual-opencl-icd:imxmali ?= "mali-imx-opencl-icd"

# GStreamer forked recipes
PREFERRED_VERSION_gstreamer1.0:imx-nxp-bsp              ??= "1.28.1.imx"
PREFERRED_VERSION_gstreamer1.0-plugins-bad:imx-nxp-bsp  ??= "1.28.1.imx"
PREFERRED_VERSION_gstreamer1.0-plugins-base:imx-nxp-bsp ??= "1.28.1.imx"
PREFERRED_VERSION_gstreamer1.0-plugins-good:imx-nxp-bsp ??= "1.28.1.imx"

# GStreamer backport recipes
PREFERRED_VERSION_gstreamer1.0-libav:imx-nxp-bsp        ??= "1.28.1"
PREFERRED_VERSION_gst-devtools:imx-nxp-bsp              ??= "1.28.1"
PREFERRED_VERSION_gst-examples:imx-nxp-bsp               ??= "1.28.1"
PREFERRED_VERSION_gstreamer1.0-plugins-ugly:imx-nxp-bsp ??= "1.28.1"
PREFERRED_VERSION_gstreamer1.0-python:imx-nxp-bsp       ??= "1.28.1"
PREFERRED_VERSION_gstreamer1.0-rtsp-server:imx-nxp-bsp  ??= "1.28.1"

# libcamera fork for certain SOCs
PREFERRED_VERSION_libcamera ??= "${PREFERRED_VERSION_LIBCAMERA_IMX}"
PREFERRED_VERSION_LIBCAMERA_IMX                = ""
PREFERRED_VERSION_LIBCAMERA_IMX:mx95-nxp-bsp   = "0.7.1.imx"
PREFERRED_VERSION_LIBCAMERA_IMX:mx8mm-nxp-bsp  = "0.7.1.imx"
PREFERRED_VERSION_LIBCAMERA_IMX:mx8ulp-nxp-bsp = "0.7.1.imx"
PREFERRED_VERSION_LIBCAMERA_IMX:mx8mq-nxp-bsp  = "0.7.1.imx"

PREFERRED_VERSION_weston:imx-nxp-bsp ??= "15.0.1.imx"
# i.MX 6 & 7 stay on weston 10.0 for fbdev
PREFERRED_VERSION_weston:mx6-nxp-bsp ??= "10.0.5.imx"
PREFERRED_VERSION_weston:mx7-nxp-bsp ??= "10.0.5.imx"

PREFERRED_VERSION_wayland-protocols:imx-nxp-bsp ??= ""

PREFERRED_VERSION_libdrm:imx-nxp-bsp ??= "2.4.127.imx"

PREFERRED_VERSION_gfxreconstruct:imxvulkan             ??= "1.3.275.0"

PREFERRED_VERSION_optee-os:imx-nxp-bsp     ??= "4.10.0.imx"
PREFERRED_VERSION_optee-client:imx-nxp-bsp ??= "4.10.0.imx"
PREFERRED_VERSION_optee-test:imx-nxp-bsp   ??= "4.10.0.imx"
PREFERRED_VERSION_optee-os-tadevkit:imx-nxp-bsp   ??= "4.10.0.imx"

PREFERRED_VERSION_opencv:mx8-nxp-bsp ??= "4.13.0.imx"
PREFERRED_VERSION_opencv:mx9-nxp-bsp ??= "4.13.0.imx"

PREFERRED_VERSION_xen-tools = "4.21.imx+stable"
PREFERRED_VERSION_xen       = "4.21.imx+stable"

QEMUVERSION                      ??= "10.2.0"
QEMUVERSION:mx95-nxp-bsp         ??= "10.2.5.imx"
PREFERRED_VERSION_qemu           ??= "${QEMUVERSION}"
PREFERRED_VERSION_qemu-native    ??= "${QEMUVERSION}"
PREFERRED_VERSION_nativesdk-qemu ??= "${QEMUVERSION}"

SOC_DEFAULT_IMAGE_FSTYPES = "wic.bmap wic.zst tar.zst"
ZSTD_COMPRESSION_LEVEL ?= "10"

# ============================================================================
# i.MX Mali GPU Driver Configuration
# ============================================================================
# Driver selection (mali-imx or mesa) for all APIs (GLES, Vulkan, OpenCL)
IMX_MALI_DRIVERS ??= "mali-imx"

# Default driver selection in dual-driver mode (mali-imx or mesa)
IMX_MALI_DEFAULT_DRIVER ??= "mali-imx"

# Detect dual-driver mode
IMX_MALI_DUAL_DRIVER = "0"
IMX_MALI_DUAL_DRIVER:imxmali = "${@'1' if 'mali-imx' in (d.getVar('IMX_MALI_DRIVERS') or '') and 'mesa' in (d.getVar('IMX_MALI_DRIVERS') or '') else '0'}"

# ============================================================================
# Graphics Provider Configuration
# ============================================================================
# Build-time providers - ALL must point to the same recipe to avoid skipping

# Desktop GL provider (mali-imx doesn't provide desktop GL)
PREFERRED_PROVIDER_virtual/libgl:imxgpu3d:imxmali = "${@'mesa' if 'mesa' in (d.getVar('IMX_MALI_DRIVERS') or '') else 'mesa-gl'}"
PREFERRED_PROVIDER_virtual/libgl:imxgpu:imxmali = "${@'mesa' if 'mesa' in (d.getVar('IMX_MALI_DRIVERS') or '') else 'mesa-gl'}"
PREFERRED_PROVIDER_virtual/mesa:imxgpu3d:imxmali = "${@'mesa' if 'mesa' in (d.getVar('IMX_MALI_DRIVERS') or '') else 'mesa-gl'}"
PREFERRED_PROVIDER_virtual/mesa:imxgpu:imxmali = "${@'mesa' if 'mesa' in (d.getVar('IMX_MALI_DRIVERS') or '') else 'mesa-gl'}"

# EGL/GLES/GBM providers - ALL point to mesa when mesa is in driver list
PREFERRED_PROVIDER_virtual/egl:imxgpu3d:imxmali = "${@'mesa' if 'mesa' in (d.getVar('IMX_MALI_DRIVERS') or '') else 'mali-imx'}"
PREFERRED_PROVIDER_virtual/libegl:imxgpu3d:imxmali = "${@'mesa' if 'mesa' in (d.getVar('IMX_MALI_DRIVERS') or '') else 'mali-imx'}"
PREFERRED_PROVIDER_virtual/libgles1:imxgpu3d:imxmali = "${@'mesa' if 'mesa' in (d.getVar('IMX_MALI_DRIVERS') or '') else 'mali-imx'}"
PREFERRED_PROVIDER_virtual/gles1:imxgpu3d:imxmali = "${@'mesa' if 'mesa' in (d.getVar('IMX_MALI_DRIVERS') or '') else 'mali-imx'}"
PREFERRED_PROVIDER_virtual/libgles2:imxgpu3d:imxmali = "${@'mesa' if 'mesa' in (d.getVar('IMX_MALI_DRIVERS') or '') else 'mali-imx'}"
PREFERRED_PROVIDER_virtual/gles2:imxgpu3d:imxmali = "${@'mesa' if 'mesa' in (d.getVar('IMX_MALI_DRIVERS') or '') else 'mali-imx'}"
PREFERRED_PROVIDER_virtual/libgles3:imxgpu3d:imxmali = "${@'mesa' if 'mesa' in (d.getVar('IMX_MALI_DRIVERS') or '') else 'mali-imx'}"
PREFERRED_PROVIDER_virtual/gles3:imxgpu3d:imxmali = "${@'mesa' if 'mesa' in (d.getVar('IMX_MALI_DRIVERS') or '') else 'mali-imx'}"
PREFERRED_PROVIDER_virtual/libgbm:imxgpu3d:imxmali = "${@'mesa' if 'mesa' in (d.getVar('IMX_MALI_DRIVERS') or '') else 'mali-imx'}"
PREFERRED_PROVIDER_virtual/gbm:imxgpu3d:imxmali = "${@'mesa' if 'mesa' in (d.getVar('IMX_MALI_DRIVERS') or '') else 'mali-imx'}"

# Vulkan provider
PREFERRED_PROVIDER_virtual/vulkan-icd:imxgpu3d:imxmali = "${@'mesa' if 'mesa' in (d.getVar('IMX_MALI_DRIVERS') or '') else 'mali-imx'}"
PREFERRED_PROVIDER_virtual/vulkan:imxgpu3d:imxmali = "${@'mesa' if 'mesa' in (d.getVar('IMX_MALI_DRIVERS') or '') else 'mali-imx'}"

# OpenCL provider
PREFERRED_PROVIDER_virtual/opencl-icd:imxgpu3d:imxmali = "${@'mesa' if 'mesa' in (d.getVar('IMX_MALI_DRIVERS') or '') else 'mali-imx'}"
PREFERRED_PROVIDER_virtual/opencl:imxgpu3d:imxmali = "${@'mesa' if 'mesa' in (d.getVar('IMX_MALI_DRIVERS') or '') else 'mali-imx'}"

# Runtime providers - Mesa is preferred in dual-driver mode
PREFERRED_RPROVIDER_virtual-vulkan-icd:imxmali = "${@'mesa-vulkan-drivers' if d.getVar('IMX_MALI_DUAL_DRIVER') == '1' else ''}"
PREFERRED_RPROVIDER_virtual-opencl-icd:imxmali = "${@'libopencl-mesa' if d.getVar('IMX_MALI_DUAL_DRIVER') == '1' else ''}"

MACHINE_EXTRA_RDEPENDS:append:imxmali = " linux-firmware-mali-csffw-arch1012"

BBMASK += "meta-freescale/recipes-graphics/mesa/mesa-gl.bbappend"

PREFERRED_VERSION_mesa         = "26.0.5"
PREFERRED_VERSION_mesa:imxmali = "26.0.5.imx"
```

## meta-imx-bsp/conf/machine/include/imx943-evk.inc
```bitbake
MACHINEOVERRIDES =. "mx943:"

require conf/machine/include/imx-base.inc
require conf/machine/include/arm/armv8-2a/tune-cortexa55.inc

MACHINE_FEATURES += "pci wifi bluetooth"
MACHINE_FEATURES:append:use-nxp-bsp = " optee dpdk nxpiw612-sdio nxp9098-pcie"

KERNEL_DEVICETREE = " \
    freescale/${KERNEL_DEVICETREE_BASENAME}.dtb \
    freescale/${KERNEL_DEVICETREE_BASENAME}-boe-wxga-lvds-panel.dtb \
    freescale/${KERNEL_DEVICETREE_BASENAME}-i2c-spi-slave.dtb \
    freescale/${KERNEL_DEVICETREE_BASENAME}-lpuart.dtb \
    freescale/${KERNEL_DEVICETREE_BASENAME}-mqs.dtb \
    freescale/${KERNEL_DEVICETREE_BASENAME}-pcie1-ep.dtb \
    freescale/${KERNEL_DEVICETREE_BASENAME}-pcie1-ep.dtbo \
    freescale/${KERNEL_DEVICETREE_BASENAME}-rpmsg.dtb \
    freescale/${KERNEL_DEVICETREE_BASENAME}-sgmii.dtb \
    freescale/${KERNEL_DEVICETREE_BASENAME}-sdwifi.dtb \
    freescale/${KERNEL_DEVICETREE_BASENAME}-xspi.dtb \
    freescale/${KERNEL_DEVICETREE_BASENAME}-rmii.dtb \
"
UBOOT_DTB_NAME = "${KERNEL_DEVICETREE_BASENAME}.dtb"

IMX_DEFAULT_BOOTLOADER:use-nxp-bsp = "u-boot-imx"
IMX_DEFAULT_BOOTLOADER:use-mainline-bsp = "u-boot-fslc"

LOADADDR = ""
UBOOT_SUFFIX = "bin"
UBOOT_MAKE_TARGET = ""

SPL_BINARY = "spl/u-boot-spl.bin"

UBOOT_CONFIG ??= "sd"
UBOOT_CONFIG[sd]   = "${UBOOT_CONFIG_BASENAME}_bringup_defconfig,sdcard"
UBOOT_CONFIG[xspi] = "${UBOOT_CONFIG_BASENAME}_xspi_defconfig"

# Set ATF platform name
ATF_PLATFORM = "imx943"
OEI_CONFIGS = "ddr"
OEI_CORE = "m33"

IMXBOOT_VARIANTS = "alt"

# Multiple system manager configs by IMXBOOT_VARIANT
SYSTEM_MANAGER_CONFIG = "${@bb.utils.contains('IMXBOOT_VARIANT', 'alt',       'mx94alt', \
                                                                              'mx94evk', d)}"

MSEL_TYPE = "${@bb.utils.contains('IMXBOOT_VARIANT', 'alt',       '1', \
                                                                  '0', d)}"

SYSTEM_MANAGER_FIRMWARE_BASENAME = "m33_image"

IMXBOOT_TARGETS_BASENAME = "flash"

# imx-boot (flash.bin) targets based on UBOOT_CONFIG and IMXBOOT_VARIANT
IMXBOOT_TARGETS_SD = "${@bb.utils.contains('IMXBOOT_VARIANT', 'alt',       '${IMXBOOT_TARGETS_BASENAME}_a55', \
                                                                           '${IMXBOOT_TARGETS_BASENAME}_all ${IMXBOOT_TARGETS_BASENAME}_a55', d)} \
"

IMXBOOT_TARGETS = "${@bb.utils.contains('UBOOT_CONFIG', 'xspi', 'flash_a55_xspi', '${IMXBOOT_TARGETS_SD}', d)}"

IMX_BOOT_SOC_TARGET = "iMX94"
IMX_BOOT_SEEK = "32"

# We have to disable SERIAL_CONSOLE due to auto-serial-console
SERIAL_CONSOLES = "115200;ttyLP0"

IMX_DEFAULT_BSP = "nxp"
```

## meta-imx-sdk/conf/distro/fsl-imx-fb-minimal.conf
```bitbake
# i.MX Minimal DISTRO with Framebuffer

require conf/distro/include/fsl-imx-base.inc

DISTRO = "fsl-imx-fb-minimal"
DISTRO_NAME = "NXP i.MX Minimal Distro with Framebuffer"

DISTRO_FEATURES_DEFAULT:remove = "x11 wayland"
DISTRO_FEATURES:remove:mx6-nxp-bsp = "vulkan"
DISTRO_FEATURES:remove:mx7-nxp-bsp = "vulkan"
```

## meta-imx-sdk/conf/distro/fsl-imx-fb.conf
```bitbake
# i.MX DISTRO with Framebuffer

require conf/distro/include/fsl-imx-base.inc
require conf/distro/include/fsl-imx-extended.inc

DISTRO = "fsl-imx-fb"
DISTRO_NAME = "NXP i.MX Distro with Framebuffer"

DISTRO_FEATURES:remove = "x11 wayland"
DISTRO_FEATURES:remove:mx6-nxp-bsp = "vulkan"
DISTRO_FEATURES:remove:mx7-nxp-bsp = "vulkan"
```

## meta-imx-sdk/conf/distro/fsl-imx-wayland-minimal.conf
```bitbake
# i.MX Minimal DISTRO with Wayland

require conf/distro/include/fsl-imx-base.inc

DISTRO = "fsl-imx-wayland-minimal"
DISTRO_NAME = "NXP i.MX Minimal Distro with Wayland"

DISTRO_FEATURES:remove = "x11"
```
