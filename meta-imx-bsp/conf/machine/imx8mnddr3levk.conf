## meta-imx-sdk/conf/distro/fsl-imx-wayland.conf
```bitbake
# i.MX DISTRO with Wayland

require conf/distro/include/fsl-imx-base.inc
require conf/distro/include/fsl-imx-extended.inc

DISTRO = "fsl-imx-wayland"
DISTRO_NAME = "NXP i.MX Distro with Wayland"

DISTRO_FEATURES:remove = "x11"
```

## meta-imx-sdk/conf/distro/fsl-imx-xwayland.conf
```bitbake
# i.MX DISTRO with Wayland and XWayland

require conf/distro/include/fsl-imx-base.inc
require conf/distro/include/fsl-imx-extended.inc

DISTRO = "fsl-imx-xwayland"
DISTRO_NAME = "NXP i.MX Distro with Wayland and XWayland"

PACKAGECONFIG:append:pn-weston      = " rdp"
PACKAGECONFIG:append:pn-weston-init = " rdp"
```
