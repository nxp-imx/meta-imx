## meta-imx-bsp/conf/machine/imx95-19x19-lpddr5-evk.conf
```bitbake
#@TYPE: Machine
#@NAME: NXP i.MX 95 19x19 Evaluation Kit with LPDDR5
#@SOC: i.MX95
#@DESCRIPTION: Machine configuration for NXP i.MX 95 19x19 EVK with LPDDR5
#@MAINTAINER: Jun Zhu <junzhu@nxp.com>

MACHINEOVERRIDES =. "mx95:"

require conf/machine/include/imx95-evk.inc

KERNEL_DEVICETREE_BASENAME = "imx95-19x19-evk"

KERNEL_DEVICETREE:append:use-nxp-bsp = " \
    freescale/${KERNEL_DEVICETREE_BASENAME}-adv7535.dtb \
    freescale/${KERNEL_DEVICETREE_BASENAME}-adv7535.dtbo \
    freescale/${KERNEL_DEVICETREE_BASENAME}-adv7535-ap1302.dtb \
    freescale/${KERNEL_DEVICETREE_BASENAME}-ap1302.dtb \
    freescale/${KERNEL_DEVICETREE_BASENAME}-ap1302.dtbo \
    freescale/${KERNEL_DEVICETREE_BASENAME}-cs42888.dtb \
    freescale/${KERNEL_DEVICETREE_BASENAME}-cs42888.dtbo \
    freescale/${KERNEL_DEVICETREE_BASENAME}-dsi-serdes.dtb \
    freescale/${KERNEL_DEVICETREE_BASENAME}-dsi-serdes.dtbo \
    freescale/${KERNEL_DEVICETREE_BASENAME}-inmate.dtb \
    freescale/${KERNEL_DEVICETREE_BASENAME}-it6263-lvds0.dtb \
    freescale/${KERNEL_DEVICETREE_BASENAME}-it6263-lvds0.dtbo \
    freescale/${KERNEL_DEVICETREE_BASENAME}-it6263-lvds1.dtb \
    freescale/${KERNEL_DEVICETREE_BASENAME}-it6263-lvds1.dtbo \
    freescale/${KERNEL_DEVICETREE_BASENAME}-it6263-lvds-dual.dtb \
    freescale/${KERNEL_DEVICETREE_BASENAME}-it6263-lvds-dual.dtbo \
    freescale/${KERNEL_DEVICETREE_BASENAME}-it6263-lvds-two-disp.dtb \
    freescale/${KERNEL_DEVICETREE_BASENAME}-jdi-wuxga-lvds-panel.dtb \
    freescale/${KERNEL_DEVICETREE_BASENAME}-jdi-wuxga-lvds-panel.dtbo \
    freescale/${KERNEL_DEVICETREE_BASENAME}-jtag.dtb \
    freescale/${KERNEL_DEVICETREE_BASENAME}-jtag.dtbo \
    freescale/${KERNEL_DEVICETREE_BASENAME}-lpspi-slave.dtb \
    freescale/${KERNEL_DEVICETREE_BASENAME}-lt9611uxc.dtb \
    freescale/${KERNEL_DEVICETREE_BASENAME}-lt9611uxc.dtbo \
    freescale/${KERNEL_DEVICETREE_BASENAME}-lt9611uxc-ap1302.dtb \
    freescale/${KERNEL_DEVICETREE_BASENAME}-neoisp.dtb \
    freescale/${KERNEL_DEVICETREE_BASENAME}-neoisp.dtbo \
    freescale/${KERNEL_DEVICETREE_BASENAME}-netc-rpmsg.dtb \
    freescale/${KERNEL_DEVICETREE_BASENAME}-os08a20.dtb \
    freescale/${KERNEL_DEVICETREE_BASENAME}-os08a20.dtbo \
    freescale/${KERNEL_DEVICETREE_BASENAME}-os08a20-isp-it6263-lvds0.dtb \
    freescale/${KERNEL_DEVICETREE_BASENAME}-ox03c10.dtb \
    freescale/${KERNEL_DEVICETREE_BASENAME}-ox03c10.dtbo \
    freescale/${KERNEL_DEVICETREE_BASENAME}-ox03c10-all.dtb \
    freescale/${KERNEL_DEVICETREE_BASENAME}-ox03c10-combo.dtb \
    freescale/${KERNEL_DEVICETREE_BASENAME}-ox03c10-combo.dtbo \
    freescale/${KERNEL_DEVICETREE_BASENAME}-ox03c10-isp-it6263-lvds0.dtb \
    freescale/${KERNEL_DEVICETREE_BASENAME}-ox05b1s.dtb \
    freescale/${KERNEL_DEVICETREE_BASENAME}-ox05b1s.dtbo \
    freescale/${KERNEL_DEVICETREE_BASENAME}-ox05b1s-combo.dtb \
    freescale/${KERNEL_DEVICETREE_BASENAME}-ox05b1s-combo.dtbo \
    freescale/${KERNEL_DEVICETREE_BASENAME}-ox05b1s-isp-it6263-lvds0.dtb \
    freescale/${KERNEL_DEVICETREE_BASENAME}-os08a20-combo.dtb \
    freescale/${KERNEL_DEVICETREE_BASENAME}-os08a20-combo.dtbo \
    freescale/${KERNEL_DEVICETREE_BASENAME}-os08a20-dual.dtb \
    freescale/${KERNEL_DEVICETREE_BASENAME}-pcie1-ep.dtb \
    freescale/${KERNEL_DEVICETREE_BASENAME}-pcie1-ep.dtbo \
    freescale/${KERNEL_DEVICETREE_BASENAME}-rm692c9.dtb \
    freescale/${KERNEL_DEVICETREE_BASENAME}-rm692c9.dtbo \
    freescale/${KERNEL_DEVICETREE_BASENAME}-root.dtb \
    freescale/${KERNEL_DEVICETREE_BASENAME}-rpmsg.dtb \
    freescale/${KERNEL_DEVICETREE_BASENAME}-rpmsg-lpv.dtb \
    freescale/${KERNEL_DEVICETREE_BASENAME}-ti-serdes.dtb \
    freescale/${KERNEL_DEVICETREE_BASENAME}-ti-serdes.dtbo \
    freescale/${KERNEL_DEVICETREE_BASENAME}-ti-serdes-combo.dtb \
    freescale/${KERNEL_DEVICETREE_BASENAME}-ti-serdes-combo.dtbo \
    freescale/${KERNEL_DEVICETREE_BASENAME}-tja1103-tja1120.dtb \
    freescale/${KERNEL_DEVICETREE_BASENAME}-tja1103-rmii.dtb \
"

UBOOT_CONFIG_BASENAME = "imx95_19x19"

IMXBOOT_TARGETS_BASENAME = "flash"
OEI_BOARD  = "mx95lp5"
DDR_TYPE   = "lpddr5"

DDR_FIRMWARE_NAME = " \
    lpddr5_dmem_v202311.bin \
    lpddr5_dmem_qb_v202311.bin \
    lpddr5_imem_v202311.bin \
    lpddr5_imem_qb_v202311.bin \
"
M4_DEFAULT_IMAGE_MX95 = "${@bb.utils.contains('SYSTEM_MANAGER_CONFIG', 'mx95netc', 'imx95-19x19-evk_m7_TCM_netc_share.bin', \
                                                                                   'imx95-19x19-evk_m7_TCM_power_mode_switch.bin', d)}"

IMAGE_BOOT_FILES:append = " \
    imx95-19x19-evk_m7_TCM_flexcan_linux.bin \
    imx95-19x19-evk_m7_TCM_low_power_wakeword.bin \
    imx95-19x19-evk_m7_TCM_netc_share.bin \
    imx95-19x19-evk_m7_TCM_power_mode_switch.bin \
    imx95-19x19-evk_m7_TCM_rpmsg_lite_pingpong_rtos_linux_remote.bin \
    imx95-19x19-evk_m7_TCM_rpmsg_lite_str_echo_rtos.bin \
    imx95-19x19-evk_m7_TCM_sai_low_power_audio.bin \
    ${@bb.utils.contains('COMBINED_FEATURES', 'xen', 'xen', '', d)} \
"
```

## meta-imx-bsp/conf/machine/imx95-19x19-titan.conf
```bitbake
#@TYPE: Machine
#@NAME: Toradex i.MX 95 19x19 Titan board
#@SOC: i.MX95
#@DESCRIPTION: Machine configuration for Toradex i.MX 95 19x19 Titan board
#@MAINTAINER: Flora Hu <flora.hu@nxp.com>

MACHINEOVERRIDES =. "mx95:"

require conf/machine/include/imx95-evk.inc

KERNEL_DEVICETREE_BASENAME = "imx95-19x19-titan"

KERNEL_DEVICETREE:append:use-nxp-bsp = " \
    freescale/${KERNEL_DEVICETREE_BASENAME}-adv7535.dtb \
    freescale/${KERNEL_DEVICETREE_BASENAME}-adv7535.dtbo \
    freescale/${KERNEL_DEVICETREE_BASENAME}-adv7535-ap1302.dtb \
    freescale/${KERNEL_DEVICETREE_BASENAME}-ap1302.dtb \
    freescale/${KERNEL_DEVICETREE_BASENAME}-ap1302.dtbo \
    freescale/${KERNEL_DEVICETREE_BASENAME}-lt8912.dtb \
    freescale/${KERNEL_DEVICETREE_BASENAME}-lt8912.dtbo \
    freescale/${KERNEL_DEVICETREE_BASENAME}-os08a20.dtb \
    freescale/${KERNEL_DEVICETREE_BASENAME}-os08a20.dtbo \
    freescale/${KERNEL_DEVICETREE_BASENAME}-panel-cap-touch-10inch-lvds.dtb \
    freescale/${KERNEL_DEVICETREE_BASENAME}-panel-cap-touch-10inch-lvds.dtbo \
"

UBOOT_CONFIG_BASENAME = "imx95_19x19_titan"

UBOOT_CONFIG ??= "sd"
UBOOT_CONFIG[sd]    = "${UBOOT_CONFIG_BASENAME}_defconfig"
UBOOT_CONFIG[fspi]  = "${UBOOT_CONFIG_BASENAME}_fspi_defconfig"

IMXBOOT_TARGETS_BASENAME = "flash"

DDR_FIRMWARE_NAME = " \
    lpddr5_dmem_v202306.bin \
    lpddr5_imem_v202306.bin \
"
IMAGE_BOOT_FILES:append = " \
    imx95-19x19-evk_m7_TCM_rpmsg_lite_pingpong_rtos_linux_remote_sm.bin \
    imx95-19x19-evk_m7_TCM_rpmsg_lite_str_echo_rtos.bin \
"
```

## meta-imx-bsp/conf/machine/imx95-a1-15x15-lpddr4x-evk.conf
```bitbake
#@TYPE: Machine
#@NAME: NXP i.MX 95 A1 15x15 Evaluation Kit with LPDDR4x
#@SOC: i.MX95
#@DESCRIPTION: Machine configuration for NXP i.MX 95 Rev A1 15x15 EVK with LPDDR4x
##@MAINTAINER: Jun Zhu <junzhu@nxp.com>

require imx95-15x15-lpddr4x-evk.conf
IMX_SOC_REV:${MACHINE} = "A0"
OEI_DDRCONFIG = "XIMX95LPD4XCPU15_4000mbps_train_timing_a1"
```

## meta-imx-bsp/conf/machine/imx95-a1-19x19-lpddr5-evk.conf
```bitbake
#@TYPE: Machine
#@NAME: NXP i.MX 95 A1 19x19 Evaluation Kit with LPDDR5
#@SOC: i.MX95
#@DESCRIPTION: Machine configuration for NXP i.MX 95 Rev A1 19x19 EVK with LPDDR5
#@MAINTAINER: Jun Zhu <junzhu@nxp.com>

require imx95-19x19-lpddr5-evk.conf
IMX_SOC_REV:${MACHINE} = "A0"
OEI_DDRCONFIG = "XIMX95LPD5EVK19_6400mbps_train_timing_a1"
```

## meta-imx-bsp/conf/machine/imx95-a1-19x19-verdin.conf
```bitbake
#@TYPE: Machine
#@NAME: Toradex i.MX 95 A1 19x19 Verdin board
#@SOC: i.MX95
#@DESCRIPTION: Machine configuration for Toradex i.MX 95 Rev A1 19x19 Verdin board
#@MAINTAINER: Flora Hu <flora.hu@nxp.com>

require imx95-19x19-verdin.conf
IMX_SOC_REV:${MACHINE} = "A0"
OEI_DDRCONFIG = "XIMX95LPD5EVK19_6400mbps_train_timing_a1"
```

## meta-imx-bsp/conf/machine/imx95a1evk.conf
```bitbake
#@TYPE: Machine
#@NAME: i.MX 95 A1 Consolidated rootfs machine
#@SOC: i.MX95
#@DESCRIPTION: A Consolidated machine configuration for i.MX 95 Rev A1 19x19 LPDDR5 and
#               15x15 LPDDR4x EVK, see Important Note below
#@MAINTAINER: Jun Zhu <junzhu@nxp.com>

#        ** Important Note **
# This machine generates an image contain the bootloader of 19x19 LPDDR5 EVK, Kernel, and rootfs, plus the DTBs of
# 15x15 LPDDR4x EVK boards. The resulting image can be used for 19x19 LPDDR5 EVK directly,
# and it can be manually converted for other EVK or QSB following the instructions in the User Guide - Consolidated Machines section.
# For users of all of EVK variants, this can save build time and space. For most users, the dedicated machines
# imx95-19x19-lpddr5-evk.conf and imx95-15x15-lpddr4x-evk.conf should be used for simplicity.

require imx95evk.conf
IMX_SOC_REV:${MACHINE} = "A0"
OEI_DDRCONFIG = "XIMX95LPD5EVK19_6400mbps_train_timing_a1"
```

## meta-imx-bsp/conf/machine/include/imx6sabreauto-common.inc
```bitbake
# Provides the i.MX6 SABRE AUTO common settings

require conf/machine/include/imx-base.inc
require conf/machine/include/arm/armv7a/tune-cortexa9.inc

SERIAL_CONSOLES = "115200;ttymxc3"

MACHINE_FIRMWARE:append:mx6-nxp-bsp = " linux-firmware-ath6k"

MACHINE_FEATURES += " pci wifi bluetooth nxp8987-sdio"
```

## meta-imx-bsp/conf/machine/include/imx6sabresd-common.inc
```bitbake
# Provides the i.MX6 SABRE SD common settings

require conf/machine/include/imx-base.inc
require conf/machine/include/arm/armv7a/tune-cortexa9.inc

SERIAL_CONSOLES = "115200;ttymxc0"

MACHINE_FIRMWARE:append:mx6-nxp-bsp = " linux-firmware-ath6k"

MACHINE_FEATURES += " pci wifi bluetooth bcm4339 bcm43455 nxpwifi-all-sdio"
```

## meta-imx-bsp/conf/machine/include/imx8mm-ab2.inc
```bitbake
MACHINEOVERRIDES =. "mx8mm:"

require conf/machine/include/imx-base.inc
require conf/machine/include/arm/armv8a/tune-cortexa53.inc

MACHINE_FEATURES += "pci wifi bluetooth bcm43455 bcm4356"

# NXP BSP can consume BCM4359 driver and firmware
# Since the firmware is not available publicly, and rather distributed
# under "Proprietary" license - we opt-out from using it in all BSPs
# and pin it to NXP BSP only
# OP-TEE is also applicable to NXP BSP, mainline BSP seems not to have
# a full support for it yet.

MACHINE_FEATURES:append:use-nxp-bsp = " optee bcm4359"

KERNEL_DEVICETREE = " \
    freescale/${KERNEL_DEVICETREE_BASENAME}.dtb \
"
UBOOT_DTB_NAME = "${KERNEL_DEVICETREE_BASENAME}.dtb"

IMX_DEFAULT_BOOTLOADER:use-nxp-bsp = "u-boot-imx"
IMX_DEFAULT_BOOTLOADER:use-mainline-bsp = "u-boot-fslc"

UBOOT_CONFIG ??= "sd"
UBOOT_CONFIG[sd]       = "${UBOOT_CONFIG_BASENAME}_defconfig,sdcard"

SPL_BINARY = "spl/u-boot-spl.bin"

ATF_PLATFORM = "imx8mm"
ATF_LOAD_ADDR = "0x920000"

IMXBOOT_TARGETS = "${@bb.utils.contains('UBOOT_CONFIG', 'fspi', '${IMXBOOT_TARGETS_BASENAME}_flexspi', '${IMXBOOT_TARGETS_BASENAME}', d)}"

IMX_BOOT_SOC_TARGET = "iMX8MM"

SERIAL_CONSOLES = "115200;ttymxc1"

LOADADDR = ""
UBOOT_SUFFIX = "bin"
UBOOT_MAKE_TARGET = "all"
IMX_BOOT_SEEK = "33"

OPTEE_BIN_EXT = "8mm"
TEE_LOAD_ADDR = "0xbe000000"

# Add additional firmware
MACHINE_FIRMWARE:append = " linux-firmware-ath10k"
```

## meta-imx-bsp/conf/machine/include/imx91-evk.inc
```bitbake
require conf/machine/include/imx-base.inc
require conf/machine/include/arm/armv8-2a/tune-cortexa55.inc

MACHINE_FEATURES += "pci wifi bluetooth"
MACHINE_FEATURES:append:use-nxp-bsp = " dpdk optee nxpwifi-all-sdio"

KERNEL_DEVICETREE = " \
    freescale/${KERNEL_DEVICETREE_BASENAME}.dtb \
"

IMX_DEFAULT_BOOTLOADER:use-nxp-bsp = "u-boot-imx"
IMX_DEFAULT_BOOTLOADER:use-mainline-bsp = "u-boot-fslc"

LOADADDR = ""
UBOOT_SUFFIX = "bin"
UBOOT_MAKE_TARGET = ""

SPL_BINARY = "spl/u-boot-spl.bin"

UBOOT_CONFIG ??= "sd"
UBOOT_CONFIG[sd]   = "${UBOOT_CONFIG_BASENAME}_defconfig,sdcard"

# Set ATF platform name
ATF_PLATFORM = "imx91"

IMXBOOT_TARGETS = "flash_singleboot"

IMX_BOOT_SOC_TARGET = "iMX91"
IMX_BOOT_SEEK = "32"

# We have to disable SERIAL_CONSOLE due to auto-serial-console
SERIAL_CONSOLES = "115200;ttyLP0"

IMX_DEFAULT_BSP = "nxp"
```

## meta-imx-bsp/conf/machine/include/imx95-evk.inc
```bitbake
require conf/machine/include/imx-base.inc
require conf/machine/include/arm/armv8-2a/tune-cortexa55.inc

MACHINE_FEATURES += "pci wifi bluetooth"
MACHINE_FEATURES:append:use-nxp-bsp = " nxpwifi-all-pcie jailhouse"
#MACHINE_FEATURES:append:use-nxp-bsp = " optee"

KERNEL_DEVICETREE = " \
    freescale/${KERNEL_DEVICETREE_BASENAME}.dtb \
"
UBOOT_DTB_NAME = "${KERNEL_DEVICETREE_BASENAME}-scmi.dtb"

IMX_DEFAULT_BOOTLOADER:use-nxp-bsp = "u-boot-imx"
IMX_DEFAULT_BOOTLOADER:use-mainline-bsp = "u-boot-fslc"

LOADADDR = ""
UBOOT_SUFFIX = "bin"
UBOOT_MAKE_TARGET = ""

SPL_BINARY = "spl/u-boot-spl.bin"

UBOOT_CONFIG ??= "sd"
UBOOT_CONFIG[sd] = "${UBOOT_CONFIG_BASENAME}_evk_defconfig,sdcard"
UBOOT_CONFIG[fspi] = "${UBOOT_CONFIG_BASENAME}_evk_fspi_defconfig"

# Set ATF platform name
ATF_PLATFORM = "imx95"
SYSTEM_MANAGER_CONFIG = "mx95evk"
OEI_CONFIGS = "ddr tcm"
OEI_CORE   = "m33"
OEI_SOC    = "mx95"
OEI_BOARD  = "mx95lp5"

IMXBOOT_TARGETS = " \
    ${@bb.utils.contains('UBOOT_CONFIG', 'fspi', '${IMXBOOT_TARGETS_BASENAME}_a55_flexspi', '${IMXBOOT_TARGETS_BASENAME}_all ${IMXBOOT_TARGETS_BASENAME}_a55', d)} \
"

IMX_BOOT_SOC_TARGET = "iMX95"
IMX_BOOT_SEEK = "32"

# We have to disable SERIAL_CONSOLE due to auto-serial-console
SERIAL_CONSOLES = "115200;ttyLP0"

IMX_DEFAULT_BSP = "nxp"
```

## meta-imx-cockpit/conf/layer.conf
```bitbake
# We have a conf and classes directory, add to BBPATH
BBPATH .= ":${LAYERDIR}"

# We have a packages directory, add to BBFILES
BBFILES += "${LAYERDIR}/recipes-*/*/*.bb \
            ${LAYERDIR}/recipes-*/*/*.bbappend"

BBFILE_COLLECTIONS += "meta-imx-cockpit"
BBFILE_PATTERN_meta-imx-cockpit := "^${LAYERDIR}/"
BBFILE_PRIORITY_meta-imx-cockpit = "8"
LAYERSERIES_COMPAT_meta-imx-cockpit = "langdale mickledore nanbield"
```

## meta-imx-cockpit/conf/machine/imx8qm-cockpit-mek.conf
```bitbake
#@TYPE: Machine
#@NAME: i.MX 8QM MEK
#@DESCRIPTION: i.MX 8QuadMax Multisensory Enablement Kit board, rev B0 Ecockpit machine
#@MAINTAINER: Lauren Post <lauren.post@nxp.com>

MACHINEOVERRIDES =. "imx8qm-mek:imx8qm-cockpit:"
require conf/machine/imx8qm-mek.conf
KERNEL_DEVICETREE_BASENAME = "imx8qm-mek"

# Include device trees for other boards for internal test
KERNEL_DEVICETREE = " \
    freescale/imx8qm-mek-cockpit-a53.dtb \
    freescale/imx8qm-mek-cockpit-a72.dtb \
"

UBOOT_CONFIG ??= "a53 a72"
UBOOT_CONFIG[a53] = "imx8qm_mek_cockpit_a53_defconfig"
UBOOT_CONFIG[a72] = "imx8qm_mek_cockpit_a72_defconfig"
```
