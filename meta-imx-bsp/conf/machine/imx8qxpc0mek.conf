## meta-imx-sdk/conf/distro/include/fsl-imx-preferred-env.inc
```bitbake
PREFERRED_PROVIDER_virtual/bootloader:imx-nxp-bsp = "u-boot-imx"
PREFERRED_PROVIDER_virtual/kernel:imx-nxp-bsp = "linux-imx"
PREFERRED_PROVIDER_linux-imx-mfgtool = "linux-imx-mfgtool"

PREFERRED_VERSION_gstreamer1.0              = "1.24.0.imx"
PREFERRED_VERSION_gstreamer1.0-plugins-base = "1.24.0.imx"
PREFERRED_VERSION_gstreamer1.0-plugins-good = "1.24.0.imx"
PREFERRED_VERSION_gstreamer1.0-plugins-bad  = "1.24.0.imx"
PREFERRED_VERSION_gstreamer1.0-plugins-ugly = "1.24.%"
PREFERRED_VERSION_gstreamer1.0-libav        = "1.24.%"
PREFERRED_VERSION_gstreamer1.0-rtsp-server  = "1.24.%"

PREFERRED_VERSION_gstreamer1.0:mx8-nxp-bsp              = "1.24.0.imx"
PREFERRED_VERSION_gstreamer1.0-plugins-base:mx8-nxp-bsp = "1.24.0.imx"
PREFERRED_VERSION_gstreamer1.0-plugins-good:mx8-nxp-bsp = "1.24.0.imx"
PREFERRED_VERSION_gstreamer1.0-plugins-bad:mx8-nxp-bsp  = "1.24.0.imx"
PREFERRED_VERSION_gstreamer1.0-plugins-ugly:mx8-nxp-bsp = "1.24.%"
PREFERRED_VERSION_gstreamer1.0-libav:mx8-nxp-bsp        = "1.24.%"
PREFERRED_VERSION_gstreamer1.0-rtsp-server:mx8-nxp-bsp  = "1.24.%"

PREFERRED_VERSION_gstreamer1.0:mx9-nxp-bsp              = "1.24.0.imx"
PREFERRED_VERSION_gstreamer1.0-plugins-base:mx9-nxp-bsp = "1.24.0.imx"
PREFERRED_VERSION_gstreamer1.0-plugins-good:mx9-nxp-bsp = "1.24.0.imx"
PREFERRED_VERSION_gstreamer1.0-plugins-bad:mx9-nxp-bsp  = "1.24.0.imx"
PREFERRED_VERSION_gstreamer1.0-plugins-ugly:mx9-nxp-bsp = "1.24.%"
PREFERRED_VERSION_gstreamer1.0-libav:mx9-nxp-bsp        = "1.24.%"
PREFERRED_VERSION_gstreamer1.0-rtsp-server:mx9-nxp-bsp  = "1.24.%"

PREFERRED_VERSION_xen-tools = "4.18.imx+stable"
PREFERRED_VERSION_xen = "4.18.imx+stable"

QEMUVERSION              = "8.2.2"
QEMUVERSION:mx95-nxp-bsp = "8.2.2.imx"

BBMASK += "meta-freescale/recipes-multimedia/gstreamer"
BBMASK += "meta-arm/meta-arm/recipes-kernel/linux/linux-yocto_5.15%.bbappend"

# Use systemd as default init manager
POKY_INIT_MANAGER = "systemd"

# Use virtual-runc as a default container runtime
# runtime: runc, crun, runv, runx
VIRTUAL-RUNTIME_container_runtime = "virtual-runc"
```

## meta-imx-v2x/conf/layer.conf
```bitbake
# We have a conf and classes directory, add to BBPATH
BBPATH .= ":${LAYERDIR}"

# We have a packages directory, add to BBFILES
BBFILES += "${LAYERDIR}/recipes-*/*/*.bb \
            ${LAYERDIR}/recipes-*/*/*.bbappend"

BBFILE_COLLECTIONS += "v2x-imx"
BBFILE_PATTERN_v2x-imx := "^${LAYERDIR}"
BBFILE_PRIORITY_v2x-imx = "9"
LAYERSERIES_COMPAT_v2x-imx = "mickledore nanbield"

# MASK append recipes to disable profiling
BBMASK += "meta-imx-v2x/recipes-kernel/"
```

## meta-ml/conf/layer.conf
```bitbake
# We have a conf and classes directory, add to BBPATH
BBPATH .= ":${LAYERDIR}"

# We have a packages directory, add to BBFILES
BBFILES += "${LAYERDIR}/recipes-*/*/*.bb \
            ${LAYERDIR}/recipes-*/*/*.bbappend"

BBFILE_COLLECTIONS += "meta-ml"
BBFILE_PATTERN_meta-ml := "^${LAYERDIR}/"
BBFILE_PRIORITY_meta-ml = "8"
LAYERSERIES_COMPAT_meta-ml = "warrior zeus"
```

## meta-sdk/conf/distro/fsl-imx-x11.conf
```bitbake
# i.MX DISTRO for X11 with no wayland

include conf/distro/include/fsl-imx-base.inc
include conf/distro/include/fsl-imx-preferred-env.inc

DISTRO = "fsl-imx-x11"

# Remove conflicting backends.
DISTRO_FEATURES:remove = "wayland"

# These are X11 specific
DISTRO_FEATURES:append = " x11"

RDEPENDS:packagegroup-core-tools-testapps:remove = "mesa-demos"
RDEPENDS:packagegroup-fsl-tools-gpu-external:remove = "mesa-demos"
```
