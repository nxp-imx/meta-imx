## meta-imx-bsp/conf/machine/imx8qxpc0mek.conf
```bitbake
# DEPRECATED: Machine is renamed, please use imx8qxp-mek
MACHINEOVERRIDES =. "imx8qxp-mek:"
require conf/machine/imx8qxp-mek.conf
KERNEL_DEVICETREE_BASENAME = "imx8qxp-mek"

# Include device trees for other boards for internal test
KERNEL_DEVICETREE += " \
    freescale/imx8dx-mek.dtb \
    freescale/imx8dx-mek-dsi-rm67191.dtb \
    freescale/imx8dx-mek-dsi-rm67191-rpmsg.dtb \
    freescale/imx8dx-mek-enet2-tja1100.dtb \
    freescale/imx8dx-mek-it6263-lvds0-dual-channel.dtb \
    freescale/imx8dx-mek-it6263-lvds0-dual-channel-rpmsg.dtb \
    freescale/imx8dx-mek-it6263-lvds1-dual-channel.dtb \
    freescale/imx8dx-mek-it6263-lvds1-dual-channel-rpmsg.dtb \
    freescale/imx8dx-mek-jdi-wuxga-lvds0-panel.dtb \
    freescale/imx8dx-mek-jdi-wuxga-lvds0-panel-rpmsg.dtb \
    freescale/imx8dx-mek-jdi-wuxga-lvds1-panel.dtb \
    freescale/imx8dx-mek-jdi-wuxga-lvds1-panel-rpmsg.dtb \
    freescale/imx8dx-mek-ov5640.dtb \
    freescale/imx8dx-mek-ov5640-rpmsg.dtb \
    freescale/imx8dx-mek-rpmsg.dtb \
    freescale/imx8qxp-lpddr4-val-a0.dtb \
    freescale/imx8qxp-lpddr4-val.dtb \
    freescale/imx8qxp-lpddr4-val-gpmi-nand.dtb \
    freescale/imx8qxp-lpddr4-val-lpspi.dtb \
    freescale/imx8qxp-lpddr4-val-lpspi-slave.dtb \
    freescale/imx8qxp-lpddr4-val-mqs.dtb \
    freescale/imx8qxp-lpddr4-val-spdif.dtb \
"
```

## meta-imx-bsp/conf/machine/imx8qxpmek.conf
```bitbake
# DEPRECATED: Machine is renamed, please use imx8qxp-b0-mek
MACHINEOVERRIDES =. "imx8qxp-b0-mek:"
require conf/machine/imx8qxp-b0-mek.conf
KERNEL_DEVICETREE_BASENAME = "imx8qxp-mek"
```

## meta-imx-bsp/conf/machine/imx8ulpevk.conf
```bitbake
#@TYPE: Machine
#@NAME: i.MX 8ULP consolidated rootfs machine
#@SOC: i.MX8ULP
#@DESCRIPTION: A consolidated machine configuration for NXP i.MX 8ULP LPDDR4 Evaluation Kits, see Important Note below
#@MAINTAINER: Jun Zhu <junzhu@nxp.com>

#        ** Important Note **
# This machine generates an image contain the bootloader of 11x11 LPDDR4 EVK, Kernel, and rootfs, plus the DTBs of
# both 11x11 and 9x9 EVKs. The resulting image can be used for 11x11 LPDDR4 EVK directly, and it can
# be manually converted for 9x9 LPDDR4 EVK following the instructions in the User Guide - Consolidated Machines section.
# For users of both EVK variants, this can save build time and space. For most users, the dedicated machines
# imx8mp-lpddr4-evk.conf and imx8mp-9x9-lpddr4-evk.conf should be used for simplicity.

MACHINEOVERRIDES =. "imx8ulp-lpddr4-evk:"
require conf/machine/imx8ulp-lpddr4-evk.conf

# Include device trees for other boards for internal test
KERNEL_DEVICETREE += " \
    freescale/imx8ulp-9x9-evk.dtb \
    freescale/imx8ulp-9x9-evk-i3c.dtb \
    freescale/imx8ulp-9x9-evk-lpa.dtb \
    freescale/imx8ulp-9x9-evk-lpspi.dtb \
    freescale/imx8ulp-9x9-evk-lpspi-slave.dtb \
    freescale/imx8ulp-9x9-evk-sof-btsco.dtb \
    freescale/imx8ulp-9x9-evk-rk055hdmipi4m.dtb \
    freescale/imx8ulp-9x9-evk-rk055hdmipi4mv2.dtb \
"
```

## meta-imx-bsp/conf/machine/imx91-11x11-lpddr4-evk.conf
```bitbake
#@TYPE: Machine
#@NAME: NXP i.MX 91 11x11 Evaluation Kit with LPDDR4
#@SOC: i.MX91
#@DESCRIPTION: Machine configuration for NXP i.MX 91 11x11 EVK with LPDDR4
#@MAINTAINER: Jun Zhu <junzhu@nxp.com>

MACHINEOVERRIDES =. "mx91:"

require conf/machine/include/imx91-evk.inc

KERNEL_DEVICETREE_BASENAME = "imx91-11x11-evk"

KERNEL_DEVICETREE:append:use-nxp-bsp = " \
    freescale/${KERNEL_DEVICETREE_BASENAME}-aud-hat.dtb \
    freescale/${KERNEL_DEVICETREE_BASENAME}-flexspi-m2.dtb \
    freescale/${KERNEL_DEVICETREE_BASENAME}-flexspi-nand-m2.dtb \
    freescale/${KERNEL_DEVICETREE_BASENAME}-i2c-spi-slave.dtb \
    freescale/${KERNEL_DEVICETREE_BASENAME}-i3c.dtb \
    freescale/${KERNEL_DEVICETREE_BASENAME}-ld.dtb \
    freescale/${KERNEL_DEVICETREE_BASENAME}-lpuart.dtb \
    freescale/${KERNEL_DEVICETREE_BASENAME}-mqs.dtb \
    freescale/${KERNEL_DEVICETREE_BASENAME}-mt9m114.dtb \
    freescale/${KERNEL_DEVICETREE_BASENAME}-tianma-wvga-panel.dtb \
"

UBOOT_CONFIG_BASENAME = "imx91_11x11_evk"

UBOOT_CONFIG[nand] = "${UBOOT_CONFIG_BASENAME}_spinand_defconfig"
UBOOT_CONFIG[fspi] = "${UBOOT_CONFIG_BASENAME}_defconfig"
UBOOT_CONFIG[ecc] = "${UBOOT_CONFIG_BASENAME}_inline_ecc_defconfig"

IMXBOOT_TARGETS_NAND = "flash_singleboot_spinand flash_singleboot_spinand_fw"
IMXBOOT_TARGETS_FSPI = "flash_singleboot_flexspi"

IMXBOOT_TARGETS = "${@bb.utils.contains('UBOOT_CONFIG', 'nand', '${IMXBOOT_TARGETS_NAND}', \
                      bb.utils.contains('UBOOT_CONFIG', 'fspi', '${IMXBOOT_TARGETS_FSPI}', \
                                                                  'flash_singleboot', d), d)}"

DDR_FIRMWARE_NAME = " \
    lpddr4_dmem_1d_v202201.bin \
    lpddr4_dmem_2d_v202201.bin \
    lpddr4_imem_1d_v202201.bin \
    lpddr4_imem_2d_v202201.bin \
"
```

## meta-imx-bsp/conf/machine/imx91evk.conf
```bitbake
#@TYPE: Machine
#@NAME: i.MX 91 Consolidated rootfs machine
#@SOC: i.MX91
#@DESCRIPTION: A Consolidated machine configuration for i.MX 91 LPDDR4 EVK/QSB, see Important Note below
#@MAINTAINER: Jun Zhu <junzhu@nxp.com>

#        ** Important Note **
# This machine generates an image contain the bootloader of 11x11 LPDDR4 EVK, Kernel, and rootfs, plus the DTBs of
# both 11x11 LPDDR4 EVK and 9x9 LPDDR4 QSB boards. The resulting image can be used for 11x11 LPDDR4 EVK directly,
# and it can be manually converted for other EVK or QSB following the instructions in the User Guide - Consolidated Machines section.
# For users of all of EVK/QSB variants, this can save build time and space. For most users, the dedicated machines
# imx91-11x11-lpddr4-evk.conf and imx91-9x9-lpddr4-qsb.conf should be used for simplicity.

MACHINEOVERRIDES =. "imx91-11x11-lpddr4-evk:"
require conf/machine/imx91-11x11-lpddr4-evk.conf

# Include device trees for other boards for internal test
KERNEL_DEVICETREE += " \
    freescale/imx91-9x9-qsb.dtb \
    freescale/imx91-9x9-qsb-aud-hat.dtb \
    freescale/imx91-9x9-qsb-can1.dtb \
    freescale/imx91-9x9-qsb-flexspi-m2.dtb \
    freescale/imx91-9x9-qsb-flexspi-nand.dtb \
    freescale/imx91-9x9-qsb-hfp.dtb \
    freescale/imx91-9x9-qsb-i2c-spi-slave.dtb \
    freescale/imx91-9x9-qsb-i3c.dtb \
    freescale/imx91-9x9-qsb-ld.dtb \
    freescale/imx91-9x9-qsb-mt9m114.dtb \
    freescale/imx91-9x9-qsb-tianma-wvga-panel.dtb \
"
```

## meta-imx-bsp/conf/machine/imx91p-11x11-lpddr4-evk.conf
```bitbake
#@TYPE: Machine
#@NAME: NXP i.MX 91 Phantom 11x11 Evaluation Kit with LPDDR4
#@SOC: i.MX91P
#@DESCRIPTION: Machine configuration for NXP i.MX 91 Phantom 11x11 EVK with LPDDR4
#@MAINTAINER: Jun Zhu <junzhu@nxp.com>

MACHINEOVERRIDES =. "mx91p:"

require conf/machine/include/imx91-evk.inc

KERNEL_DEVICETREE_BASENAME = "imx91p-11x11-evk"

KERNEL_DEVICETREE:append:use-nxp-bsp = " \
    freescale/${KERNEL_DEVICETREE_BASENAME}-aud-hat.dtb \
    freescale/${KERNEL_DEVICETREE_BASENAME}-flexspi-m2.dtb \
    freescale/${KERNEL_DEVICETREE_BASENAME}-i3c.dtb \
    freescale/${KERNEL_DEVICETREE_BASENAME}-ld.dtb \
    freescale/${KERNEL_DEVICETREE_BASENAME}-lpspi.dtb \
    freescale/${KERNEL_DEVICETREE_BASENAME}-lpspi-slave.dtb \
    freescale/${KERNEL_DEVICETREE_BASENAME}-mqs.dtb \
    freescale/${KERNEL_DEVICETREE_BASENAME}-mt9m114.dtb \
	freescale/${KERNEL_DEVICETREE_BASENAME}-ontat-wvga-panel.dtb \
"

UBOOT_CONFIG_BASENAME = "imx91p_11x11_evk"

DDR_FIRMWARE_NAME = " \
    lpddr4_dmem_1d_v202201.bin \
    lpddr4_dmem_2d_v202201.bin \
    lpddr4_imem_1d_v202201.bin \
    lpddr4_imem_2d_v202201.bin \
"
```

## meta-imx-bsp/conf/machine/imx91p-9x9-lpddr4-qsb.conf
```bitbake
#@TYPE: Machine
#@NAME: NXP i.MX91Phantom 9x9 Quick Start Board with LPDDR4
#@SOC: i.MX91Phantom
#@DESCRIPTION: Machine configuration for NXP i.MX91Phantom 9x9 QSB with LPDDR4
#@MAINTAINER: Jun Zhu <junzhu@nxp.com>

MACHINEOVERRIDES =. "mx91p:"

require include/imx91-evk.inc

KERNEL_DEVICETREE_BASENAME = "imx91p-9x9-qsb"

KERNEL_DEVICETREE:append:use-nxp-bsp = " \
    freescale/${KERNEL_DEVICETREE_BASENAME}-aud-hat.dtb \
    freescale/${KERNEL_DEVICETREE_BASENAME}-can1.dtb \
    freescale/${KERNEL_DEVICETREE_BASENAME}-flexspi-m2.dtb \
    freescale/${KERNEL_DEVICETREE_BASENAME}-i3c.dtb \
    freescale/${KERNEL_DEVICETREE_BASENAME}-ld.dtb \
    freescale/${KERNEL_DEVICETREE_BASENAME}-lpspi-slave.dtb \
    freescale/${KERNEL_DEVICETREE_BASENAME}-lpspi.dtb \
    freescale/${KERNEL_DEVICETREE_BASENAME}-mt9m114.dtb \
    freescale/${KERNEL_DEVICETREE_BASENAME}-ontat-wvga-panel.dtb \
    freescale/${KERNEL_DEVICETREE_BASENAME}-spi-nand-m2.dtb \
"

UBOOT_CONFIG_BASENAME = "imx91p_9x9_qsb"

UBOOT_CONFIG[spinand]   = "${UBOOT_CONFIG_BASENAME}_spinand_defconfig"

IMXBOOT_TARGETS_NAND = "flash_singleboot_spinand flash_singleboot_spinand_fw"

IMXBOOT_TARGETS = "${@bb.utils.contains('UBOOT_CONFIG','spinand', '${IMXBOOT_TARGETS_NAND}', 'flash_singleboot', d)}"

DDR_FIRMWARE_NAME = " \
    lpddr4_dmem_1d_v202201.bin \
    lpddr4_dmem_2d_v202201.bin \
    lpddr4_imem_1d_v202201.bin \
    lpddr4_imem_2d_v202201.bin \
"
```

## meta-imx-bsp/conf/machine/imx95-15x15-lpddr4x-evk.conf
```bitbake
#@TYPE: Machine
#@NAME: NXP i.MX 95 15x15 Evaluation Kit with LPDDR4x
#@SOC: i.MX95
#@DESCRIPTION: Machine configuration for NXP i.MX 95 15x15 EVK with LPDDR4x
##@MAINTAINER: Jun Zhu <junzhu@nxp.com>

MACHINEOVERRIDES =. "mx95:"

require conf/machine/include/imx95-evk.inc

KERNEL_DEVICETREE_BASENAME = "imx95-15x15-evk"

KERNEL_DEVICETREE:append:use-nxp-bsp = " \
    freescale/imx95-15x15-ab2.dtb \
    freescale/${KERNEL_DEVICETREE_BASENAME}-aud-hat.dtb \
    freescale/${KERNEL_DEVICETREE_BASENAME}-adv7535.dtb \
    freescale/${KERNEL_DEVICETREE_BASENAME}-adv7535-ap1302.dtb \
    freescale/${KERNEL_DEVICETREE_BASENAME}-adv7535-ap1302_rpi.dtb \
    freescale/${KERNEL_DEVICETREE_BASENAME}-adv7535.dtbo \
    freescale/${KERNEL_DEVICETREE_BASENAME}-ap1302.dtb \
    freescale/${KERNEL_DEVICETREE_BASENAME}-ap1302.dtbo \
    freescale/${KERNEL_DEVICETREE_BASENAME}-ap1302_rpi.dtb \
    freescale/${KERNEL_DEVICETREE_BASENAME}-ap1302_rpi.dtbo \
    freescale/${KERNEL_DEVICETREE_BASENAME}-boe-wxga-lvds-two-panels.dtb \
    freescale/${KERNEL_DEVICETREE_BASENAME}-boe-wxga-lvds0-panel.dtb \
    freescale/${KERNEL_DEVICETREE_BASENAME}-boe-wxga-lvds1-panel.dtb \
    freescale/${KERNEL_DEVICETREE_BASENAME}-i2c-spi-slave.dtb \
    freescale/${KERNEL_DEVICETREE_BASENAME}-inmate.dtb \
    freescale/${KERNEL_DEVICETREE_BASENAME}-lt9611uxc.dtb \
    freescale/${KERNEL_DEVICETREE_BASENAME}-lt9611uxc.dtbo \
    freescale/${KERNEL_DEVICETREE_BASENAME}-lt9611uxc-ap1302.dtb \
    freescale/${KERNEL_DEVICETREE_BASENAME}-mqs.dtb \
    freescale/${KERNEL_DEVICETREE_BASENAME}-os08a20.dtb \
    freescale/${KERNEL_DEVICETREE_BASENAME}-os08a20.dtbo \
    freescale/${KERNEL_DEVICETREE_BASENAME}-os08a20-isp-adv7535.dtb \
    freescale/${KERNEL_DEVICETREE_BASENAME}-ox03c10.dtb \
    freescale/${KERNEL_DEVICETREE_BASENAME}-ox03c10.dtbo \
    freescale/${KERNEL_DEVICETREE_BASENAME}-ox03c10-isp-adv7535.dtb \
    freescale/${KERNEL_DEVICETREE_BASENAME}-ox05b1s.dtb \
    freescale/${KERNEL_DEVICETREE_BASENAME}-ox05b1s.dtbo \
    freescale/${KERNEL_DEVICETREE_BASENAME}-ox05b1s-isp-adv7535.dtb \
    freescale/${KERNEL_DEVICETREE_BASENAME}-rm692c9.dtb \
    freescale/${KERNEL_DEVICETREE_BASENAME}-rm692c9.dtbo \
    freescale/${KERNEL_DEVICETREE_BASENAME}-root.dtb \
    freescale/${KERNEL_DEVICETREE_BASENAME}-rpmsg.dtb \
    freescale/${KERNEL_DEVICETREE_BASENAME}-rpmsg-lpv.dtb \
"

KERNEL_DEVICETREE_NON_SUPPORT:append:use-nxp-bsp = " \
    freescale/${KERNEL_DEVICETREE_BASENAME}-cs42888.dtb \
    freescale/${KERNEL_DEVICETREE_BASENAME}-cs42888.dtbo \
    freescale/${KERNEL_DEVICETREE_BASENAME}-it6263-lvds0.dtb \
    freescale/${KERNEL_DEVICETREE_BASENAME}-it6263-lvds0.dtbo \
    freescale/${KERNEL_DEVICETREE_BASENAME}-it6263-lvds1.dtb \
    freescale/${KERNEL_DEVICETREE_BASENAME}-it6263-lvds1.dtbo \
    freescale/${KERNEL_DEVICETREE_BASENAME}-it6263-lvds-dual.dtb \
    freescale/${KERNEL_DEVICETREE_BASENAME}-it6263-lvds-dual.dtbo \
    freescale/${KERNEL_DEVICETREE_BASENAME}-it6263-lvds-two-disp.dtb \
    freescale/${KERNEL_DEVICETREE_BASENAME}-i2c-spi-slave.dtb \
    freescale/${KERNEL_DEVICETREE_BASENAME}-jdi-wuxga-lvds-panel.dtb \
    freescale/${KERNEL_DEVICETREE_BASENAME}-jdi-wuxga-lvds-panel.dtbo \
    freescale/${KERNEL_DEVICETREE_BASENAME}-jtag.dtb \
    freescale/${KERNEL_DEVICETREE_BASENAME}-neoisp.dtb \
    freescale/${KERNEL_DEVICETREE_BASENAME}-os08a20.dtb \
    freescale/${KERNEL_DEVICETREE_BASENAME}-pcie1-ep.dtb \
    freescale/${KERNEL_DEVICETREE_BASENAME}-tja1103-tja1120.dtb \
"

UBOOT_CONFIG_BASENAME = "imx95_15x15"

IMXBOOT_TARGETS_BASENAME = "flash"

OEI_BOARD  = "mx95lp4x-15"
DDR_TYPE   = "lpddr4x"

DDR_FIRMWARE_NAME = " \
    lpddr4x_dmem_v202311.bin \
    lpddr4x_dmem_qb_v202311.bin \
    lpddr4x_imem_v202311.bin \
    lpddr4x_imem_qb_v202311.bin \
"

M4_DEFAULT_IMAGE_MX95 = "imx95-15x15-evk_m7_TCM_power_mode_switch.bin"

IMAGE_BOOT_FILES:append = " \
    imx95-15x15-evk_m7_TCM_power_mode_switch.bin \
    imx95-15x15-evk_m7_TCM_rpmsg_lite_pingpong_rtos_linux_remote.bin \
    imx95-15x15-evk_m7_TCM_rpmsg_lite_str_echo_rtos.bin \
    imx95-15x15-evk_m7_TCM_sai_low_power_audio.bin \
"
```
