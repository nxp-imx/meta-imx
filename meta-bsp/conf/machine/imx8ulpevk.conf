## meta-imx-bsp/conf/layer.conf
```bitbake
# We have a conf and classes directory, add to BBPATH
BBPATH .= ":${LAYERDIR}"

# We have a packages directory, add to BBFILES
BBFILES += "${LAYERDIR}/recipes-*/*/*.bb \
            ${LAYERDIR}/recipes-*/*/*.bbappend"

BBFILE_COLLECTIONS += "fsl-bsp-release"
BBFILE_PATTERN_fsl-bsp-release := "^${LAYERDIR}/"
BBFILE_PRIORITY_fsl-bsp-release = "8"
LAYERSERIES_COMPAT_fsl-bsp-release = "mickledore nanbield"

# Create a mirror for unreliable packages
MIRRORS += "http://sourceforge.net/.* http://www.nxp.com/lgfiles/updates/other"

# FIXME: Drop these lines when the external layers are marked compatible
LAYERSERIES_COMPAT_chromium-browser-layer:append = " langdale mickledore"
LAYERSERIES_COMPAT_imx-demo:append = " mickledore"

# Define new EULAs and add them to the list defined in meta-freescale.
# See fsl-eula-unpack.bbclass.
FSL_EULA_FILE_MD5SUM_LA_OPT_NXP_SOFTWARE_LICENSE_V49 = "2827219e81f28aba7c6a569f7c437fa7"
FSL_EULA_FILE_MD5SUM_LA_OPT_NXP_SOFTWARE_LICENSE_V53 = "44a8052c384584ba09077e85a3d1654f"

FSL_EULA_FILE_MD5SUMS:append = " \
    ${FSL_EULA_FILE_MD5SUM_LA_OPT_NXP_SOFTWARE_LICENSE_V49} \
    ${FSL_EULA_FILE_MD5SUM_LA_OPT_NXP_SOFTWARE_LICENSE_V53} \
"

# Override the EULA defined in meta-freescale.
FSL_EULA_FILE = "${LAYERDIR}/../LICENSE.txt"
FSL_EULA_FILE_MD5SUM = "${FSL_EULA_FILE_MD5SUM_LA_OPT_NXP_SOFTWARE_LICENSE_V53}"

# FIXME: Drop xxd if/when xxd-native can be used instead
HOSTTOOLS_NONFATAL:append = " xxd cert-to-efi-sig-list"

# optee is no longer a valid distro feature. Use machine feature to remove, like this:
# MACHINE_FEATURES:remove = "optee"
# DEPRECATED: The ability to remove optee from the build is deprecated and
# will be removed in some future release.

MACHINE_USES_VIVANTE_KERNEL_DRIVER_MODULE ?= "0"

# Overrides for imx-base.inc
IMX_DEFAULT_BSP = "nxp"

# The default bootloader is set to -fslc in
# meta-freescale/cond/machine/include/imx-base.inc, so we must
# override it here.
IMX_DEFAULT_BOOTLOADER:imx-nxp-bsp = "u-boot-imx"

UBOOT_MAKE_TARGET:pn-u-boot-imx:mx6-nxp-bsp = "u-boot.imx"
UBOOT_MAKE_TARGET:pn-u-boot-imx:mx7-nxp-bsp = "u-boot.imx"
UBOOT_SUFFIX:pn-u-boot-imx:mx6-nxp-bsp = "imx"
UBOOT_SUFFIX:pn-u-boot-imx:mx7-nxp-bsp = "imx"
UBOOT_SUFFIX:pn-u-boot-imx:mx8-nxp-bsp = "bin"
UBOOT_MAKE_TARGET:pn-u-boot-imx-mfgtool:mx6-nxp-bsp = "u-boot.imx"
UBOOT_MAKE_TARGET:pn-u-boot-imx-mfgtool:mx7-nxp-bsp = "u-boot.imx"
UBOOT_SUFFIX:pn-u-boot-imx-mfgtool:mx6-nxp-bsp = "imx"
UBOOT_SUFFIX:pn-u-boot-imx-mfgtool:mx7-nxp-bsp = "imx"
UBOOT_SUFFIX:pn-u-boot-imx-mfgtool:mx8-nxp-bsp = "bin"

IMX_DEFAULT_UBOOTTOOLS = "u-boot-imx-tools"
PREFERRED_PROVIDER_u-boot-tools-native = "${IMX_DEFAULT_UBOOTTOOLS}-native"
PREFERRED_PROVIDER_nativesdk-u-boot-tools = "nativesdk-${IMX_DEFAULT_UBOOTTOOLS}"
PREFERRED_PROVIDER_u-boot-mkimage-native = "${IMX_DEFAULT_UBOOTTOOLS}-native"
PREFERRED_PROVIDER_nativesdk-u-boot-mkimage = "nativesdk-${IMX_DEFAULT_UBOOTTOOLS}"

PREFERRED_RPROVIDER_linux-firmware-bcm4359-pcie ??= "linux-firmware"
PREFERRED_RPROVIDER_u-boot-default-env ??= "${IMX_DEFAULT_BOOTLOADER}"

MACHINE_SOCARCH_FILTER:remove = "alsa-lib gstreamer1.0 imx-codec"

# Use latest SDMA firmware from firmware-imx instead of upstream linux-firmware
MACHINE_FIRMWARE:remove:mx6-nxp-bsp      = "linux-firmware-imx-sdma-imx6q"
MACHINE_FIRMWARE:remove:mx7d-nxp-bsp     = "linux-firmware-imx-sdma-imx7d"
MACHINE_FIRMWARE:remove:mx8-nxp-bsp      = "linux-firmware-imx-sdma-imx7d"
MACHINE_FIRMWARE:append:mx6-nxp-bsp      = " firmware-imx-sdma-imx6q"
MACHINE_FIRMWARE:append:mx7-nxp-bsp      = " firmware-imx-sdma-imx7d"
# imx6ul7d doesn't have mx7 in MACHINEOVERRIDES but needs both imx6q and imx7d firmware

MACHINE_FIRMWARE:append:imx6ul7d = " firmware-imx-sdma-imx7d"
MACHINE_FIRMWARE:append:mx8-nxp-bsp      = " firmware-imx-sdma-imx7d"

MACHINE_FIRMWARE:append:mx6ulz-nxp-bsp = " firmware-imx-epdc"
MACHINE_FIRMWARE:append:mx8-nxp-bsp    = " linux-firmware-ath10k"
MACHINE_FIRMWARE:append:mx8qm-nxp-bsp  = " firmware-imx-hdmi firmware-imx-xuvi-imx8 sof-imx sof-zephyr zephyr-demo-imx"
MACHINE_FIRMWARE:append:mx8qxp-nxp-bsp = " sof-imx sof-zephyr zephyr-demo-imx"
MACHINE_FIRMWARE:append:mx8dx-nxp-bsp  = " sof-imx sof-zephyr"
MACHINE_FIRMWARE:append:mx8mnul-nxp-bsp = " firmware-imx-easrc-imx8mn"
MACHINE_FIRMWARE:remove:mx8mp-nxp-bsp  = "firmware-sof-imx"
MACHINE_FIRMWARE:append:mx8mp-nxp-bsp  = " sof-imx sof-zephyr zephyr-demo-imx"
MACHINE_FIRMWARE:remove:mx8mpul-nxp-bsp  = "firmware-sof-imx"
MACHINE_FIRMWARE:append:mx8mpul-nxp-bsp  = " sof-imx sof-zephyr"
MACHINE_FIRMWARE:append:mx8ulp-nxp-bsp = " sof-imx sof-zephyr firmware-ele-imx-ext"

# DPDK extra SDK
MACHINE_EXTRA_RRECOMMENDS:append = " ${@bb.utils.contains('MACHINE_FEATURES', 'dpdk', 'kernel-module-dpdk-extras', '', d)}"

# NXP WiFi firmware & extra Wlan SDK
MACHINE_EXTRA_RRECOMMENDS:append = " ${@bb.utils.contains('MACHINE_FEATURES', 'nxpiw416-sdio', 'nxp-wlan-sdk', '', d)}"
MACHINE_EXTRA_RRECOMMENDS:append = " ${@bb.utils.contains('MACHINE_FEATURES', 'nxpiw612-sdio', 'nxp-wlan-sdk', '', d)}"

MACHINE_FIRMWARE:append = " ${@bb.utils.contains('MACHINE_FEATURES', 'nxpwifi-all-sdio', 'firmware-nxp-wifi-all-sdio', '', d)}"
MACHINE_EXTRA_RRECOMMENDS:append = " ${@bb.utils.contains('MACHINE_FEATURES', 'nxpwifi-all-sdio', 'nxp-wlan-sdk kernel-module-nxp-wlan', '', d)}"

MACHINE_FIRMWARE:append = " ${@bb.utils.contains('MACHINE_FEATURES', 'nxpwifi-all-pcie', 'firmware-nxp-wifi-all-pcie', '', d)}"
MACHINE_EXTRA_RRECOMMENDS:append = " ${@bb.utils.contains('MACHINE_FEATURES', 'nxpwifi-all-pcie', 'nxp-wlan-sdk kernel-module-nxp-wlan', '', d)}"

# MCore Demo apps to /lib/firmware
MACHINE_EXTRA_RRECOMMENDS:append:mx7ulp-nxp-bsp  = " imx-m4-demos"
MACHINE_EXTRA_RRECOMMENDS:append:mx8mm-nxp-bsp   = " imx-m4-demos"
MACHINE_EXTRA_RRECOMMENDS:append:mx8mn-nxp-bsp   = " imx-m7-demos"
MACHINE_EXTRA_RRECOMMENDS:append:mx8mnul-nxp-bsp = " imx-m7-demos"
MACHINE_EXTRA_RRECOMMENDS:append:mx8mp-nxp-bsp   = " imx-m7-demos"
MACHINE_EXTRA_RRECOMMENDS:append:mx8mpul-nxp-bsp = " imx-m7-demos"
MACHINE_EXTRA_RRECOMMENDS:append:mx8mq-nxp-bsp   = " imx-m4-demos"
MACHINE_EXTRA_RRECOMMENDS:append:mx8qm-nxp-bsp   = " imx-m4-demos"
MACHINE_EXTRA_RRECOMMENDS:append:mx8qxp-nxp-bsp  = " imx-m4-demos"
MACHINE_EXTRA_RRECOMMENDS:append:mx8dx-nxp-bsp   = " imx-m4-demos"
MACHINE_EXTRA_RRECOMMENDS:append:mx8dxl-nxp-bsp  = " imx-m4-demos"
MACHINE_EXTRA_RRECOMMENDS:append:mx93-nxp-bsp    = " imx-m33-demos"
MACHINE_EXTRA_RRECOMMENDS:append:mx95-nxp-bsp    = " imx-m7-demos"

MACHINE_GSTREAMER_1_0_PLUGIN:mx6dl-nxp-bsp ?= "imx-gst1.0-plugin"
MACHINE_GSTREAMER_1_0_PLUGIN:mx6q-nxp-bsp ?= "imx-gst1.0-plugin"
MACHINE_GSTREAMER_1_0_PLUGIN:mx6sl-nxp-bsp ?= "imx-gst1.0-plugin"
MACHINE_GSTREAMER_1_0_PLUGIN:mx6sll-nxp-bsp ?= "imx-gst1.0-plugin"
MACHINE_GSTREAMER_1_0_PLUGIN:mx6sx-nxp-bsp ?= "imx-gst1.0-plugin"
MACHINE_GSTREAMER_1_0_PLUGIN:mx6ul-nxp-bsp ?= "imx-gst1.0-plugin"
MACHINE_GSTREAMER_1_0_PLUGIN:mx6ull-nxp-bsp ?= "imx-gst1.0-plugin"
MACHINE_GSTREAMER_1_0_PLUGIN:mx6ulz-nxp-bsp ?= "imx-gst1.0-plugin"
MACHINE_GSTREAMER_1_0_PLUGIN:mx7d-nxp-bsp ?= "imx-gst1.0-plugin"
MACHINE_GSTREAMER_1_0_PLUGIN:mx7ulp-nxp-bsp ?= "imx-gst1.0-plugin"
MACHINE_GSTREAMER_1_0_PLUGIN:mx8mm-nxp-bsp  ?= "imx-gst1.0-plugin"
MACHINE_GSTREAMER_1_0_PLUGIN:mx8mn-nxp-bsp  ?= "imx-gst1.0-plugin"
MACHINE_GSTREAMER_1_0_PLUGIN:mx8mp-nxp-bsp  ?= "imx-gst1.0-plugin"
MACHINE_GSTREAMER_1_0_PLUGIN:mx8mq-nxp-bsp  ?= "imx-gst1.0-plugin"
MACHINE_GSTREAMER_1_0_PLUGIN:mx8qm-nxp-bsp  ?= "imx-gst1.0-plugin"
MACHINE_GSTREAMER_1_0_PLUGIN:mx8qxp-nxp-bsp ?= "imx-gst1.0-plugin"
MACHINE_GSTREAMER_1_0_PLUGIN:mx8dx-nxp-bsp  ?= "imx-gst1.0-plugin"
MACHINE_GSTREAMER_1_0_PLUGIN:mx8-nxp-bsp ?= "imx-gst1.0-plugin"
MACHINE_GSTREAMER_1_0_PLUGIN:mx9-nxp-bsp ?= "imx-gst1.0-plugin"

IMX_DEFAULT_KERNEL:mx6ulz-nxp-bsp = "linux-imx"

OPTEE_BOOT_IMAGE:mx6-nxp-bsp ?= "tee.bin uTee-${OPTEE_BIN_EXT}"
OPTEE_BOOT_IMAGE:mx7-nxp-bsp ?= "tee.bin uTee-${OPTEE_BIN_EXT}"
OPTEE_BOOT_IMAGE:mx8-nxp-bsp ?= "tee.bin"

IMAGE_INSTALL:append = " \
    ${@bb.utils.contains('COMBINED_FEATURES', 'jailhouse', 'jailhouse', '', d)} \
    ${@bb.utils.contains('MACHINE_FEATURES', 'optee', 'packagegroup-fsl-optee-imx', '', d)} \
"

# To add a new array override for a specific upstream machine, set the
# array value with a variable, then set the default variable value to
# UNSUPPORTED and the machine-specific variable value as required.
# For example:
#   UBOOT_CONFIG[fspi] = "${UBOOT_CONFIG_FSPI}"
#   UBOOT_CONFIG_FSPI                   = "UNSUPPORTED"
#   UBOOT_CONFIG_FSPI:imx8dxl-ddr3l-evk = "${UBOOT_CONFIG_BASENAME}_fspi_defconfig"

MACHINE_FEATURES_IMX_REMOVALS ?= "mrvl8997"
MACHINE_FEATURES:remove        = "${MACHINE_FEATURES_IMX_REMOVALS}"

IMXBOOT_TARGETS:append:mx8m-nxp-bsp = \
    "${@bb.utils.contains('MACHINE_FEATURES', 'optee stmm', ' flash_evk_stmm_capsule', \
                                                            '', d)}"
IMXBOOT_TARGETS:append:mx93-nxp-bsp = \
     "${@bb.utils.contains('MACHINE_FEATURES', 'stmm', ' flash_singleboot_stmm_capsule', \
                                                             '', d)}"

# Overrides for imx6qsabresd.conf

# Overrides for imx6qpdlsolox.conf

# Overrides for imx6slevk.conf
MACHINE_FEATURES:append:imx6slevk = " optee nxpwifi-all-sdio"

# Overrides for imx6sllevk.conf
MACHINE_FEATURES:append:imx6sllevk = " optee nxpwifi-all-sdio"

# Overrides for imx6sxsabresd.conf
MACHINE_FEATURES:append:imx6sxsabresd = " optee nxpwifi-all-sdio"

# Overrides for imx6ulevk.conf
MACHINE_FEATURES:append:imx6ulevk = " optee nxpwifi-all-sdio"
KERNEL_DEVICETREE:remove:imx6ulevk = " \
    imx6ul-14x14-evk-btwifi-sdio3_0.dtb \
"
KERNEL_DEVICETREE:append:imx6ulevk = " \
    nxp/imx/imx6ul-14x14-evk-reve.dtb \
    nxp/imx/imx6ul-14x14-evk-reve-btwifi.dtb \
    nxp/imx/imx6ul-14x14-evk-reve-csi.dtb \
    nxp/imx/imx6ul-14x14-evk-reve-ecspi.dtb \
    nxp/imx/imx6ul-14x14-evk-reve-ecspi-slave.dtb \
    nxp/imx/imx6ul-14x14-evk-reve-emmc.dtb \
    nxp/imx/imx6ul-14x14-evk-reve-gpmi-weim.dtb \
"

# Overrides for imx6ullevk.conf
MACHINE_FEATURES:append:imx6ullevk = " optee nxpwifi-all-sdio"
KERNEL_DEVICETREE:append:imx6ullevk = " \
    nxp/imx/imx6ull-14x14-evk-reve.dtb \
    nxp/imx/imx6ull-14x14-evk-reve-btwifi.dtb \
    nxp/imx/imx6ull-14x14-evk-reve-emmc.dtb \
    nxp/imx/imx6ull-14x14-evk-reve-gpmi-weim.dtb \
"

# Overrides for imx6ulz-14x14-evk.conf
MACHINE_FEATURES:append:imx6ulz-14x14-evk = " optee nxpwifi-all-sdio"
KERNEL_DEVICETREE:append:imx6ulz-14x14-evk = " \
    nxp/imx/imx6ulz-14x14-evk-reve.dtb \
    nxp/imx/imx6ulz-14x14-evk-reve-btwifi.dtb \
    nxp/imx/imx6ulz-14x14-evk-reve-emmc.dtb \
    nxp/imx/imx6ulz-14x14-evk-reve-gpmi-weim.dtb \
"

# Overrides for imx6ul7d.conf

# Overrides for imx7dsabresd.conf
MACHINE_FEATURES:append:imx7dsabresd = " optee nxpwifi-all-sdio"
WKS_FILE_DEPENDS:append:imx7dsabresd = " imx-m4-demos"
IMAGE_BOOT_FILES:append:imx7dsabresd = " \
    imx7d_sabresd_m4_TCM_Pingpang.bin \
    imx7d_sabresd_m4_TCM_helloworld.bin \
    imx7d_sabresd_m4_TCM_mcctty.bin \
"

# Overrides for imx7ulpevk.conf
MACHINE_FEATURES:append:imx7ulpevk = " optee nxpwifi-all-sdio"
WKS_FILE_DEPENDS:append:imx7ulpevk = " imx-m4-demos"
IMAGE_BOOT_FILES:append:imx7ulpevk = " \
    imx7ulp_m4_demo.img \
    imx7ulp_wireless_uart_bridge.img \
    imx7ulp_erpc_matrix_multiply_rpmsg_rtos_imxcm4.img \
    imx7ulp_rpmsg_lite_pingpong_rtos.img \
    imx7ulp_rpmsg_lite_str_echo_rtos.img \
"

# Overrides for imx8mm-lpddr4-evk.conf AND imx8mmevk.conf
MACHINE_FEATURES:append:imx8mm-lpddr4-evk = " dpdk nxpwifi-all-sdio"
WKS_FILE_DEPENDS:append:imx8mm-lpddr4-evk = " imx-m4-demos"
IMAGE_BOOT_FILES:append:imx8mm-lpddr4-evk = " \
    imx8mm_m4_TCM_hello_world.bin \
    imx8mm_m4_TCM_low_power_wakeword.bin \
    imx8mm_m4_TCM_rpmsg_lite_pingpong_rtos_linux_remote.bin \
    imx8mm_m4_TCM_rpmsg_lite_str_echo_rtos.bin \
    imx8mm_m4_TCM_sai_low_power_audio.bin \
    imx8mm_m4_TCM_sai_low_power_audio_wm8524.bin \
"

# Overrides for imx8mm-ddr4-evk.conf
MACHINE_FEATURES:append:imx8mm-ddr4-evk = " dpdk nxpwifi-all-sdio"
WKS_FILE_DEPENDS:append:imx8mm-ddr4-evk = " imx-m4-demos"
IMAGE_BOOT_FILES:append:imx8mm-ddr4-evk = " \
    imx8mm_m4_TCM_hello_world.bin \
    imx8mm_m4_TCM_low_power_wakeword.bin \
    imx8mm_m4_TCM_rpmsg_lite_pingpong_rtos_linux_remote.bin \
    imx8mm_m4_TCM_rpmsg_lite_str_echo_rtos.bin \
    imx8mm_m4_TCM_sai_low_power_audio.bin \
    imx8mm_m4_TCM_sai_low_power_audio_wm8524.bin \
"

# Overrides for imx8mn-lpddr4-evk.conf AND imx8mnevk.conf
MACHINE_FEATURES:append:imx8mn-lpddr4-evk = " nxpwifi-all-sdio"
WKS_FILE_DEPENDS:append:imx8mn-lpddr4-evk = " imx-m7-demos"
IMAGE_BOOT_FILES:append:imx8mn-lpddr4-evk = " \
    imx8mn_m7_TCM_hello_world.bin \
    imx8mn_m7_TCM_rpmsg_lite_pingpong_rtos_linux_remote.bin \
    imx8mn_m7_TCM_rpmsg_lite_str_echo_rtos.bin \
    imx8mn_m7_TCM_sai_low_power_audio.bin \
"

# Overrides for imx8mn-ddr4-evk.conf
MACHINE_FEATURES:append:imx8mn-ddr4-evk = " nxpwifi-all-sdio"
WKS_FILE_DEPENDS:append:imx8mn-ddr4-evk = " imx-m7-demos"
IMAGE_BOOT_FILES:append:imx8mn-ddr4-evk = " \
    imx8mn_m7_TCM_hello_world.bin \
    imx8mn_m7_TCM_rpmsg_lite_pingpong_rtos_linux_remote.bin \
    imx8mn_m7_TCM_rpmsg_lite_str_echo_rtos.bin \
    imx8mn_m7_TCM_sai_low_power_audio.bin \
"

# Overrides for imx8mnul-ddr3l-evk.conf
MACHINE_FEATURES_IMX_REMOVALS:append:imx8mnul-ddr3l-evk = " jailhouse"
MACHINE_FEATURES:append:imx8mnul-ddr3l-evk = " nxpwifi-all-sdio"
WKS_FILE_DEPENDS:append:imx8mnul-ddr3l-evk = " imx-m7-demos"
IMAGE_BOOT_FILES:append:imx8mnul-ddr3l-evk = " \
    imx8mnddr3l_m7_TCM_hello_world.bin \
    imx8mnddr3l_m7_TCM_rpmsg_lite_pingpong_rtos_linux_remote.bin \
    imx8mnddr3l_m7_TCM_rpmsg_lite_str_echo_rtos.bin \
    imx8mnddr3l_m7_TCM_sai_low_power_audio.bin \
"

# Overrides for imx8mp-lpddr4-evk
MACHINE_FEATURES:append:imx8mp-lpddr4-evk = " optee nxpwifi-all-pcie nxpwifi-all-sdio dpdk"
WKS_FILE_DEPENDS:append:imx8mp-lpddr4-evk = " imx-m7-demos"
IMAGE_BOOT_FILES:append:imx8mp-lpddr4-evk = " \
    imx8mp_m7_TCM_hello_world.bin \
    imx8mp_m7_TCM_low_power_wakeword.bin \
    imx8mp_m7_TCM_rpmsg_lite_pingpong_rtos_linux_remote.bin \
    imx8mp_m7_TCM_rpmsg_lite_str_echo_rtos.bin \
    imx8mp_m7_TCM_sai_low_power_audio.bin \
"

# Overrides for imx8mp-ddr4-evk
MACHINE_FEATURES:append:imx8mp-ddr4-evk = " optee nxpwifi-all-pcie nxpwifi-all-sdio dpdk"
WKS_FILE_DEPENDS:append:imx8mp-ddr4-evk = " imx-m7-demos"
IMAGE_BOOT_FILES:append:imx8mp-ddr4-evk = " \
    imx8mp_m7_TCM_hello_world.bin \
    imx8mp_m7_TCM_low_power_wakeword.bin \
    imx8mp_m7_TCM_rpmsg_lite_pingpong_rtos_linux_remote.bin \
    imx8mp_m7_TCM_rpmsg_lite_str_echo_rtos.bin \
    imx8mp_m7_TCM_sai_low_power_audio.bin \
"

# Overrides for imx8mq-evk.conf
MACHINE_FEATURES:append:imx8mq-evk = " jailhouse nxpwifi-all-pcie nxpwifi-all-sdio"
WKS_FILE_DEPENDS:append:imx8mq-evk = " imx-m4-demos"
IMAGE_BOOT_FILES:append:imx8mq-evk = " \
    imx8mq_m4_TCM_hello_world.bin \
    imx8mq_m4_TCM_rpmsg_lite_pingpong_rtos_linux_remote.bin \
    imx8mq_m4_TCM_rpmsg_lite_str_echo_rtos.bin \
"

# Overrides for imx8qm-mek.conf AND imx8qmmek.conf
MACHINE_FEATURES:append:imx8qm-mek = " nxpwifi-all-pcie nxpwifi-all-sdio"
RDEPENDS:${KERNEL_PACKAGE_NAME}-image:imx8qm-mek = ""
IMXBOOT_TARGETS_SD:prepend:imx8qm-mek = \
    "${@bb.utils.contains('MACHINE_FEATURES', 'optee', 'flash_linux_m4', \
                                                       'flash_regression_linux_m4', d)} "
KERNEL_DEVICETREE:remove:imx8qm-mek = " \
    freescale/imx8qm-mek-esai.dtb \
"

KERNEL_DEVICETREE:append:imx8qm-mek = " \
    freescale/imx8qm-mek-dsi-serdes.dtb \
    freescale/imx8qm-mek-dsi-serdes-dual-display.dtb \
    freescale/imx8qm-mek-dsi-serdes-dual-display-rpmsg.dtb \
    freescale/imx8qm-mek-dsi-serdes-rpmsg.dtb \
"

# Overrides for imx8qxp-mek.conf AND imx8qxpc0mek.conf
MACHINE_FEATURES:append:imx8qm-mek = " nxpwifi-all-pcie nxpwifi-all-sdio"
RDEPENDS:${KERNEL_PACKAGE_NAME}-image:imx8qxp-mek = ""
IMXBOOT_TARGETS_SD:prepend:imx8qxp-mek = \
    "${@bb.utils.contains('MACHINE_FEATURES', 'optee', 'flash_linux_m4', \
                                                       'flash_regression_linux_m4', d)} "
KERNEL_DEVICETREE:append:imx8qxp-mek = " \
     freescale/imx8qxp-mek-sof-wm8962.dtb \
"

# Overrides for imx8dxla1-lpddr4-evk.conf AND imx8dxlevk.conf
MACHINE_FEATURES:append:imx8dxla1-lpddr4-evk = " nxpwifi-all-sdio"
RDEPENDS:${KERNEL_PACKAGE_NAME}-image:imx8dxla1-lpddr4-evk = ""
IMXBOOT_TARGETS_SD:prepend:imx8dxla1-lpddr4-evk = \
    "${@bb.utils.contains('MACHINE_FEATURES', 'optee', 'flash_linux_m4 flash_linux_m4_no_v2x ', \
                                                       'flash_regression_linux_m4', d)} "

# Overrides for imx8dxl-a1-lpddr4-evk.conf
MACHINE_FEATURES:append:imx8dxl-a1-lpddr4-evk = " nxpwifi-all-sdio"
RDEPENDS:${KERNEL_PACKAGE_NAME}-image:imx8dxl-a1-lpddr4-evk = ""
IMXBOOT_TARGETS_SD:prepend:imx8dxl-a1-lpddr4-evk = \
    "${@bb.utils.contains('MACHINE_FEATURES', 'optee', 'flash_linux_m4 flash_linux_m4_no_v2x ', \
                                                       'flash_regression_linux_m4', d)} "

# Overrides for imx8dxlb0-fips-lpddr4-evk.conf
MACHINE_FEATURES:append:imx8dxlb0-fips-lpddr4-evk = " nxpwifi-all-sdio"
RDEPENDS:${KERNEL_PACKAGE_NAME}-image:imx8dxlb0-fips-lpddr4-evk = ""
IMXBOOT_TARGETS_SD:prepend:imx8dxlb0-fips-lpddr4-evk = \
    "${@bb.utils.contains('MACHINE_FEATURES', 'optee', 'flash_linux_m4 flash_linux_m4_no_v2x ', \
                                                       'flash_regression_linux_m4', d)} "

# Overrides for imx8dxl-b0-fips-lpddr4-evk.conf
MACHINE_FEATURES:append:imx8dxl-b0-fips-lpddr4-evk = " nxpwifi-all-sdio"
RDEPENDS:${KERNEL_PACKAGE_NAME}-image:imx8dxl-b0-fips-lpddr4-evk = ""
IMXBOOT_TARGETS_SD:prepend:imx8dxl-b0-fips-lpddr4-evk = \
    "${@bb.utils.contains('MACHINE_FEATURES', 'optee', 'flash_linux_m4 flash_linux_m4_no_v2x ', \
                                                       'flash_regression_linux_m4', d)} "

# Overrides for imx8dxlb0-lpddr4-evk.conf
MACHINE_FEATURES:append:imx8dxlb0-lpddr4-evk = " nxpwifi-all-sdio"
RDEPENDS:${KERNEL_PACKAGE_NAME}-image:imx8dxlb0-lpddr4-evk = ""
IMXBOOT_TARGETS_SD:prepend:imx8dxlb0-lpddr4-evk = \
    "${@bb.utils.contains('MACHINE_FEATURES', 'optee', 'flash_linux_m4 flash_linux_m4_no_v2x ', \
                                                       'flash_regression_linux_m4', d)} "

# Overrides for imx8dxl-b0-lpddr4-evk.conf
MACHINE_FEATURES:append:imx8dxl-b0-lpddr4-evk = " nxpwifi-all-sdio"
RDEPENDS:${KERNEL_PACKAGE_NAME}-image:imx8dxl-b0-lpddr4-evk = ""
IMXBOOT_TARGETS_SD:prepend:imx8dxl-b0-lpddr4-evk = \
    "${@bb.utils.contains('MACHINE_FEATURES', 'optee', 'flash_linux_m4 flash_linux_m4_no_v2x ', \
                                                       'flash_regression_linux_m4', d)} "

# Overrides for imx8dxla1-ddr3l-evk.conf
MACHINE_FEATURES:append:imx8dxla1-ddr3l-evk = " nxpwifi-all-sdio"
RDEPENDS:${KERNEL_PACKAGE_NAME}-image:imx8dxla1-ddr3l-evk = ""
IMXBOOT_TARGETS_SD:prepend:imx8dxla1-ddr3l-evk = \
    "${@bb.utils.contains('MACHINE_FEATURES', 'optee', 'flash_linux_m4 flash_linux_m4_no_v2x', \
                                                       'flash_regression_linux_m4', d)} "

# Overrides for imx8dxl-a1-ddr3l-evk.conf
MACHINE_FEATURES:append:imx8dxl-a1-ddr3l-evk = " nxpwifi-all-sdio"
RDEPENDS:${KERNEL_PACKAGE_NAME}-image:imx8dxl-a1-ddr3l-evk = ""
IMXBOOT_TARGETS_SD:prepend:imx8dxl-a1-ddr3l-evk = \
    "${@bb.utils.contains('MACHINE_FEATURES', 'optee', 'flash_linux_m4 flash_linux_m4_no_v2x', \
                                                       'flash_regression_linux_m4', d)} "

# Overrides for imx8dxlb0-ddr3l-evk.conf
MACHINE_FEATURES:append:imx8dxlb0-ddr3l-evk = " nxpwifi-all-sdio"
RDEPENDS:${KERNEL_PACKAGE_NAME}-image:imx8dxlb0-ddr3l-evk = ""
IMXBOOT_TARGETS_SD:prepend:imx8dxlb0-ddr3l-evk = \
    "${@bb.utils.contains('MACHINE_FEATURES', 'optee', 'flash_linux_m4 flash_linux_m4_no_v2x', \
                                                       'flash_regression_linux_m4', d)} "

# Overrides for imx8dxl-b0-ddr3l-evk.conf
MACHINE_FEATURES:append:imx8dxl-b0-ddr3l-evk = " nxpwifi-all-sdio"
RDEPENDS:${KERNEL_PACKAGE_NAME}-image:imx8dxl-b0-ddr3l-evk = ""
IMXBOOT_TARGETS_SD:prepend:imx8dxl-b0-ddr3l-evk = \
    "${@bb.utils.contains('MACHINE_FEATURES', 'optee', 'flash_linux_m4 flash_linux_m4_no_v2x', \
                                                       'flash_regression_linux_m4', d)} "

# Overrides for imx8ulp-lpddr4-evk.conf
MACHINE_FEATURES:append:imx8ulp-lpddr4-evk = " soc-reva2 nxpwifi-all-sdio"
MACHINE_FEATURES:remove:imx8ulp-lpddr4-evk = " soc-reva1"
IMXBOOT_TARGETS_SD:imx8ulp-lpddr4-evk   = "flash_singleboot_m33 flash_singleboot flash_dualboot_m33 flash_dualboot"
IMXBOOT_TARGETS_FSPI:imx8ulp-lpddr4-evk = "flash_singleboot_m33_flexspi flash_dualboot_flexspi"
IMXBOOT_TARGETS_ND:imx8ulp-lpddr4-evk   = "flash_singleboot_m33"

# Overrides for imx8ulp-9x9-lpddr4-evk.conf
MACHINE_FEATURES:append:imx8ulp-9x9-lpddr4-evk = " soc-reva2 nxpwifi-all-sdio"
MACHINE_FEATURES:remove:imx8ulp-9x9-lpddr4-evk = " soc-reva1"
IMXBOOT_TARGETS_SD:imx8ulp-9x9-lpddr4-evk   = "flash_singleboot_m33 flash_singleboot flash_dualboot_m33 flash_dualboot"
IMXBOOT_TARGETS_FSPI:imx8ulp-9x9-lpddr4-evk = "flash_singleboot_m33_flexspi flash_dualboot_flexspi"
IMXBOOT_TARGETS_ND:imx8ulp-9x9-lpddr4-evk   = "flash_singleboot_m33"

# Overrides for imx93-9x9-lpddr4-qsb.conf
MACHINE_FEATURES:append:imx93-9x9-lpddr4-qsb = " dpdk nxpwifi-all-sdio"
MACHINE_FIRMWARE:append:imx93-9x9-lpddr4-qsb = " ethos-u-firmware"
WKS_FILE_DEPENDS:append:imx93-9x9-lpddr4-qsb = " imx-m33-demos"
IMAGE_BOOT_FILES:append:imx93-9x9-lpddr4-qsb = " \
    imx93-9x9-qsb_m33_TCM_power_mode_switch.bin \
    imx93-9x9-qsb_m33_TCM_low_power_wakeword.bin \
    imx93-9x9-qsb_m33_TCM_rpmsg_lite_pingpong_rtos_linux_remote.bin \
    imx93-9x9-qsb_m33_TCM_rpmsg_lite_str_echo_rtos.bin \
    imx93-9x9-qsb_m33_TCM_sai_low_power_audio.bin \
"

# Overrides for imx93-11x11-lpddr4x-evk.conf AND imx93evk.conf
MACHINE_FEATURES:append:imx93-11x11-lpddr4x-evk = " dpdk nxpwifi-all-sdio"
MACHINE_FIRMWARE:append:imx93-11x11-lpddr4x-evk = " ethos-u-firmware"
WKS_FILE_DEPENDS:append:imx93-11x11-lpddr4x-evk = " imx-m33-demos"
IMAGE_BOOT_FILES:append:imx93-11x11-lpddr4x-evk = " \
    imx93-11x11-evk_m33_TCM_low_power_wakeword.bin \
    imx93-11x11-evk_m33_TCM_power_mode_switch.bin \
    imx93-11x11-evk_m33_TCM_rpmsg_lite_pingpong_rtos_linux_remote.bin \
    imx93-11x11-evk_m33_TCM_rpmsg_lite_str_echo_rtos.bin \
    imx93-11x11-evk_m33_TCM_sai_low_power_audio.bin \
"
KERNEL_DEVICETREE:append:imx93-11x11-lpddr4x-evk = " \
    freescale/imx93-11x11-evk-ld.dtb \
    freescale/imx93-11x11-evk-rpmsg.dtb \
    freescale/imx93-11x11-evk-rpmsg-lpv.dtb \
"

# Overrides for imx93-14x14-lpddr4x-evk.conf
MACHINE_FEATURES:append:imx93-14x14-lpddr4x-evk = " dpdk nxpwifi-all-sdio"
MACHINE_FIRMWARE:append:imx93-14x14-lpddr4x-evk = " ethos-u-firmware"
WKS_FILE_DEPENDS:append:imx93-14x14-lpddr4x-evk = " imx-m33-demos"
IMAGE_BOOT_FILES:append:imx93-14x14-lpddr4x-evk = " \
    imx93-14x14-evk_m33_TCM_power_mode_switch.bin \
    imx93-14x14-evk_m33_TCM_rpmsg_lite_pingpong_rtos_linux_remote.bin \
    imx93-14x14-evk_m33_TCM_rpmsg_lite_str_echo_rtos.bin \
"
KERNEL_DEVICETREE:remove:imx93-14x14-lpddr4x-evk = " \
    freescale/imx93-14x14-evk-mqs.dtb \
    freescale/${KERNEL_DEVICETREE_BASENAME}-lvds-it6263.dtb \
"
KERNEL_DEVICETREE:append:imx93-14x14-lpddr4x-evk = " \
    freescale/${KERNEL_DEVICETREE_BASENAME}-dsi-serdes.dtb \
    freescale/${KERNEL_DEVICETREE_BASENAME}-flexspi-m2.dtb \
    freescale/${KERNEL_DEVICETREE_BASENAME}-i3c.dtb \
    freescale/${KERNEL_DEVICETREE_BASENAME}-sja1105.dtb \
"
```
