## meta-imx-bsp/conf/machine/imx7d12x12lpddr3arm2.conf
```bitbake
#@TYPE: Machine
#@NAME: NXP i.MX7D 12x12 LPDDR3 ARM2 Evaluation Kit
#@SOC: i.MX7D
#@DESCRIPTION: Machine configuration for NXP i.MX7D 12x12 LPDDR3 ARM2 Evaluation Kit
#@MAINTAINER: Lauren Post <Lauren.Post@nxp.com>

MACHINEOVERRIDES =. "mx7:mx7d:"

require conf/machine/include/imx-base.inc
require conf/machine/include/arm/armv7a/tune-cortexa7.inc

MACHINE_FEATURES += " pci wifi bluetooth"

KERNEL_DEVICETREE = " \
    nxp/imx/imx7d-12x12-lpddr3-arm2.dtb \
    nxp/imx/imx7d-12x12-lpddr3-arm2-ecspi.dtb \
    nxp/imx/imx7d-12x12-lpddr3-arm2-enet2.dtb \
    nxp/imx/imx7d-12x12-lpddr3-arm2-flexcan.dtb \
    nxp/imx/imx7d-12x12-lpddr3-arm2-m4.dtb \
    nxp/imx/imx7d-12x12-lpddr3-arm2-mipi_dsi.dtb \
    nxp/imx/imx7d-12x12-lpddr3-arm2-mqs.dtb \
    nxp/imx/imx7d-12x12-lpddr3-arm2-pcie.dtb \
    nxp/imx/imx7d-12x12-lpddr3-arm2-qspi.dtb \
    nxp/imx/imx7d-12x12-lpddr3-arm2-sai.dtb \
"

UBOOT_CONFIG ??= "sd"
UBOOT_CONFIG[sd] = "mx7d_12x12_lpddr3_val_config,sdcard"
UBOOT_CONFIG[epdc] = "mx7d_12x12_lpddr3_val_config"
UBOOT_CONFIG[qspi1] = "mx7d_12x12_lpddr3_val_qspi1_config"
UBOOT_CONFIG[spinor] = "mx7d_12x12_lpddr3_val_spinor_config"
```
