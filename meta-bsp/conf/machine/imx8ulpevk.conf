## meta-imx-bsp/conf/machine/imx8_all.conf
```bitbake
#@TYPE: Machine
#@NAME: i.MX 8 Common rootfs machine
#@SOC: i.MX 8QM and 8QXP
#@DESCRIPTION: Machine configuration for i.MX 8QM and 8QXP boards
#@MAINTAINER: Jun Zhu <junzhu@nxp.com>

MACHINEOVERRIDES =. "mx8:mx8qm:"

require conf/machine/include/imx-base.inc
require conf/machine/include/arm/armv8a/tune-cortexa72-cortexa53.inc

MACHINE_FEATURES:append = " optee bcm43455 bcm4356 bcm4359"

# Don't include kernels in standard images
RDEPENDS:${KERNEL_PACKAGE_NAME}-base = ""
RDEPENDS:${KERNEL_PACKAGE_NAME}-image = ""

LOADADDR = ""

# Disable the serial console due to auto-serial-console
SERIAL_CONSOLES = "115200;ttyAMA0"

# we do not want to have getty running on tty1 as we run
# auto-serial-console there
USE_VT = "0"

# DEVICETREE of i.MX 8MM
KERNEL_DEVICETREE = "freescale/imx8mm-evk.dtb freescale/imx8mm-evk-ak4497.dtb freescale/imx8mm-evk-ak5558.dtb \
                     freescale/imx8mm-evk-audio-tdm.dtb \
                     freescale/imx8mm-evk-dpdk.dtb \
                     freescale/imx8mm-evk-ecspi-slave.dtb \
                     freescale/imx8mm-evk-inmate.dtb \
                     freescale/imx8mm-evk-lk.dtb \
                     freescale/imx8mm-evk-pcie-ep.dtb \
                     freescale/imx8mm-evk-rm67191.dtb \
                     freescale/imx8mm-evk-rm67191-cmd-ram.dtb \
                     freescale/imx8mm-evk-rm67199.dtb \
                     freescale/imx8mm-evk-rm67199-cmd-ram.dtb \
                     freescale/imx8mm-evk-root.dtb \
                     freescale/imx8mm-evk-rpmsg.dtb \
                     freescale/imx8mm-evk-rpmsg-wm8524.dtb \
                     freescale/imx8mm-evk-rpmsg-wm8524-lpv.dtb \
                     freescale/imx8mm-evk-usd-wifi.dtb \
                     freescale/imx8mm-evk-8mic-revE.dtb freescale/imx8mm-evk-8mic-swpdm.dtb \
                     freescale/imx8mm-evk-qca-wifi.dtb freescale/imx8mm-evk-revb-qca-wifi.dtb \
                     freescale/imx8mm-ddr4-evk.dtb \
                     freescale/imx8mm-ddr4-evk-pcie-ep.dtb \
                     freescale/imx8mm-ddr4-evk-rm67191.dtb \
                     freescale/imx8mm-ddr4-evk-rm67191-cmd-ram.dtb \
                     freescale/imx8mm-ddr4-evk-rm67199.dtb \
                     freescale/imx8mm-ddr4-evk-rm67199-cmd-ram.dtb \
                     freescale/imx8mm-ddr4-evk-revb.dtb \
                     freescale/imx8mm-ddr4-evk-revb-rm67191.dtb \
                     freescale/imx8mm-ddr4-evk-revb-rm67191-cmd-ram.dtb \
                     freescale/imx8mm-ddr4-evk-revb-rm67199.dtb \
                     freescale/imx8mm-ddr4-evk-revb-rm67199-cmd-ram.dtb \
"

# DEVICETREE of i.MX 8MN
KERNEL_DEVICETREE += "freescale/imx8mn-evk.dtb freescale/imx8mn-evk-ak5558.dtb \
                     freescale/imx8mn-evk-inmate.dtb freescale/imx8mn-evk-lk.dtb \
                     freescale/imx8mn-evk-rm67191.dtb \
                     freescale/imx8mn-evk-rm67191-cmd-ram.dtb \
                     freescale/imx8mn-evk-rm67199.dtb \
                     freescale/imx8mn-evk-rm67199-cmd-ram.dtb \
                     freescale/imx8mn-evk-root.dtb freescale/imx8mn-evk-rpmsg.dtb \
                     freescale/imx8mn-evk-usd-wifi.dtb \
                     freescale/imx8mn-evk-8mic-revE.dtb \
                     freescale/imx8mn-evk-8mic-swpdm.dtb \
                     freescale/imx8mn-ddr4-evk-ak5558.dtb \
                     freescale/imx8mn-ddr4-evk-lk.dtb \
                     freescale/imx8mn-ddr4-evk-rm67191.dtb \
                     freescale/imx8mn-ddr4-evk-rm67191-cmd-ram.dtb \
                     freescale/imx8mn-ddr4-evk-rm67199.dtb \
                     freescale/imx8mn-ddr4-evk-rm67199-cmd-ram.dtb \
                     freescale/imx8mn-ddr4-evk-rpmsg.dtb \
                     freescale/imx8mn-ddr4-evk-usd-wifi.dtb \
                     freescale/imx8mn-ddr4-evk.dtb \
                     freescale/imx8mn-ddr3l-evk.dtb \
                     freescale/imx8mn-ddr3l-evk-ak5558.dtb \
                     freescale/imx8mn-ddr3l-evk-rpmsg.dtb \
"

# DEVICETREE of i.MX 8MQ
KERNEL_DEVICETREE += "freescale/imx8mq-evk-ak4497.dtb freescale/imx8mq-evk-audio-tdm.dtb \
                     freescale/imx8mq-evk-dcss-adv7535.dtb freescale/imx8mq-evk-dcss-rm67191.dtb \
                     freescale/imx8mq-evk-dcss-rm67199.dtb \
                     freescale/imx8mq-evk-dual-display.dtb \
                     freescale/imx8mq-evk-dp.dtb freescale/imx8mq-evk-inmate.dtb \
                     freescale/imx8mq-evk-lcdif-adv7535.dtb freescale/imx8mq-evk-lcdif-rm67191.dtb \
                     freescale/imx8mq-evk-lcdif-rm67199.dtb \
                     freescale/imx8mq-evk-pcie1-m2.dtb freescale/imx8mq-evk-pcie-ep.dtb \
                     freescale/imx8mq-evk-pdm.dtb \
                     freescale/imx8mq-evk-root.dtb freescale/imx8mq-evk-rpmsg.dtb \
                     freescale/imx8mq-evk-usdhc2-m2.dtb freescale/imx8mq-evk-usd-wifi.dtb \
                     freescale/imx8mq-evk.dtb \
"

# DEVICETREE of i.MX 8MP
KERNEL_DEVICETREE += " \
                     freescale/imx8mp-ab2.dtb \
                     freescale/imx8mp-ddr4-evk.dtb \
                     freescale/imx8mp-evk.dtb \
                     freescale/imx8mp-evk-basler.dtb freescale/imx8mp-evk-basler-ov2775.dtb freescale/imx8mp-evk-basler-ov5640.dtb \
                     freescale/imx8mp-evk-dpdk.dtb \
                     freescale/imx8mp-evk-dsp.dtb \
                     freescale/imx8mp-evk-dual-basler.dtb freescale/imx8mp-evk-dual-ov2775.dtb \
                     freescale/imx8mp-evk-dual-os08a20.dtb \
                     freescale/imx8mp-evk-ecspi-slave.dtb \
                     freescale/imx8mp-evk-flexcan2.dtb freescale/imx8mp-evk-inmate.dtb \
                     freescale/imx8mp-evk-jdi-wuxga-lvds-panel.dtb \
                     freescale/imx8mp-evk-it6263-lvds-dual-channel.dtb \
                     freescale/imx8mp-evk-ndm.dtb \
                     freescale/imx8mp-evk-os08a20.dtb \
                     freescale/imx8mp-evk-os08a20-ov5640.dtb \
                     freescale/imx8mp-evk-ov2775.dtb freescale/imx8mp-evk-ov2775-ov5640.dtb \
                     freescale/imx8mp-evk-pcie-ep.dtb \
                     freescale/imx8mp-evk-revA3-8mic-revE.dtb \
                     freescale/imx8mp-evk-rm67191.dtb \
                     freescale/imx8mp-evk-rm67199.dtb \
                     freescale/imx8mp-evk-root.dtb \
                     freescale/imx8mp-evk-rpmsg.dtb \
                     freescale/imx8mp-evk-rpmsg-lpv.dtb \
                     freescale/imx8mp-evk-sof-wm8960.dtb freescale/imx8mp-evk-spdif-lb.dtb \
                     freescale/imx8mp-evk-usdhc1-m2.dtb \
                     freescale/imx8mp-evk-8mic-swpdm.dtb \
                     freescale/imx8mp-evk-sof-pdm.dtb \
"

# DEVICETREE of i.MX 8QM
KERNEL_DEVICETREE += "freescale/imx8qm-mek.dtb \
                     freescale/imx8qm-mek-ca53.dtb freescale/imx8qm-mek-ca72.dtb \
                     freescale/imx8qm-mek-dsi-rm67191.dtb \
                     freescale/imx8qm-mek-dsi-rm67199.dtb \
                     freescale/imx8qm-mek-dsi-serdes.dtb \
                     freescale/imx8qm-mek-dsi-serdes-dual-display.dtb \
                     freescale/imx8qm-mek-dsi-serdes-dual-display-rpmsg.dtb \
                     freescale/imx8qm-mek-dsi-serdes-rpmsg.dtb \
                     freescale/imx8qm-mek-enet2-tja1100.dtb \
                     freescale/imx8qm-mek-hdmi.dtb \
                     freescale/imx8qm-mek-hdmi-rx.dtb \
                     freescale/imx8qm-mek-hdmi-rx-ov5640.dtb \
                     freescale/imx8qm-mek-jdi-wuxga-lvds1-panel.dtb \
                     freescale/imx8qm-mek-jdi-wuxga-lvds1-panel-rpmsg.dtb \
                     freescale/imx8qm-mek-ov5640.dtb \
                     freescale/imx8qm-mek-pcie-ep.dtb \
                     freescale/imx8qm-mek-rpmsg.dtb \
                     freescale/imx8qm-mek-sof-cs42888.dtb freescale/imx8qm-mek-sof-wm8960.dtb \
                     freescale/imx8qm-pcieax2pciebx1.dtb \
                     freescale/imx8qm-mek-usd-wifi.dtb freescale/imx8qm-mek-usdhc3-m2.dtb \
                     freescale/imx8qm-mek-sof.dtb \
                     freescale/imx8qm-mek-revd-ca53.dtb \
                     freescale/imx8qm-mek-revd-ca72.dtb \
                     freescale/imx8qm-mek-revd-dsi-rm67191.dtb \
                     freescale/imx8qm-mek-revd-dsi-rm67199.dtb \
                     freescale/imx8qm-mek-revd.dtb \
                     freescale/imx8qm-mek-revd-enet2-tja1100.dtb \
                     freescale/imx8qm-mek-revd-hdmi.dtb \
                     freescale/imx8qm-mek-revd-hdmi-rx.dtb \
                     freescale/imx8qm-mek-revd-hdmi-rx-ov5640.dtb \
                     freescale/imx8qm-mek-revd-jdi-wuxga-lvds1-panel.dtb \
                     freescale/imx8qm-mek-revd-jdi-wuxga-lvds1-panel-rpmsg.dtb \
                     freescale/imx8qm-mek-revd-ov5640.dtb \
                     freescale/imx8qm-mek-revd-pcie-ep.dtb \
                     freescale/imx8qm-mek-revd-root.dtb \
                     freescale/imx8qm-mek-revd-rpmsg.dtb \
                     freescale/imx8qm-mek-revd-sof-wm8962.dtb \
                     freescale/imx8qm-mek-revd-usdhc3-m2.dtb \
                     freescale/imx8qm-mek-revd-usd-wifi.dtb \
"

# DEVICETREE of i.MX 8QM Validation
KERNEL_DEVICETREE += "freescale/imx8qm-lpddr4-val.dtb \
                     freescale/imx8qm-lpddr4-val-ca53.dtb freescale/imx8qm-lpddr4-val-ca72.dtb \
                     freescale/imx8qm-lpddr4-val-lpspi.dtb freescale/imx8qm-lpddr4-val-lpspi-slave.dtb \
                     freescale/imx8qm-lpddr4-val-mqs.dtb freescale/imx8qm-lpddr4-val-spdif.dtb \
                     freescale/imx8qm-lpddr4-val-dp.dtb \
"

# DEVICETREE of i.MX 8QXP
KERNEL_DEVICETREE += "freescale/imx8qxp-mek.dtb freescale/imx8qxp-mek-a0.dtb \
                     freescale/imx8qxp-mek-dpu-lcdif.dtb \
                     freescale/imx8qxp-mek-dpu-lcdif-rpmsg.dtb \
                     freescale/imx8qxp-mek-dsi-rm67191.dtb freescale/imx8qxp-mek-dsi-rm67191-rpmsg.dtb \
                     freescale/imx8qxp-mek-dsi-rm67199.dtb \
                     freescale/imx8qxp-mek-dsi-rm67199-rpmsg.dtb \
                     freescale/imx8qxp-mek-enet2-tja1100.dtb freescale/imx8qxp-mek-enet2.dtb \
                     freescale/imx8qxp-mek-it6263-lvds0-dual-channel.dtb freescale/imx8qxp-mek-it6263-lvds0-dual-channel-rpmsg.dtb \
                     freescale/imx8qxp-mek-it6263-lvds1-dual-channel.dtb freescale/imx8qxp-mek-it6263-lvds1-dual-channel-rpmsg.dtb \
                     freescale/imx8qxp-mek-jdi-wuxga-lvds0-panel.dtb freescale/imx8qxp-mek-jdi-wuxga-lvds0-panel-rpmsg.dtb \
                     freescale/imx8qxp-mek-jdi-wuxga-lvds1-panel.dtb freescale/imx8qxp-mek-jdi-wuxga-lvds1-panel-rpmsg.dtb \
                     freescale/imx8qxp-mek-lcdif.dtb freescale/imx8qxp-mek-lcdif-rpmsg.dtb \
                     freescale/imx8qxp-mek-ov5640.dtb \
                     freescale/imx8qxp-mek-ov5640-rpmsg.dtb \
                     freescale/imx8qxp-mek-pcie-ep.dtb \
                     freescale/imx8qxp-mek-rpmsg.dtb freescale/imx8qxp-mek-sof-cs42888.dtb freescale/imx8qxp-mek-sof-wm8960.dtb \
                     freescale/imx8qxp-mek-sof-wm8962.dtb \
                     freescale/imx8qxp-mek-sof.dtb \
"

# DEVICETREE of i.MX 8QXP Validation
KERNEL_DEVICETREE += "freescale/imx8qxp-lpddr4-val.dtb \
                     freescale/imx8qxp-lpddr4-val-a0.dtb freescale/imx8qxp-lpddr4-val-gpmi-nand.dtb \
                     freescale/imx8qxp-lpddr4-val-lpspi.dtb freescale/imx8qxp-lpddr4-val-lpspi-slave.dtb \
                     freescale/imx8qxp-lpddr4-val-mqs.dtb freescale/imx8qxp-lpddr4-val-spdif.dtb \
"

# DEVICETREE of i.MX 8DXL
KERNEL_DEVICETREE += "freescale/imx8dxl-evk.dtb \
                      freescale/imx8dxl-evk-enet0.dtb freescale/imx8dxl-evk-enet0-tja1100.dtb \
                      freescale/imx8dxl-evk-lcdif.dtb freescale/imx8dxl-evk-lpspi-slave.dtb \
                      freescale/imx8dxl-evk-pcie-ep.dtb \
                      freescale/imx8dxl-evk-rpmsg.dtb"

# DEVICETREE of i.MX 8DXL DDR3 EVK Board
KERNEL_DEVICETREE += "freescale/imx8dxl-ddr3l-evk.dtb freescale/imx8dxl-ddr3l-evk-rpmsg.dtb"

# DEVICETREE of i.MX 8DX
KERNEL_DEVICETREE += " \
    freescale/imx8dx-mek.dtb \
    freescale/imx8dx-mek-dsi-rm67191.dtb freescale/imx8dx-mek-dsi-rm67191-rpmsg.dtb \
    freescale/imx8dx-mek-enet2-tja1100.dtb \
    freescale/imx8dx-mek-it6263-lvds0-dual-channel.dtb freescale/imx8dx-mek-it6263-lvds0-dual-channel-rpmsg.dtb \
    freescale/imx8dx-mek-it6263-lvds1-dual-channel.dtb freescale/imx8dx-mek-it6263-lvds1-dual-channel-rpmsg.dtb \
    freescale/imx8dx-mek-jdi-wuxga-lvds0-panel.dtb freescale/imx8dx-mek-jdi-wuxga-lvds0-panel-rpmsg.dtb \
    freescale/imx8dx-mek-jdi-wuxga-lvds1-panel.dtb freescale/imx8dx-mek-jdi-wuxga-lvds1-panel-rpmsg.dtb \
    freescale/imx8dx-mek-ov5640.dtb freescale/imx8dx-mek-ov5640-rpmsg.dtb \
    freescale/imx8dx-mek-rpmsg.dtb \
"

# DEVICETREE of i.MX 8ULP
KERNEL_DEVICETREE += " \
    freescale/imx8ulp-evk.dtb \
    freescale/imx8ulp-evk-epdc.dtb \
    freescale/imx8ulp-evk-flexio-i2c.dtb \
    freescale/imx8ulp-evk-i3c.dtb \
    freescale/imx8ulp-evk-lpa.dtb \
    freescale/imx8ulp-evk-lpspi-slave.dtb \
    freescale/imx8ulp-evk-nd.dtb \
    freescale/imx8ulp-evk-rk055hdmipi4m.dtb \
    freescale/imx8ulp-evk-rk055hdmipi4mv2.dtb \
    freescale/imx8ulp-evk-sof-btsco.dtb \
    freescale/imx8ulp-9x9-evk.dtb \
    freescale/imx8ulp-9x9-evk-i3c.dtb \
    freescale/imx8ulp-9x9-evk-lpa.dtb \
    freescale/imx8ulp-9x9-evk-lpspi.dtb \
    freescale/imx8ulp-9x9-evk-lpspi-slave.dtb \
    freescale/imx8ulp-9x9-evk-sof-btsco.dtb \
    freescale/imx8ulp-9x9-evk-rk055hdmipi4m.dtb \
    freescale/imx8ulp-9x9-evk-rk055hdmipi4mv2.dtb \
"
# DEVICETREE of i.MX 93
KERNEL_DEVICETREE += "freescale/imx93-11x11-evk.dtb \
                      freescale/imx93-11x11-evk-aud-hat.dtb \
                      freescale/imx93-11x11-evk-boe-wxga-lvds-panel.dtb \
                      freescale/imx93-11x11-evk-flexio-i2c.dtb \
                      freescale/imx93-11x11-evk-flexspi-m2.dtb \
                      freescale/imx93-11x11-evk-inmate.dtb \
                      freescale/imx93-11x11-evk-i3c.dtb \
                      freescale/imx93-11x11-evk-ld.dtb \
                      freescale/imx93-11x11-evk-lpspi-slave.dtb \
                      freescale/imx93-11x11-evk-lpspi.dtb \
                      freescale/imx93-11x11-evk-lpuart.dtb \
                      freescale/imx93-11x11-evk-mqs.dtb \
                      freescale/imx93-11x11-evk-mt9m114.dtb \
                      freescale/imx93-11x11-evk-root.dtb \
                      freescale/imx93-11x11-evk-rm67199.dtb \
                      freescale/imx93-11x11-evk-rpmsg.dtb \
                      freescale/imx93-11x11-evk-rpmsg-lpv.dtb \
                      freescale/imx93-11x11-evk-pmic-pf0900.dtb \
                      freescale/imx93-11x11-evk-pmic-pf0900-aud-hat.dtb \
                      freescale/imx93-11x11-evk-pmic-pf0900-boe-wxga-lvds-panel.dtb \
                      freescale/imx93-11x11-evk-pmic-pf0900-flexio-i2c.dtb \
                      freescale/imx93-11x11-evk-pmic-pf0900-flexspi-m2.dtb \
                      freescale/imx93-11x11-evk-pmic-pf0900-i3c.dtb \
                      freescale/imx93-11x11-evk-pmic-pf0900-ld.dtb \
                      freescale/imx93-11x11-evk-pmic-pf0900-lpspi.dtb \
                      freescale/imx93-11x11-evk-pmic-pf0900-lpspi-slave.dtb \
                      freescale/imx93-11x11-evk-pmic-pf0900-lpuart.dtb \
                      freescale/imx93-11x11-evk-pmic-pf0900-mqs.dtb \
                      freescale/imx93-11x11-evk-pmic-pf0900-mt9m114.dtb \
                      freescale/imx93-11x11-evk-pmic-pf0900-rm67199.dtb \
                      freescale/imx93-11x11-evk-pmic-pf0900-root.dtb \
                      freescale/imx93-11x11-evk-pmic-pf0900-rpmsg.dtb \
                      freescale/imx93-11x11-evk-pmic-pf0900-rpmsg-lpv.dtb \
                      freescale/imx93-14x14-evk.dtb \
                      freescale/imx93-14x14-evk-aud-hat.dtb \
                      freescale/imx93-14x14-evk-dsi-serdes.dtb \
                      freescale/imx93-14x14-evk-flexspi-m2.dtb \
                      freescale/imx93-14x14-evk-i3c.dtb \
                      freescale/imx93-14x14-evk-lvds-it6263.dtb \
                      freescale/imx93-14x14-evk-mqs.dtb \
                      freescale/imx93-14x14-evk-tja1103.dtb \
                      freescale/imx93-14x14-evk-rm67199.dtb \
                      freescale/imx93-14x14-evk-sja1105.dtb \
                      freescale/imx93-9x9-qsb.dtb \
                      freescale/imx93-9x9-qsb-ld.dtb \
                      freescale/imx93-9x9-qsb-aud-hat.dtb \
                      freescale/imx93-9x9-qsb-can1.dtb \
                      freescale/imx93-9x9-qsb-flexspi-m2.dtb \
                      freescale/imx93-9x9-qsb-i3c.dtb \
                      freescale/imx93-9x9-qsb-lpspi.dtb \
                      freescale/imx93-9x9-qsb-lpspi-slave.dtb \
                      freescale/imx93-9x9-qsb-mt9m114.dtb \
                      freescale/imx93-9x9-qsb-ontat-wvga-panel.dtb \
                      freescale/imx93-9x9-qsb-rpmsg.dtb \
                      freescale/imx93-9x9-qsb-rpmsg-lpv.dtb \
"

# DEVICETREE of i.MX 91p
# Not supported by 6.6 kernel
KERNEL_DEVICETREE_NOT_SUPPORTED += "freescale/imx91p-11x11-evk.dtb \
                      freescale/imx91p-11x11-evk-aud-hat.dtb \
                      freescale/imx91p-11x11-evk-flexspi-m2.dtb \
                      freescale/imx91p-11x11-evk-i3c.dtb \
                      freescale/imx91p-11x11-evk-ld.dtb \
                      freescale/imx91p-11x11-evk-lpspi.dtb \
                      freescale/imx91p-11x11-evk-lpspi-slave.dtb \
                      freescale/imx91p-11x11-evk-mqs.dtb \
                      freescale/imx91p-11x11-evk-mt9m114.dtb \
                      freescale/imx91p-11x11-evk-ontat-wvga-panel.dtb \
                      freescale/imx91p-9x9-qsb.dtb \
                      freescale/imx91p-9x9-qsb-aud-hat.dtb \
                      freescale/imx91p-9x9-qsb-can1.dtb \
                      freescale/imx91p-9x9-qsb-flexspi-m2.dtb \
                      freescale/imx91p-9x9-qsb-i3c.dtb \
                      freescale/imx91p-9x9-qsb-ld.dtb \
                      freescale/imx91p-9x9-qsb-lpspi-slave.dtb \
                      freescale/imx91p-9x9-qsb-lpspi.dtb \
                      freescale/imx91p-9x9-qsb-mt9m114.dtb \
                      freescale/imx91p-9x9-qsb-ontat-wvga-panel.dtb \
                      freescale/imx91p-9x9-qsb-spi-nand-m2.dtb \
"

UBOOT_MAKE_TARGET = \
    "${@bb.utils.contains('MACHINE_FEATURES', 'optee', '', \
                                                        'u-boot.bin', d)}"
SPL_BINARY = \
    "${@bb.utils.contains('MACHINE_FEATURES', 'optee', 'spl/u-boot-spl.bin', \
                                                        '', d)}"
UBOOT_CONFIG ??= "sd"
UBOOT_CONFIG[sd]   = "imx8qm_mek_defconfig,sdcard"
UBOOT_CONFIG[fspi] = "imx8qm_mek_fspi_defconfig"

IMAGE_BOOTLOADER = "imx-boot"
IMX_BOOT_SEEK = "32"

IMAGE_BOOT_FILES += "hdmitxfw.bin hdmirxfw.bin dpfw.bin"

BOARD_TYPE = "mek"

IMXBOOT_TARGETS_SD = \
    "${@bb.utils.contains('MACHINE_FEATURES', 'optee', 'flash_b0_spl_container', \
                                                        'flash_b0', d)}"
IMXBOOT_TARGETS_FSPI = \
    "${@bb.utils.contains('MACHINE_FEATURES', 'optee', 'flash_b0_spl_flexspi_container', \
                                                        'flash_b0_flexspi', d)}"
IMXBOOT_TARGETS = \
    "${@bb.utils.contains('UBOOT_CONFIG',         'sd', '${IMXBOOT_TARGETS_SD}', \
                                                        '${IMXBOOT_TARGETS_FSPI}', d)}"
```
