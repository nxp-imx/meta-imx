## meta-imx-bsp/conf/machine/imx8dxlb0-ddr3l-evk.conf
```bitbake
#@TYPE: Machine
#@NAME: i.MX 8DXL B0 EVK with DDR3L
#@SOC: i.MX8DXL B0
#@DESCRIPTION: Machine configuration for NXP i.MX 8DualXLite B0 Evaluation Kit with DDR3L
#@MAINTAINER: Lauren Post <lauren.post@nxp.com>

require conf/machine/imx8dxl-b0-ddr3l-evk.conf
```

## meta-imx-bsp/conf/machine/imx8dxlb0-lpddr4-evk.conf
```bitbake
#@TYPE: Machine
#@NAME: i.MX 8DXL B0 EVK with LPDDR4
#@SOC: i.MX8DXL B0
#@DESCRIPTION: Machine configuration for NXP i.MX 8DualXLite B0 Evaluation Kit with LPDDR4
#@MAINTAINER: Lauren Post <lauren.post@nxp.com>

require conf/machine/imx8dxl-b0-lpddr4-evk.conf
```

## meta-imx-bsp/conf/machine/imx8dxlevk.conf
```bitbake
#@TYPE: Machine
#@NAME: i.MX 8DXL B0 EVK with LPDDR4
#@SOC: i.MX8DXL B0
#@DESCRIPTION: Machine configuration for NXP i.MX 8DualXLite B0 Evaluation Kit with LPDDR4
#@MAINTAINER: Lauren Post <lauren.post@nxp.com>

MACHINEOVERRIDES =. "imx8dxl-b0-lpddr4-evk:"
require conf/machine/imx8dxl-b0-lpddr4-evk.conf

# DEVICETREE of i.MX 8DXL DDR3 EVK Board
KERNEL_DEVICETREE += "freescale/imx8dxl-ddr3l-evk.dtb freescale/imx8dxl-ddr3l-evk-rpmsg.dtb"
```

## meta-imx-bsp/conf/machine/imx8mn-lpddr4-ab2.conf
```bitbake
#@TYPE: Machine
#@NAME: NXP i.MX 8M Nano Audio Board 2.0 with LPDDR4
#@SOC: i.MX8MN
#@DESCRIPTION: Machine configuration for NXP i.MX 8M Nano AB2 with LPDDR4
#@MAINTAINER: Adrian Alonso <adrian.alonso@nxp.com>

require include/imx8mn-ab2.inc

# The device tree name is implicit for LPDDR4, so can't use MACHINE here
KERNEL_DEVICETREE_BASENAME = "imx8mn-ab2"

UBOOT_CONFIG_BASENAME = "imx8mn_ab2"
DDR_FIRMWARE_NAME = " \
    lpddr4_pmu_train_1d_imem.bin \
    lpddr4_pmu_train_1d_dmem.bin \
    lpddr4_pmu_train_2d_imem.bin \
    lpddr4_pmu_train_2d_dmem.bin \
"
IMXBOOT_TARGETS_BASENAME = "flash_evk"
```

## meta-imx-bsp/conf/machine/imx8mnevk.conf
```bitbake
#@TYPE: Machine
#@NAME: i.MX 8MN Consolidated Machine
#@DESCRIPTION: A consolidated machine for using i.MX 8MN EVK both LPDDR4 and DDR4, see Important Note below
#@MAINTAINER: Jun Zhu <junzhu@nxp.com>

#        ** Important Note **
# This machine generates an image contain the bootloader of LPDDR4 EVK, Kernel, and rootfs, plus the DTBs of
# both LPDDR4 and DDR4 EVKs. The resulting image can be used for LPDDR4 EVK directly, and it can
# be manually converted for DDR4 EVK following the instructions in the User Guide - Consolidated Machines section.
# For users of both EVK variants, this can save build time and space. For most users, the dedicated machines
# imx8mn-lpddr4-evk.conf and imx8mn-ddr4-evk.conf should be used for simplicity.

MACHINEOVERRIDES =. "imx8mn-lpddr4-evk:"
require conf/machine/imx8mn-lpddr4-evk.conf

# Include device trees for other boards for internal test
KERNEL_DEVICETREE += " \
    freescale/imx8mn-ddr4-evk.dtb \
    freescale/imx8mn-ddr4-evk-ak5558.dtb \
    freescale/imx8mn-ddr4-evk-lk.dtb \
    freescale/imx8mn-ddr4-evk-rm67191.dtb \
    freescale/imx8mn-ddr4-evk-rm67191-cmd-ram.dtb \
    freescale/imx8mn-ddr4-evk-rm67199-cmd-ram.dtb \
    freescale/imx8mn-ddr4-evk-rpmsg.dtb \
    freescale/imx8mn-ddr4-evk-usd-wifi.dtb \
    freescale/imx8mn-ddr3l-evk.dtb \
    freescale/imx8mn-ddr3l-evk-ak5558.dtb \
    freescale/imx8mn-ddr3l-evk-rpmsg.dtb \
"
```

## meta-imx-bsp/conf/machine/imx8mnul-ddr3l-ab2.conf
```bitbake
#@TYPE: Machine
#@NAME: NXP i.MX 8M Nano UltraLite Audio Board 2.0 with DDR3L
#@SOC: i.MX8MN
#@DESCRIPTION: Machine configuration for NXP i.MX 8M Nano UltraLite AB2 with DDR3L
#@MAINTAINER: Adrian Alonso <adrian.alonso@nxp.com>

require include/imx8mnul-ab2.inc

KERNEL_DEVICETREE_BASENAME = "imx8mn-ddr3l-ab2"
UBOOT_CONFIG_BASENAME = "imx8mn_ddr3l_ab2"

DDR_FIRMWARE_VERSION = "201810"
DDR_FIRMWARE_NAME = " \
    ddr3_imem_1d_${DDR_FIRMWARE_VERSION}.bin \
    ddr3_dmem_1d_${DDR_FIRMWARE_VERSION}.bin \
"
IMXBOOT_TARGETS_BASENAME = "flash_ddr3l_evk"
```

## meta-imx-bsp/conf/machine/imx8mp-lpddr4-ndm.conf
```bitbake
#@TYPE: Machine
#@NAME: NXP i.MX8MPlus LPDDR4 NDM Evaluation Kit
#@SOC: i.MX8MP
#@DESCRIPTION: Machine configuration for NXP i.MX8MPlus LPDDR4 EVK in NDM
#@MAINTAINER: Pascal Mareau <pascal.mareau@nxp.com>

require conf/machine/include/imx8mp-evk.inc

# The device tree name is implicit for LPDDR4, so can't use MACHINE here
KERNEL_DEVICETREE_BASENAME = "imx8mp-evk"
KERNEL_DEVICETREE = " \
                     freescale/${KERNEL_DEVICETREE_BASENAME}-ndm.dtb \
                     freescale/${KERNEL_DEVICETREE_BASENAME}-sof-pdm.dtb \
"

UBOOT_CONFIG_BASENAME = "imx8mp_evk_ndm"
UBOOT_CONFIG[sd] = "${UBOOT_CONFIG_BASENAME}_defconfig,sdcard"

# Set DDR FIRMWARE
DDR_FIRMWARE_VERSION = "202006"
DDR_FIRMWARE_NAME = " \
	lpddr4_pmu_train_1d_dmem_${DDR_FIRMWARE_VERSION}.bin \
	lpddr4_pmu_train_1d_imem_${DDR_FIRMWARE_VERSION}.bin \
	lpddr4_pmu_train_2d_dmem_${DDR_FIRMWARE_VERSION}.bin \
	lpddr4_pmu_train_2d_imem_${DDR_FIRMWARE_VERSION}.bin \
"

# Set u-boot DTB
UBOOT_DTB_NAME = "imx8mp-evk.dtb"

IMXBOOT_TARGETS_BASENAME = "flash_evk"
```

## meta-imx-bsp/conf/machine/imx8mp-navq.conf
```bitbake
#@TYPE: Machine
#@NAME: NXP NavQPlus EVK
#@SOC: i.MX8MP
#@DESCRIPTION: Machine configuration for NXP NavQPlus Evaluation Kit
#@MAINTAINER: Jun Zhu <junzhu@nxp.com>

require conf/machine/include/imx8mp-evk.inc

MACHINE_FEATURES:remove = "nxp8997-pcie nxp8997-sdio nxp9098-pcie nxp9098-sdio"
MACHINE_FEATURES += "nxp8987-sdio"

KERNEL_DEVICETREE_BASENAME = "${MACHINE}"

# NXP kernel has additional DTB files for various board configuration and
# derivates. Include them here for NXP BSP only
KERNEL_DEVICETREE:append:use-nxp-bsp = " \
    freescale/${KERNEL_DEVICETREE_BASENAME}-ov5640-ov5645.dtb \
    freescale/${KERNEL_DEVICETREE_BASENAME}-ov5647-ov5640.dtb \
"

UBOOT_CONFIG_BASENAME = "navqp"
UBOOT_DTB_NAME="imx8mp-navqp.dtb"

DDR_FIRMWARE_NAME = " \
    lpddr4_pmu_train_1d_dmem_${DDR_FIRMWARE_VERSION}.bin \
    lpddr4_pmu_train_1d_imem_${DDR_FIRMWARE_VERSION}.bin \
    lpddr4_pmu_train_2d_dmem_${DDR_FIRMWARE_VERSION}.bin \
    lpddr4_pmu_train_2d_imem_${DDR_FIRMWARE_VERSION}.bin \
"
DDR_FIRMWARE_VERSION = "202006"

IMXBOOT_TARGETS_BASENAME = "flash_evk"

IMX_DEFAULT_BSP = "nxp"
```

## meta-imx-bsp/conf/machine/imx8qxpc0lpddr4arm2.conf
```bitbake
#@TYPE: Machine
#@NAME: i.MX 8QXP MEK
#@DESCRIPTION: i.MX 8QXP C0 LPDDR4 ARM2 Development board

require conf/machine/imx8qxplpddr4arm2.conf

MACHINE_FEATURES:remove = "soc-revb0"
```
