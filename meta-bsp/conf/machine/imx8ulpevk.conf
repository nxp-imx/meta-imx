## meta-bsp/conf/machine/imx8ulpevk.conf
```bitbake
#@TYPE: Machine
#@NAME: i.MX 8ULP consolidated rootfs machine
#@SOC: i.MX8ULP
#@DESCRIPTION: A consolidated machine configuration for NXP i.MX 8ULP LPDDR4 Evaluation Kit
#@MAINTAINER: Jun Zhu <junzhu@nxp.com>

MACHINEOVERRIDES =. "imx8ulp-lpddr4-evk:"
require conf/machine/imx8ulp-lpddr4-evk.conf

# Include device trees for other boards for internal test
KERNEL_DEVICETREE += " \
    freescale/imx8ulp-9x9-evk.dtb \
    freescale/imx8ulp-9x9-evk-i3c.dtb \
    freescale/imx8ulp-9x9-evk-lpa.dtb \
    freescale/imx8ulp-9x9-evk-lpspi.dtb \
    freescale/imx8ulp-9x9-evk-lpspi-slave.dtb \
    freescale/imx8ulp-9x9-evk-sof-btsco.dtb \
    freescale/imx8ulp-9x9-evk-rk055hdmipi4m.dtb \
    freescale/imx8ulp-9x9-evk-rk055hdmipi4mv2.dtb \
"
```

## meta-bsp/conf/machine/imx91p-9x9-lpddr4-qsb.conf
```bitbake
#@TYPE: Machine
#@NAME: NXP i.MX91Phantom 9x9 Quick Start Board with LPDDR4
#@SOC: i.MX91Phantom
#@DESCRIPTION: Machine configuration for NXP i.MX91Phantom 9x9 QSB with LPDDR4
#@MAINTAINER: Jun Zhu <junzhu@nxp.com>

MACHINEOVERRIDES =. "mx91p:"

require include/imx91-evk.inc

KERNEL_DEVICETREE_BASENAME = "imx91p-9x9-qsb"

KERNEL_DEVICETREE:append:use-nxp-bsp = " \
    freescale/${KERNEL_DEVICETREE_BASENAME}-aud-hat.dtb \
    freescale/${KERNEL_DEVICETREE_BASENAME}-flexspi-m2.dtb \
    freescale/${KERNEL_DEVICETREE_BASENAME}-i3c.dtb \
    freescale/${KERNEL_DEVICETREE_BASENAME}-mt9m114.dtb \
"

UBOOT_CONFIG_BASENAME = "imx91p_9x9_qsb"

DDR_FIRMWARE_NAME = " \
    lpddr4_dmem_1d_v202201.bin \
    lpddr4_dmem_2d_v202201.bin \
    lpddr4_imem_1d_v202201.bin \
    lpddr4_imem_2d_v202201.bin \
"
```

## meta-bsp/conf/machine/imx91pevk.conf
```bitbake
#@TYPE: Machine
#@NAME: i.MX 91 Phantom Consolidated rootfs machine
#@SOC: i.MX91P
#@DESCRIPTION: A Consolidated machine configuration for i.MX 91 Phantom LPDDR4 EVK/QSB, see Important Note below
#@MAINTAINER: Jun Zhu <junzhu@nxp.com>

#        ** Important Note **
# This machine generates an image contain the bootloader of 9x9 LPDDR4 QSB, Kernel, and rootfs, plus the DTBs of
# both 11x11 LPDDR4 EVK and 9x9 LPDDR4 QSB boards. The resulting image can be used for 9x9 LPDDR4 QSB directly,
# and it can be manually converted for other EVK or QSB following the instructions in the User Guide - Consolidated Machines section.
# For users of all of EVK/QSB variants, this can save build time and space. For most users, the dedicated machines
# imx91p-11x11-lpddr4-evk.conf and imx91p-9x9-lpddr4-qsb.conf should be used for simplicity.

MACHINEOVERRIDES =. "imx91p-9x9-lpddr4-qsb:"
require conf/machine/imx91p-9x9-lpddr4-qsb.conf

# Include device trees for other boards for internal test
KERNEL_DEVICETREE += " \
        freescale/imx91p-11x11-evk.dtb \
        freescale/imx91p-11x11-evk-aud-hat.dtb \
        freescale/imx91p-11x11-evk-flexspi-m2.dtb \
        freescale/imx91p-11x11-evk-i3c.dtb \
        freescale/imx91p-11x11-evk-ld.dtb \
        freescale/imx91p-11x11-evk-lpspi.dtb \
        freescale/imx91p-11x11-evk-lpspi-slave.dtb \
        freescale/imx91p-11x11-evk-mqs.dtb \
        freescale/imx91p-11x11-evk-mt9m114.dtb \
		freescale/imx91p-11x11-evk-ontat-wvga-panel.dtb \
"
```

## meta-bsp/conf/machine/imx93-11x11-lpddr4x-evk.conf
```bitbake
#@TYPE: Machine
#@NAME: NXP i.MX 93 11x11 Evaluation Kit with LPDDR4X
#@SOC: i.MX93
#@DESCRIPTION: Machine configuration for NXP i.MX 93 11x11 EVK with LPDDR4X
#@MAINTAINER: Jun Zhu <junzhu@nxp.com>

MACHINEOVERRIDES =. "mx93:"

require include/imx93-evk.inc

KERNEL_DEVICETREE_BASENAME = "imx93-11x11-evk"

KERNEL_DEVICETREE += " \
      freescale/imx93-11x11-evk-aud-hat.dtb \
      freescale/imx93-11x11-evk-boe-wxga-lvds-panel.dtb \
      freescale/imx93-11x11-evk-flexio-i2c.dtb \
      freescale/imx93-11x11-evk-flexspi-m2.dtb \
      freescale/imx93-11x11-evk-i3c.dtb \
      freescale/imx93-11x11-evk-inmate.dtb \
      freescale/imx93-11x11-evk-lpspi-slave.dtb \
      freescale/imx93-11x11-evk-lpspi.dtb \
      freescale/imx93-11x11-evk-lpuart.dtb \
      freescale/imx93-11x11-evk-mqs.dtb \
      freescale/imx93-11x11-evk-mt9m114.dtb \
      freescale/imx93-11x11-evk-rm67199.dtb \
      freescale/imx93-11x11-evk-root.dtb \
 "

UBOOT_CONFIG_BASENAME = "imx93_11x11_evk"

DDR_FIRMWARE_NAME = " \
        lpddr4_dmem_1d_v202201.bin \
        lpddr4_dmem_2d_v202201.bin \
        lpddr4_imem_1d_v202201.bin \
        lpddr4_imem_2d_v202201.bin \
"

SECO_FIRMWARE_NAME:mx9-nxp-bsp = "mx93a0-ahab-container.img"

IMAGE_BOOT_FILES:append:use-nxp-bsp = " \
        imx93_m33_TCM_rpmsg_lite_pingpong_rtos_linux_remote.bin \
        imx93_m33_TCM_rpmsg_lite_str_echo_rtos.bin \
"
WKS_FILE_DEPENDS:append = " imx-m33-demos"
```

## meta-bsp/conf/machine/imx93-14x14-lpddr4x-evk.conf
```bitbake
#@TYPE: Machine
#@NAME: NXP i.MX 93 14x14 Evaluation Kit with LPDDR4X
#@SOC: i.MX93
#@DESCRIPTION: Machine configuration for NXP i.MX 93 14x14 EVK with LPDDR4X
#@MAINTAINER: Jun Zhu <junzhu@nxp.com>

MACHINEOVERRIDES =. "mx93:"

require conf/machine/include/imx93-evk.inc

KERNEL_DEVICETREE_BASENAME = "imx93-14x14-evk"

KERNEL_DEVICETREE:append:use-nxp-bsp = " \
    freescale/${KERNEL_DEVICETREE_BASENAME}-aud-hat.dtb \
    freescale/${KERNEL_DEVICETREE_BASENAME}-mqs.dtb \
    freescale/${KERNEL_DEVICETREE_BASENAME}-rm67199.dtb \
"

UBOOT_CONFIG_BASENAME = "imx93_14x14_evk"

DDR_FIRMWARE_NAME = " \
    lpddr4_dmem_1d_v202201.bin \
    lpddr4_dmem_2d_v202201.bin \
    lpddr4_imem_1d_v202201.bin \
    lpddr4_imem_2d_v202201.bin \
"
```

## meta-bsp/conf/machine/imx93-9x9-lpddr4-qsb.conf
```bitbake
#@TYPE: Machine
#@NAME: NXP i.MX93 9x9 Quick Start Board with LPDDR4
#@SOC: i.MX93
#@DESCRIPTION: Machine configuration for NXP i.MX93 9x9 QSB with LPDDR4
#@MAINTAINER: Jun Zhu <junzhu@nxp.com>

MACHINEOVERRIDES =. "mx93:"

require include/imx93-evk.inc

KERNEL_DEVICETREE_BASENAME = "imx93-9x9-qsb"

KERNEL_DEVICETREE += " \
      freescale/imx93-9x9-qsb-can1.dtb \
      freescale/imx93-9x9-qsb-flexspi-m2.dtb \
      freescale/imx93-9x9-qsb-i3c.dtb \
      freescale/imx93-9x9-qsb-lpspi-slave.dtb \
      freescale/imx93-9x9-qsb-lpspi.dtb \
      freescale/imx93-9x9-qsb-mt9m114.dtb \
      freescale/imx93-9x9-qsb-ontat-wvga-panel.dtb \
"

UBOOT_CONFIG_BASENAME = "imx93_9x9_qsb"

DDR_FIRMWARE_NAME = " \
        lpddr4_dmem_1d_v202201.bin \
        lpddr4_dmem_2d_v202201.bin \
        lpddr4_imem_1d_v202201.bin \
        lpddr4_imem_2d_v202201.bin \
"

SECO_FIRMWARE_NAME:mx9-nxp-bsp = "mx93a0-ahab-container.img"

IMAGE_BOOT_FILES:append:use-nxp-bsp = " \
        imx93_m33_TCM_rpmsg_lite_pingpong_rtos_linux_remote.bin \
        imx93_m33_TCM_rpmsg_lite_str_echo_rtos.bin \
"
WKS_FILE_DEPENDS:append = " imx-m33-demos"
```

## meta-bsp/conf/machine/imx93evk.conf
```bitbake
#@TYPE: Machine
#@NAME: i.MX 93 Consolidated rootfs machine
#@SOC: i.MX93
#@DESCRIPTION: A Consolidated machine configuration for NXP i.MX 93 LPDDR4x and LPDDR4 EVK
#@MAINTAINER: Jun Zhu <junzhu@nxp.com>

MACHINEOVERRIDES =. "imx93-11x11-lpddr4x-evk:"
require conf/machine/imx93-11x11-lpddr4x-evk.conf

# Include device trees for other boards for internal test
KERNEL_DEVICETREE += " \
        freescale/imx93-14x14-evk.dtb \
        freescale/imx93-14x14-evk-aud-hat.dtb \
        freescale/imx93-14x14-evk-flexspi-m2.dtb \
        freescale/imx93-14x14-evk-lvds-it6263.dtb \
        freescale/imx93-14x14-evk-tja1103.dtb \
        freescale/imx93-14x14-evk-mqs.dtb \
        freescale/imx93-14x14-evk-rm67199.dtb \
        freescale/imx93-9x9-qsb.dtb \
        freescale/imx93-9x9-qsb-ld.dtb \
        freescale/imx93-9x9-qsb-aud-hat.dtb \
        freescale/imx93-9x9-qsb-can1.dtb \
        freescale/imx93-9x9-qsb-flexspi-m2.dtb \
        freescale/imx93-9x9-qsb-i3c.dtb \
        freescale/imx93-9x9-qsb-lpspi.dtb \
        freescale/imx93-9x9-qsb-lpspi-slave.dtb \
        freescale/imx93-9x9-qsb-mt9m114.dtb \
        freescale/imx93-9x9-qsb-ontat-wvga-panel.dtb \
        freescale/imx93-9x9-qsb-rpmsg.dtb \
        freescale/imx93-9x9-qsb-rpmsg-lpv.dtb \
"
# Include M33 demo apps of other boards
IMAGE_BOOT_FILES:append = " \
    imx93-14x14-evk_m33_TCM_power_mode_switch.bin \
    imx93-14x14-evk_m33_TCM_rpmsg_lite_pingpong_rtos_linux_remote.bin \
    imx93-14x14-evk_m33_TCM_rpmsg_lite_str_echo_rtos.bin \
    imx93-9x9-qsb_m33_TCM_power_mode_switch.bin \
    imx93-9x9-qsb_m33_TCM_low_power_wakeword.bin \
    imx93-9x9-qsb_m33_TCM_rpmsg_lite_pingpong_rtos_linux_remote.bin \
    imx93-9x9-qsb_m33_TCM_rpmsg_lite_str_echo_rtos.bin \
"
```

## meta-bsp/conf/machine/include/imx-base-extend.inc
```bitbake
# This file is included from meta-freescale/conf/machine/include/imx-base.inc
# and provides a simple mechanism to override settings in the file

# Update i.MX 8ULP
IMX_EXTRA_FIRMWARE:mx8ulp-generic-bsp = "firmware-upower firmware-ele-imx"

# Update i.MX 93
IMX_SOC_REV:mx93-generic-bsp  ?= "A1"
IMX_EXTRA_FIRMWARE:mx93-generic-bsp = "imx-boot-firmware-files firmware-ele-imx"

# Add new machine i.MX 8M Plus UltraLite
MACHINEOVERRIDES_EXTENDER:mx8mpul:use-nxp-bsp = "imx-generic-bsp:imx-nxp-bsp:imxfbdev:mx8-generic-bsp:mx8-nxp-bsp:mx8m-generic-bsp:mx8m-nxp-bsp:mx8mpul-generic-bsp:mx8mpul-nxp-bsp"
MACHINEOVERRIDES_EXTENDER:mx8mpul:use-mainline-bsp = "imx-generic-bsp:imx-mainline-bsp:mx8-generic-bsp:mx8-mainline-bsp:mx8m-generic-bsp:mx8m-mainline-bsp:mx8mpul-generic-bsp:mx8mpul-mainline-bsp"
MACHINEOVERRIDES_EXTENDER_FILTER_OUT += "mx8mpul"
MACHINE_SOCARCH_SUFFIX:mx8mpul-nxp-bsp = "-mx8mpul"

# Add new machine i.MX 91 Phantom
IMX_SOC_REV:mx91p-generic-bsp ?= "A1"
SECO_FIRMWARE_NAME:mx91p-generic-bsp ?= "mx93${IMX_SOC_REV_LOWER}-ahab-container.img"
MACHINEOVERRIDES_EXTENDER:mx91p:use-nxp-bsp  = "imx-generic-bsp:imx-nxp-bsp:imxdrm:mx9-generic-bsp:mx9-nxp-bsp:mx91p-generic-bsp:mx91p-nxp-bsp"
MACHINEOVERRIDES_EXTENDER:mx91p:use-mainline-bsp  = "imx-generic-bsp:imx-mainline-bsp:mx9-generic-bsp:mx9-mainline-bsp:mx91p-generic-bsp:mx91p-mainline-bsp"
MACHINEOVERRIDES_EXTENDER_FILTER_OUT += "mx91p"
MACHINE_SOCARCH_SUFFIX:mx91p-nxp-bsp = "-mx91"
IMX_EXTRA_FIRMWARE:mx91p-nxp-bsp = "imx-boot-firmware-files firmware-ele-imx"

# i.MX 6 & 7 stay on weston 10.0 for fbdev
PREFERRED_VERSION_weston:mx6-nxp-bsp ??= "10.0.5.imx"
PREFERRED_VERSION_weston:mx7-nxp-bsp ??= "10.0.5.imx"
PREFERRED_VERSION_weston:imx-nxp-bsp ??= "11.0.3.imx"

PREFERRED_VERSION_wayland-protocols:mx6-nxp-bsp ??= "1.32.imx"
PREFERRED_VERSION_wayland-protocols:mx7-nxp-bsp ??= "1.32.imx"
PREFERRED_VERSION_wayland-protocols:mx8-nxp-bsp ??= "1.32.imx"
PREFERRED_VERSION_wayland-protocols:mx9-nxp-bsp ??= "1.32.imx"

PREFERRED_VERSION_vulkan-headers:imxvulkan           ??= "1.3.239.0"
PREFERRED_VERSION_vulkan-loader:imxvulkan            ??= "1.3.239.0"
PREFERRED_VERSION_vulkan-tools:imxvulkan             ??= "1.3.239.0"
PREFERRED_VERSION_vulkan-validation-layers:imxvulkan ??= "1.3.239.0"

PREFERRED_VERSION_ffmpeg ??= "4.4.1"

PREFERRED_VERSION_libdrm:mx6-nxp-bsp ??= "2.4.115.imx"
PREFERRED_VERSION_libdrm:mx7-nxp-bsp ??= "2.4.115.imx"
PREFERRED_VERSION_libdrm:mx8-nxp-bsp ??= "2.4.115.imx"
PREFERRED_VERSION_libdrm:mx9-nxp-bsp ??= "2.4.115.imx"

PREFERRED_VERSION_optee-client:mx6-nxp-bsp ??= "4.0.0.imx"
PREFERRED_VERSION_optee-client:mx7-nxp-bsp ??= "4.0.0.imx"
PREFERRED_VERSION_optee-client:mx8-nxp-bsp ??= "4.0.0.imx"
PREFERRED_VERSION_optee-client:mx9-nxp-bsp ??= "4.0.0.imx"
PREFERRED_VERSION_optee-os:mx6-nxp-bsp     ??= "4.0.0.imx"
PREFERRED_VERSION_optee-os:mx7-nxp-bsp     ??= "4.0.0.imx"
PREFERRED_VERSION_optee-os:mx8-nxp-bsp     ??= "4.0.0.imx"
PREFERRED_VERSION_optee-os:mx9-nxp-bsp     ??= "4.0.0.imx"
PREFERRED_VERSION_optee-test:mx6-nxp-bsp   ??= "4.0.0.imx"
PREFERRED_VERSION_optee-test:mx7-nxp-bsp   ??= "4.0.0.imx"
PREFERRED_VERSION_optee-test:mx8-nxp-bsp   ??= "4.0.0.imx"
PREFERRED_VERSION_optee-test:mx9-nxp-bsp   ??= "4.0.0.imx"
PREFERRED_VERSION_optee-os-tadevkit:mx6-nxp-bsp   ??= "4.0.0.imx"
PREFERRED_VERSION_optee-os-tadevkit:mx7-nxp-bsp   ??= "4.0.0.imx"
PREFERRED_VERSION_optee-os-tadevkit:mx8-nxp-bsp   ??= "4.0.0.imx"
PREFERRED_VERSION_optee-os-tadevkit:mx9-nxp-bsp   ??= "4.0.0.imx"

PREFERRED_VERSION_opencv:mx8-nxp-bsp ??= "4.7.0.imx"
PREFERRED_VERSION_opencv:mx9-nxp-bsp ??= "4.7.0.imx"

SOC_DEFAULT_IMAGE_FSTYPES = "wic.bmap wic.zst tar.zst"
ZSTD_COMPRESSION_LEVEL ?= "-10"
```

## meta-bsp/conf/machine/include/imx8dxl-common.inc
```bitbake
# Provides the i.MX8DXL EVK common settings

MACHINE_FEATURES_append = " pci bcm43455 bcm4356 bcm4359 nxp8997"

# Don't include kernels in standard images
RDEPENDS_${KERNEL_PACKAGE_NAME}-base = ""
RDEPENDS_${KERNEL_PACKAGE_NAME}-image = ""

LOADADDR = ""

# Disable the serial console due to auto-serial-console
SERIAL_CONSOLES = "115200;ttyLP0"

# we do not want to have getty running on tty1 as we run
# auto-serial-console there
USE_VT = "0"

UBOOT_MAKE_TARGET = "all"
SPL_BINARY = "spl/u-boot-spl.bin"

IMAGE_BOOTLOADER = "imx-boot"
IMX_BOOT_SEEK = "32"

IMXBOOT_TARGETS_SD = \
    "${@bb.utils.contains('MACHINE_FEATURES', 'optee', 'flash_linux_m4 flash_linux_m4_no_v2x flash_spl', \
                                                       'flash_regression_linux_m4 flash', d)}"
IMXBOOT_TARGETS_FSPI = \
    "${@bb.utils.contains('MACHINE_FEATURES', 'optee', 'flash_spl_flexspi', \
                                                       'flash_flexspi', d)}"
IMXBOOT_TARGETS_NAND = \
    "${@bb.utils.contains('MACHINE_FEATURES', 'optee', 'flash_spl_nand', \
                                                       'flash_nand flash_nand_fw', d)}"
IMXBOOT_TARGETS = \
    "${@bb.utils.contains('UBOOT_CONFIG',        'sd', '${IMXBOOT_TARGETS_SD}',   \
        bb.utils.contains('UBOOT_CONFIG',      'fspi', '${IMXBOOT_TARGETS_FSPI}', \
        bb.utils.contains('UBOOT_CONFIG',      'nand', '${IMXBOOT_TARGETS_NAND}', \
                                                       'UNHANDLED_UBOOT_CONFIG_${UBOOT_CONFIG}', d), d), d)}"
```

## meta-bsp/conf/machine/include/imx8dxl-ddr3l-evk.inc
```bitbake
require conf/machine/include/imx8dxl-evk.inc

KERNEL_DEVICETREE_BASENAME = "imx8dxl-ddr3l-evk"

KERNEL_DEVICETREE:append:use-nxp-bsp = " \
    freescale/${KERNEL_DEVICETREE_BASENAME}.dtb \
    freescale/${KERNEL_DEVICETREE_BASENAME}-rpmsg.dtb \
"

UBOOT_CONFIG_BASENAME = "imx8dxl_ddr3l_evk"

UBOOT_CONFIG[nand] = "${UBOOT_CONFIG_BASENAME}_nand_defconfig"

BOARD_TYPE = "ddr3-evk"
```

## meta-bsp/conf/machine/include/imx8mnul-ab2.inc
```bitbake
MACHINEOVERRIDES =. "mx8mnul:"

require conf/machine/include/imx-base.inc
require conf/machine/include/arm/armv8a/tune-cortexa53.inc

MACHINE_FEATURES += "wifi bluetooth bcm43455 bcm4356"

# NXP BSP can consume proprietary jailhouse and Broadcom drivers
# OP-TEE is also applicable to NXP BSP, mainline BSP seems not to have
# a full support for it yet.
MACHINE_FEATURES:append:use-nxp-bsp = " jailhouse bcm4359 optee"

KERNEL_DEVICETREE = " \
	freescale/${KERNEL_DEVICETREE_BASENAME}.dtb \
"
UBOOT_DTB_NAME = "${KERNEL_DEVICETREE_BASENAME}.dtb"

IMX_DEFAULT_BOOTLOADER:use-nxp-bsp = "u-boot-imx"
IMX_DEFAULT_BOOTLOADER:use-mainline-bsp = "u-boot-fslc"

UBOOT_CONFIG ??= "sd"
UBOOT_CONFIG[sd]      = "${UBOOT_CONFIG_BASENAME}_defconfig,sdcard"
UBOOT_CONFIG[fspi]    = "${UBOOT_CONFIG_BASENAME}_defconfig"

SPL_BINARY = "spl/u-boot-spl.bin"

ATF_PLATFORM = "imx8mn"
ATF_LOAD_ADDR = "0x960000"

IMXBOOT_TARGETS = "${@bb.utils.contains('UBOOT_CONFIG', 'fspi', '${IMXBOOT_TARGETS_BASENAME}_flexspi', '${IMXBOOT_TARGETS_BASENAME}', d)}"

IMX_BOOT_SOC_TARGET = "iMX8MN"

SERIAL_CONSOLES = "115200;ttymxc1"

BOOT_SPACE = "65536"
LOADADDR = ""
UBOOT_SUFFIX = "bin"
UBOOT_MAKE_TARGET = "all"

# Image boot offset as defined in section 6.1.6.1 "Primary image offset and IVT offset" of
# i.MX 8M Nano Applications Processor Reference Manual, Rev. 0, 12/2019
# Doc ID: IMX8MNRM
IMX_BOOT_SEEK = "32"

OPTEE_BIN_EXT = "8mn"
TEE_LOAD_ADDR = "0x56000000"

# Add additional firmware
MACHINE_FIRMWARE:append = " linux-firmware-ath10k"
```
