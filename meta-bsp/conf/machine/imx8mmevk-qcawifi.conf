## meta-bsp/conf/machine/imx8qxplpddr4arm2.conf
```bitbake
#@TYPE: Machine
#@NAME: i.MX 8QXP LPDDR4 ARM2
#@DESCRIPTION: i.MX 8QXP LPDDR4 ARM2 Development board

MACHINEOVERRIDES =. "mx8:mx8x:mx8qxp:"

require conf/machine/include/imx-base.inc
require conf/machine/include/arm/armv8a/tune-cortexa35.inc

MACHINE_FEATURES += "soc-revb0"

# Don't include kernels in standard images
RDEPENDS:${KERNEL_PACKAGE_NAME}-base = ""
RDEPENDS:${KERNEL_PACKAGE_NAME}-image = ""

LOADADDR = ""

# Disable the serial console due to auto-serial-console
SERIAL_CONSOLES = "115200;ttyAMA0"

# we do not want to have getty running on tty1 as we run
# auto-serial-console there
USE_VT = "0"

KERNEL_DEVICETREE = "freescale/imx8qxp-lpddr4-val.dtb \
                     freescale/imx8qxp-lpddr4-val-a0.dtb freescale/imx8qxp-lpddr4-val-gpmi-nand.dtb \
                     freescale/imx8qxp-lpddr4-val-lpspi.dtb freescale/imx8qxp-lpddr4-val-lpspi-slave.dtb \
                     freescale/imx8qxp-lpddr4-val-mqs.dtb freescale/imx8qxp-lpddr4-val-spdif.dtb \
"

UBOOT_MAKE_TARGET = "u-boot.bin"
UBOOT_CONFIG ??= "sd"
UBOOT_CONFIG[sd] = "imx8qxp_lpddr4_val_config,sdcard"
UBOOT_CONFIG[fspi] = "imx8qxp_lpddr4_val_fspi_config"
UBOOT_CONFIG[nand] = "imx8qxp_lpddr4_val_nand_config,ubifs"

ATF_PLATFORM = "imx8qx"

IMAGE_BOOTLOADER = "imx-boot"
IMX_BOOT_SEEK = "32"

IMXBOOT_TARGETS = "${@bb.utils.contains('UBOOT_CONFIG', 'fspi', 'flash_flexspi', \
                      bb.utils.contains('UBOOT_CONFIG', 'nand', 'flash_nand flash_nand_fw', \
                                                                'flash_regression_linux_m4 flash', d), d)}"

IMX_BOOT_SOC_TARGET = "iMX8QX"

BOARD_TYPE = "val"
```

## meta-bsp/conf/machine/imx8ulp-9x9-lpddr4-evk.conf
```bitbake
#@TYPE: Machine
#@NAME: i.MX 8ULP 9x9 EVK
#@SOC: i.MX8ULP
#@DESCRIPTION: Machine configuration for NXP i.MX 8ULP 9x9 Evaluation Kit with LPDDR4
#@MAINTAINER: Jun Zhu <junzhu@nxp.com>

require include/imx8ulp-evk.inc

KERNEL_DEVICETREE_BASENAME = "imx8ulp-9x9-evk"
KERNEL_DEVICETREE += " \
    freescale/imx8ulp-9x9-evk-i3c.dtb \
    freescale/imx8ulp-9x9-evk-lpa.dtb \
    freescale/imx8ulp-9x9-evk-lpspi.dtb \
    freescale/imx8ulp-9x9-evk-lpspi-slave.dtb \
    freescale/imx8ulp-9x9-evk-sof-btsco.dtb \
    freescale/imx8ulp-9x9-evk-rk055hdmipi4m.dtb \
    freescale/imx8ulp-9x9-evk-rk055hdmipi4mv2.dtb \
"

UBOOT_CONFIG_BASENAME = "imx8ulp_9x9_evk"

MACHINE_FEATURES += "soc-reva0"
UPOWER_FIRMWARE_NAME = "upower_a0.bin"
SECO_FIRMWARE_NAME = "mx8ulpa0-ahab-container.img"
```

## meta-bsp/conf/machine/imx8ulp-evk.conf
```bitbake
#@TYPE: Machine
#@NAME: i.MX 8ULP EVK
#@SOC: i.MX8ULP
#@DESCRIPTION: Machine configuration for NXP i.MX 8ULP Evaluation Kit with LPDDR4
#@MAINTAINER: Jun Zhu <junzhu@nxp.com>

require include/imx8ulp-evk.inc

KERNEL_DEVICETREE_BASENAME = "${MACHINE}"

UBOOT_CONFIG_BASENAME = "imx8ulp_evk"
```

## meta-bsp/conf/machine/imx8ulp-lpddr4-evk.conf
```bitbake
#@TYPE: Machine
#@NAME: i.MX 8ULP EVK
#@SOC: i.MX8ULP
#@DESCRIPTION: Machine configuration for NXP i.MX 8ULP Evaluation Kit with LPDDR4
#@MAINTAINER: Jun Zhu <junzhu@nxp.com>

require include/imx8ulp-evk.inc

KERNEL_DEVICETREE_BASENAME = "imx8ulp-evk"

KERNEL_DEVICETREE += " \
    freescale/imx8ulp-evk-epdc.dtb \
    freescale/imx8ulp-evk-flexio-i2c.dtb \
    freescale/imx8ulp-evk-i3c.dtb \
    freescale/imx8ulp-evk-lpa.dtb \
    freescale/imx8ulp-evk-lpspi-slave.dtb \
    freescale/imx8ulp-evk-nd.dtb \
    freescale/imx8ulp-evk-rk055hdmipi4m.dtb \
    freescale/imx8ulp-evk-rk055hdmipi4mv2.dtb \
    freescale/imx8ulp-evk-sof-btsco.dtb \
"

UBOOT_CONFIG_BASENAME = "imx8ulp_evk"

MACHINE_FEATURES += "soc-reva1"
UPOWER_FIRMWARE_NAME = "upower_a1.bin"
SECO_FIRMWARE_NAME = "mx8ulpa1-ahab-container.img"
```
