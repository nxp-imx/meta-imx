## meta-bsp/conf/machine/imx8mmevk-qcawifi.conf
```bitbake
#@TYPE: Machine
#@NAME: NXP i.MX8MM LPDDR4 + QCA Wi-Fi Evaluation Kit
#@SOC: i.MX8MM
#@DESCRIPTION: Machine configuration for NXP i.MX8MMini LPDDR4 + QCA Wi-Fi EVK
#@MAINTAINER: Jun Zhu <junzhu@nxp.com>

require conf/machine/imx8mmlpddr4evk.conf


UBOOT_CONFIG ??= "sd"
UBOOT_CONFIG[sd] = "imx8mm_evk_qca_config,sdcard"
UBOOT_CONFIG[fspi] = "imx8mm_evk_qca_fspi_defconfig"

# KERNEL DTB
KERNEL_DEVICETREE = " \
    freescale/imx8mm-evk-qca-wifi.dtb \
    freescale/imx8mm-evk-revb-qca-wifi.dtb \
"

# Set u-boot DTB
UBOOT_DTB_NAME = "imx8mm-evk-qca-wifi.dtb"
```

## meta-bsp/conf/machine/imx8mmevk.conf
```bitbake
#@TYPE: Machine
#@NAME: i.MX 8MM Consolidated Machine
#@DESCRIPTION: A consolidated machine for using i.MX 8MM EVK both LPDDR4 and DDR4, see Important Note below
#@MAINTAINER: Jun Zhu <junzhu@nxp.com>

#        ** Important Note **
# This machine generates an image contain the bootloader of LPDDR4 EVK, Kernel, and rootfs, plus the DTBs of
# both LPDDR4 and DDR4 EVKs. The resulting image can be used for LPDDR4 EVK directly, and it can
# be manually converted for DDR4 EVK following the instructions in the User Guide - Consolidated Machines section.
# For users of both EVK variants, this can save build time and space. For most users, the dedicated machines
# imx8mm-lpddr4-evk.conf and imx8mm-ddr4-evk.conf should be used for simplicity.

MACHINEOVERRIDES =. "imx8mm-lpddr4-evk:"
require conf/machine/imx8mm-lpddr4-evk.conf

# Include device trees for other boards for internal test
KERNEL_DEVICETREE += " \
    freescale/imx8mm-ddr4-evk.dtb \
    freescale/imx8mm-ddr4-evk-pcie-ep.dtb \
    freescale/imx8mm-ddr4-evk-rm67191.dtb \
    freescale/imx8mm-ddr4-evk-rm67191-cmd-ram.dtb \
    freescale/imx8mm-ddr4-evk-rm67199.dtb \
    freescale/imx8mm-ddr4-evk-rm67199-cmd-ram.dtb \
    freescale/imx8mm-ddr4-evk-revb.dtb \
    freescale/imx8mm-ddr4-evk-revb-rm67191.dtb \
    freescale/imx8mm-ddr4-evk-revb-rm67191-cmd-ram.dtb \
    freescale/imx8mm-ddr4-evk-revb-rm67199.dtb \
    freescale/imx8mm-ddr4-evk-revb-rm67199-cmd-ram.dtb \
"
```

## meta-bsp/conf/machine/imx8mmlpddr4evk.conf
```bitbake
# DEPRECATED: Machine is renamed, please use imx8mm-lpddr4-evk
MACHINEOVERRIDES =. "imx8mm-lpddr4-evk:"
require conf/machine/imx8mm-lpddr4-evk.conf
```

## meta-bsp/conf/machine/imx8mn-ddr4-ab2.conf
```bitbake
#@TYPE: Machine
#@NAME: NXP i.MX 8M Nano Audio Board 2.0 with DDR4
#@SOC: i.MX8MM
#@DESCRIPTION: Machine configuration for NXP i.MX 8M Nano AB2 with DDR4
#@MAINTAINER: Adrian Alonso <adrian.alonso@nxp.com>

require include/imx8mn-ab2.inc

KERNEL_DEVICETREE_BASENAME = "${MACHINE}"
UBOOT_CONFIG_BASENAME = "imx8mn_ddr4_ab2"

DDR_FIRMWARE_VERSION = "201810"
DDR_FIRMWARE_NAME = " \
    ddr4_imem_1d_${DDR_FIRMWARE_VERSION}.bin \
    ddr4_dmem_1d_${DDR_FIRMWARE_VERSION}.bin \
    ddr4_imem_2d_${DDR_FIRMWARE_VERSION}.bin \
    ddr4_dmem_2d_${DDR_FIRMWARE_VERSION}.bin \
"
IMXBOOT_TARGETS_BASENAME = "flash_ddr4_evk"
```

## meta-bsp/conf/machine/imx8mnddr3levk.conf
```bitbake
# DEPRECATED: Machine is renamed, please use imx8mnul-ddr3l-evk
MACHINEOVERRIDES =. "imx8mnul-ddr3l-evk:"
require conf/machine/imx8mnul-ddr3l-evk.conf
```

## meta-bsp/conf/machine/imx8mnddr4evk.conf
```bitbake
# DEPRECATED: Machine is renamed, please use imx8mn-ddr4-evk
MACHINEOVERRIDES =. "imx8mn-ddr4-evk:"
require conf/machine/imx8mn-ddr4-evk.conf
KERNEL_DEVICETREE_BASENAME = "imx8mn-ddr4-evk"
```

## meta-bsp/conf/machine/imx8mnevk.conf
```bitbake
#@TYPE: Machine
#@NAME: i.MX 8MN Consolidated Machine
#@DESCRIPTION: A consolidated machine for i.MX 8MN LPDDR4 and DDR4 EVK
#@MAINTAINER: Jun Zhu <junzhu@nxp.com>

MACHINEOVERRIDES =. "imx8mn-lpddr4-evk:"
require conf/machine/imx8mn-lpddr4-evk.conf

# Include device trees for other boards for internal test
KERNEL_DEVICETREE += " \
    freescale/imx8mn-ddr4-evk.dtb \
    freescale/imx8mn-ddr4-evk-ak5558.dtb \
    freescale/imx8mn-ddr4-evk-lk.dtb \
    freescale/imx8mn-ddr4-evk-rm67191.dtb \
    freescale/imx8mn-ddr4-evk-rm67191-cmd-ram.dtb \
    freescale/imx8mn-ddr4-evk-rm67199-cmd-ram.dtb \
    freescale/imx8mn-ddr4-evk-rpmsg.dtb \
    freescale/imx8mn-ddr4-evk-usd-wifi.dtb \
    freescale/imx8mn-ddr3l-evk.dtb \
    freescale/imx8mn-ddr3l-evk-ak5558.dtb \
    freescale/imx8mn-ddr3l-evk-rpmsg.dtb \
"
```

## meta-bsp/conf/machine/imx8mnlpddr4evk.conf
```bitbake
# DEPRECATED: Machine is renamed, please use imx8mn-lpddr4-evk
MACHINEOVERRIDES =. "imx8mn-lpddr4-evk:"
require conf/machine/imx8mn-lpddr4-evk.conf
```

## meta-bsp/conf/machine/imx8mnul-ddr3l-evk.conf
```bitbake
#@TYPE: Machine
#@NAME: NXP i.MX 8MNUL EVK with DDR3L
#@SOC: i.MX8MN
#@DESCRIPTION: Machine configuration for NXP i.MX 8M Nano UltraLite Evaluation Kit with DDR3L
#@MAINTAINER: Yuqing Zhu <carol.zhu@nxp.com>

MACHINEOVERRIDES =. "mx8:mx8m:mx8mnul:"

require conf/machine/include/imx-base.inc
require conf/machine/include/arm/armv8a/tune-cortexa53.inc

MACHINE_FEATURES += " wifi bluetooth bcm43455 bcm4356 bcm4359 optee"

KERNEL_DEVICETREE = " \
    freescale/imx8mn-ddr3l-evk.dtb \
    freescale/imx8mn-ddr3l-evk-ak5558.dtb \
    freescale/imx8mn-ddr3l-evk-rpmsg.dtb \
"

WKS_FILE_DEPENDS:append = " imx-m7-demos"
IMAGE_BOOT_FILES += " \
    imx8mnddr3l_m7_TCM_hello_world.bin \
    imx8mnddr3l_m7_TCM_rpmsg_lite_pingpong_rtos_linux_remote.bin \
    imx8mnddr3l_m7_TCM_rpmsg_lite_str_echo_rtos.bin \
    imx8mnddr3l_m7_TCM_sai_low_power_audio.bin \
"

UBOOT_CONFIG ??= "sd"
UBOOT_CONFIG[sd] = "imx8mn_ddr3l_evk_config,sdcard"
UBOOT_CONFIG[fspi] = "imx8mn_ddr3l_evk_defconfig"

SPL_BINARY = "spl/u-boot-spl.bin"

ATF_PLATFORM = "imx8mn"

# Set DDR FIRMWARE
DDR_FIRMWARE_NAME = " \
    ddr3_dmem_1d_201810.bin \
    ddr3_imem_1d_201810.bin \
"

# Set u-boot DTB
UBOOT_DTB_NAME = "imx8mn-ddr3l-evk.dtb"

# Set imx-mkimage boot target
IMXBOOT_TARGETS = "${@bb.utils.contains('UBOOT_CONFIG', 'fspi', 'flash_ddr3l_evk_flexspi', \
                                                                'flash_ddr3l_evk', d)}"

IMX_BOOT_SOC_TARGET = "iMX8MN"

SERIAL_CONSOLES = "115200;ttymxc1"

IMAGE_BOOTLOADER = "imx-boot"

BOOT_SPACE = "65536"

LOADADDR = ""
UBOOT_SUFFIX:pn-u-boot-imx = "bin"
UBOOT_MAKE_TARGET:pn-u-boot-imx = ""
IMX_BOOT_SEEK = "32"
```

## meta-bsp/conf/machine/imx8mpddr4evk.conf
```bitbake
# DEPRECATED: Machine is renamed, please use imx8mp-ddr4-evk
MACHINEOVERRIDES =. "imx8mp-ddr4-evk:"
require conf/machine/imx8mp-ddr4-evk.conf
KERNEL_DEVICETREE_BASENAME = "imx8mp-ddr4-evk"
```

## meta-bsp/conf/machine/imx8mpevk.conf
```bitbake
#@TYPE: Machine
#@NAME: i.MX 8MP Consolidated Machine
#@DESCRIPTION: A consolidated machine for using i.MX 8MP EVK both LPDDR4 and DDR4, see Important Note below
#@MAINTAINER: Jun Zhu <junzhu@nxp.com>

#        ** Important Note **
# This machine generates an image contain the bootloader of LPDDR4 EVK, Kernel, and rootfs, plus the DTBs of
# both LPDDR4 and DDR4 EVKs. The resulting image can be used for LPDDR4 EVK directly, and it can
# be manually converted for DDR4 EVK following the instructions in the User Guide - Consolidated Machines section.
# For users of both EVK variants, this can save build time and space. For most users, the dedicated machines
# imx8mp-lpddr4-evk.conf and imx8mp-ddr4-evk.conf should be used for simplicity.

MACHINEOVERRIDES =. "imx8mp-lpddr4-evk:"
require conf/machine/imx8mp-lpddr4-evk.conf

# Include device trees for other boards for internal test
KERNEL_DEVICETREE += " \
    freescale/imx8mp-ddr4-evk.dtb \
"
```

## meta-bsp/conf/machine/imx8mpul-lpddr4-evk.conf
```bitbake
#@TYPE: Machine
#@NAME: NXP i.MX 8MPUL EVK with LPDDR4
#@SOC: i.MX8MP
#@DESCRIPTION: Machine configuration for NXP i.MX 8M Plus UltraLite Evaluation Kit with LPDDR4
#@MAINTAINER: Neena Busireddy <neenareddy.busireddy@nxp.com>

require conf/machine/include/imx8mpul-evk.inc

# The device tree name is implicit for LPDDR4, so can't use MACHINE here
KERNEL_DEVICETREE_BASENAME = "imx8mp-evk"

# NXP kernel has additional DTB files for various board configuration and
# derivates. Include them here for NXP BSP only
KERNEL_DEVICETREE:append:use-nxp-bsp = " \
	freescale/imx8mp-evk-hifiberry-dacplus.dtb \
	freescale/imx8mp-evk-iqaudio-dacplus.dtb \
	freescale/imx8mp-evk-iqaudio-dacpro.dtb \
"

UBOOT_CONFIG_BASENAME = "imx8mp_evk"
UBOOT_CONFIG[fspi] = "${UBOOT_CONFIG_BASENAME}_defconfig"

# Set DDR FIRMWARE
DDR_FIRMWARE_VERSION = "202006"
DDR_FIRMWARE_NAME = " \
	lpddr4_pmu_train_1d_dmem_${DDR_FIRMWARE_VERSION}.bin \
	lpddr4_pmu_train_1d_imem_${DDR_FIRMWARE_VERSION}.bin \
	lpddr4_pmu_train_2d_dmem_${DDR_FIRMWARE_VERSION}.bin \
	lpddr4_pmu_train_2d_imem_${DDR_FIRMWARE_VERSION}.bin \
"

IMXBOOT_TARGETS_BASENAME = "flash_evk"
```

## meta-bsp/conf/machine/imx8mq-lpddr4-wevk.conf
```bitbake
#@TYPE: Machine
#@NAME: NXP i.MX 8M Quad LPDDR4 WEVK
#@SOC: i.MX8MQ
#@DESCRIPTION: Machine configuration for NXP i.MX 8M Quad LPDDR4 EVK with NXP Wi-Fi
#@MAINTAINER: Jun Zhu <junzhu@nxp.com>

MACHINEOVERRIDES =. "imx8mq-evk:"
require conf/machine/imx8mq-evk.conf

UBOOT_CONFIG ??= "sd"
UBOOT_CONFIG[sd] = "imx8mq_wevk_config,sdcard"

# Set imx-mkimage boot target
IMXBOOT_TARGETS = "flash_evk flash_evk_no_hdmi"
```

## meta-bsp/conf/machine/imx8mq-wevk.conf
```bitbake
#@TYPE: Machine
#@NAME: NXP i.MX 8M Quad WEVK
#@SOC: i.MX8MQ
#@DESCRIPTION: Machine configuration for NXP i.MX 8M Quad Evaluation Kit with NXP Wi-Fi
#@MAINTAINER: Jun Zhu <junzhu@nxp.com>

MACHINEOVERRIDES =. "imx8mq-evk:"
require conf/machine/imx8mq-evk.conf

# Set imx-mkimage boot target
IMXBOOT_TARGETS = "flash_evk flash_evk_no_hdmi"
```

## meta-bsp/conf/machine/imx8mqevk.conf
```bitbake
#@TYPE: Machine
#@NAME: i.MX 8MQ Consolidated Machine
#@DESCRIPTION: A consolidated machine for using i.MX 8MQ LPDDR4 EVK and WEVK, see Important Note below
#@MAINTAINER: Jun Zhu <junzhu@nxp.com>

#        ** Important Note **
# This machine generates an image contain the bootloader of LPDDR4 EVK, Kernel, and rootfs, plus the DTBs of
# both LPDDR4 WEVKs. The resulting image can be used for LPDDR4 EVK directly, and it can
# be manually converted for LPDDR4 WEVK following the instructions in the User Guide - Consolidated Machines section.
# For users of both EVK variants, this can save build time and space. For most users, the dedicated machines
# imx8mq-lpddr4-wevk.conf and imx8mq-evk.conf should be used for simplicity.

MACHINEOVERRIDES =. "imx8mq-lpddr4-wevk:"
require conf/machine/imx8mq-lpddr4-wevk.conf
```

## meta-bsp/conf/machine/imx8qmddr4arm2.conf
```bitbake
#@TYPE: Machine
#@NAME: i.MX 8QM B0 DDR4 ARM2
#@DESCRIPTION: i.MX 8QuadMax DDR4 ARM2 Development board
#@MAINTAINER: Carol Zhu <carol.zhu@nxp.com>

MACHINEOVERRIDES =. "mx8:mx8qm:"

require conf/machine/include/imx-base.inc
require conf/machine/include/arm/armv8a/tune-cortexa72-cortexa53.inc

# Don't include kernels in standard images
RDEPENDS:${KERNEL_PACKAGE_NAME}-base = ""
RDEPENDS:${KERNEL_PACKAGE_NAME}-image = ""

LOADADDR = ""

# Disable the serial console due to auto-serial-console
SERIAL_CONSOLES = "115200;ttyAMA0"

# we do not want to have getty running on tty1 as we run
# auto-serial-console there
USE_VT = "0"

KERNEL_DEVICETREE = "freescale/imx8qm-ddr4-val.dtb "

UBOOT_MAKE_TARGET = "u-boot.bin"
UBOOT_CONFIG ??= "sd"
UBOOT_CONFIG[sd] = "imx8qm_ddr4_val_config,sdcard"

IMAGE_BOOTLOADER = "imx-boot"
IMX_BOOT_SEEK = "32"

IMAGE_BOOT_FILES += "hdmitxfw.bin hdmirxfw.bin dpfw.bin"

BOARD_TYPE = "ddr4"

# Set imx-mkimage boot target
IMXBOOT_TARGETS = "flash flash_regression_linux_m4"

IMX_BOOT_SOC_TARGET = "iMX8QM"
ATF_PLATFORM = "imx8qm"
```

## meta-bsp/conf/machine/imx8qmlpddr4arm2.conf
```bitbake
#@TYPE: Machine
#@NAME: i.MX 8QM B0 LPDDR4 ARM2
#@DESCRIPTION: i.MX 8QuadMax LPDDR4 ARM2 Development board
#@MAINTAINER: Carol Zhu <carol.zhu@nxp.com>

MACHINEOVERRIDES =. "mx8:mx8qm:"

require conf/machine/include/imx-base.inc
require conf/machine/include/arm/armv8a/tune-cortexa72-cortexa53.inc

# Don't include kernels in standard images
RDEPENDS:${KERNEL_PACKAGE_NAME}-base = ""
RDEPENDS:${KERNEL_PACKAGE_NAME}-image = ""

LOADADDR = ""

# Disable the serial console due to auto-serial-console
SERIAL_CONSOLES = "115200;ttyAMA0"

# we do not want to have getty running on tty1 as we run
# auto-serial-console there
USE_VT = "0"

KERNEL_DEVICETREE = "freescale/imx8qm-lpddr4-val.dtb \
                     freescale/imx8qm-lpddr4-val-ca53.dtb freescale/imx8qm-lpddr4-val-ca72.dtb \
                     freescale/imx8qm-lpddr4-val-dp.dtb \
                     freescale/imx8qm-lpddr4-val-lpspi.dtb freescale/imx8qm-lpddr4-val-lpspi-slave.dtb \
                     freescale/imx8qm-lpddr4-val-mqs.dtb freescale/imx8qm-lpddr4-val-spdif.dtb \
"

UBOOT_MAKE_TARGET = "u-boot.bin"
UBOOT_CONFIG ??= "sd"
UBOOT_CONFIG[sd] = "imx8qm_lpddr4_val_config,sdcard"
UBOOT_CONFIG[fspi] = "imx8qm_lpddr4_val_fspi_config"

IMAGE_BOOTLOADER = "imx-boot"
IMX_BOOT_SEEK = "32"

IMAGE_BOOT_FILES += "hdmitxfw.bin hdmirxfw.bin dpfw.bin"

BOARD_TYPE = "val"

IMXBOOT_TARGETS = "${@bb.utils.contains('UBOOT_CONFIG', 'fspi', 'flash_flexspi', \
                                                                'flash flash_regression_linux_m4', d)}"

IMX_BOOT_SOC_TARGET = "iMX8QM"
ATF_PLATFORM = "imx8qm"
```

## meta-bsp/conf/machine/imx8qmmek.conf
```bitbake
# DEPRECATED: Machine is renamed, please use imx8qm-mek
MACHINEOVERRIDES =. "imx8qm-mek:"
require conf/machine/imx8qm-mek.conf

KERNEL_DEVICETREE += "freescale/imx8qm-mek-revd-ca53.dtb \
                     freescale/imx8qm-mek-revd-ca72.dtb \
                     freescale/imx8qm-mek-revd-dsi-rm67191.dtb \
                     freescale/imx8qm-mek-revd-dsi-rm67199.dtb \
                     freescale/imx8qm-mek-revd.dtb \
                     freescale/imx8qm-mek-revd-enet2-tja1100.dtb \
                     freescale/imx8qm-mek-revd-hdmi.dtb \
                     freescale/imx8qm-mek-revd-hdmi-rx.dtb \
                     freescale/imx8qm-mek-revd-hdmi-rx-ov5640.dtb \
                     freescale/imx8qm-mek-revd-jdi-wuxga-lvds1-panel.dtb \
                     freescale/imx8qm-mek-revd-jdi-wuxga-lvds1-panel-rpmsg.dtb \
                     freescale/imx8qm-mek-revd-ov5640.dtb \
                     freescale/imx8qm-mek-revd-pcie-ep.dtb \
                     freescale/imx8qm-mek-revd-root.dtb \
                     freescale/imx8qm-mek-revd-rpmsg.dtb \
                     freescale/imx8qm-mek-revd-sof-wm8962.dtb \
                     freescale/imx8qm-mek-revd-usdhc3-m2.dtb \
                     freescale/imx8qm-mek-revd-usd-wifi.dtb \
"
```

## meta-bsp/conf/machine/imx8qxp-b0-mek.conf
```bitbake
#@TYPE: Machine
#@NAME: i.MX 8QXP B0 MEK
#@DESCRIPTION: i.MX 8QuadXPlus B0 Multisensory Enablement Kit board

# Re-use imx8qxp-mek.conf, which is for rev C0.
MACHINEOVERRIDES =. "imx8qxp-mek:"
require conf/machine/imx8qxp-mek.conf
KERNEL_DEVICETREE_BASENAME = "imx8qxp-mek"

# Make it Rev B0
MACHINE_FEATURES += "soc-revb0"
```

## meta-bsp/conf/machine/imx8qxpc0lpddr4arm2.conf
```bitbake
#@TYPE: Machine
#@NAME: i.MX 8QXP MEK
#@DESCRIPTION: i.MX 8QXP C0 LPDDR4 ARM2 Development board

MACHINEOVERRIDES =. "mx8qxpc0:"

require conf/machine/imx8qxplpddr4arm2.conf
```

## meta-bsp/conf/machine/imx8qxpc0mek.conf
```bitbake
# DEPRECATED: Machine is renamed, please use imx8qxp-mek
MACHINEOVERRIDES =. "imx8qxp-mek:"
require conf/machine/imx8qxp-mek.conf
KERNEL_DEVICETREE_BASENAME = "imx8qxp-mek"
```
