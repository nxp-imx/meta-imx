## meta-bsp/conf/machine/imx6qsabreauto.conf
```bitbake
#@TYPE: Machine
#@NAME: NXP i.MX6Q SABRE Automotive
#@SOC: i.MX6Q
#@DESCRIPTION: Machine configuration for NXP i.MX6Q SABRE Automotive
#@MAINTAINER: Daiane Angolini <daiane.angolini@nxp.com>

MACHINEOVERRIDES =. "mx6:mx6q:"

require conf/machine/include/imx6sabreauto-common.inc

KERNEL_DEVICETREE = "imx6q-sabreauto.dtb imx6q-sabreauto-gpmi-weim.dtb imx6q-sabreauto-ecspi.dtb \
                     imx6q-sabreauto-flexcan1.dtb imx6q-sabreauto-enetirq.dtb imx6q-sabreauto-pcie.dtb "

MACHINE_FEATURES_append = " optee"

UBOOT_CONFIG ??= "${@bb.utils.contains('MACHINE_FEATURES', 'optee', 'sd-optee', 'sd', d)}"
UBOOT_CONFIG[sd] = "mx6qsabreauto_config,sdcard"
UBOOT_CONFIG[eimnor] = "mx6qsabreauto_eimnor_config"
UBOOT_CONFIG[nand] = "mx6qsabreauto_nand_config,ubifs"
UBOOT_CONFIG[spinor] = "mx6qsabreauto_spinor_config"
UBOOT_CONFIG[sata] = "mx6qsabreauto_sata_config"
UBOOT_CONFIG[mfgtool] = "mx6qsabreauto_config"
UBOOT_CONFIG[sd-optee] = "mx6qsabreauto_optee_config,sdcard"

OPTEE_BIN_EXT = "6qauto"
```

## meta-bsp/conf/machine/imx6qsabresd.conf
```bitbake
#@TYPE: Machine
#@NAME: NXP i.MX6Q SABRE Smart Device
#@SOC: i.MX6Q
#@DESCRIPTION: Machine configuration for NXP i.MX6Q SABRE Smart Device
#@MAINTAINER: Otavio Salvador <otavio@ossystems.com.br>

MACHINEOVERRIDES =. "mx6:mx6q:"

require conf/machine/include/imx6sabresd-common.inc

KERNEL_DEVICETREE = " \
    nxp/imx/imx6q-sabresd.dtb \
    nxp/imx/imx6q-sabresd-btwifi.dtb \
    nxp/imx/imx6q-sabresd-enetirq.dtb \
    nxp/imx/imx6q-sabresd-hdcp.dtb \
    nxp/imx/imx6q-sabresd-ldo.dtb \
    nxp/imx/imx6q-sabresd-uart.dtb \
    nxp/imx/imx6q-sabresd-pcie.dtb \
    nxp/imx/imx6q-sabresd-pcie-ep.dtb \
"

MACHINE_FEATURES:append = " optee"

UBOOT_CONFIG ??= "${@bb.utils.contains('MACHINE_FEATURES', 'optee', 'sd-optee', 'sd', d)}"
UBOOT_CONFIG[sd] = "mx6qsabresd_config,sdcard"
UBOOT_CONFIG[sata] = "mx6qsabresd_sata_config"
UBOOT_CONFIG[sd-optee] = "mx6qsabresd_optee_config,sdcard"

OPTEE_BIN_EXT = "6qsdb"
```

## meta-bsp/conf/machine/imx6solosabresd.conf
```bitbake
#@TYPE: Machine
#@NAME: NXP i.MX6Solo SABRE Smart Device
#@SOC: i.MX6S
#@DESCRIPTION: Machine configuration for NXP i.MX6Solo SABRE Smart Device
#@MAINTAINER: Otavio Salvador <otavio@ossystems.com.br>

MACHINEOVERRIDES =. "mx6:mx6dl:"

require conf/machine/include/imx6sabresd-common.inc

KERNEL_DEVICETREE = " \
    nxp/imx/imx6dl-sabresd.dtb \
    nxp/imx/imx6dl-sabresd-ldo.dtb \
"

PREFERRED_PROVIDER_u-boot = "u-boot-imx"
PREFERRED_PROVIDER_virtual/bootloader = "u-boot-imx"
KERNEL_IMAGETYPE = "zImage"

MACHINE_FEATURES:append = " optee"

UBOOT_CONFIG ??= "${@bb.utils.contains('MACHINE_FEATURES', 'optee', 'sd-optee', 'sd', d)}"
UBOOT_CONFIG[sd] = "mx6solosabresd_config,sdcard"
UBOOT_CONFIG[sd-optee] = "mx6solosabresd_optee_config,sdcard"

OPTEE_BIN_EXT = "6solosdb"
```

## meta-bsp/conf/machine/imx6ul7d.conf
```bitbake
#@TYPE: Machine
#@NAME: NXP i.MX Common rootfs machine for mfg tools without gpu
#@SOC: i.MX6UL, i.MX6ULL and i.MX7D

#@DESCRIPTION: Machine configuration for NXP i.MX 6 and 7  boards without a gpu

# this machine builds both for 6ul/6ull and 7D in same rootfs with all device trees

MACHINEOVERRIDES =. "mx6:mx6ul:"

require conf/machine/include/imx-base.inc
require conf/machine/include/arm/armv7a/tune-cortexa7.inc

# Install epdc firmware for i.MX7D
MACHINE_FIRMWARE:append = " firmware-imx-epdc"

KERNEL_DEVICETREE = " \
    nxp/imx/imx6ul-14x14-evk.dtb \
    nxp/imx/imx6ul-14x14-evk-btwifi.dtb \
    nxp/imx/imx6ul-14x14-evk-csi.dtb \
    nxp/imx/imx6ul-14x14-evk-ecspi.dtb \
    nxp/imx/imx6ul-14x14-evk-ecspi-slave.dtb \
    nxp/imx/imx6ul-14x14-evk-emmc.dtb \
    nxp/imx/imx6ul-14x14-evk-gpmi-weim.dtb \
    nxp/imx/imx6ul-14x14-evk-reve.dtb \
    nxp/imx/imx6ul-14x14-evk-reve-btwifi.dtb \
    nxp/imx/imx6ul-14x14-evk-reve-csi.dtb \
    nxp/imx/imx6ul-14x14-evk-reve-ecspi.dtb \
    nxp/imx/imx6ul-14x14-evk-reve-ecspi-slave.dtb \
    nxp/imx/imx6ul-14x14-evk-reve-emmc.dtb \
    nxp/imx/imx6ul-14x14-evk-reve-gpmi-weim.dtb \
    nxp/imx/imx6ul-9x9-evk.dtb \
    nxp/imx/imx6ul-9x9-evk-btwifi.dtb \
    nxp/imx/imx6ul-9x9-evk-ldo.dtb \
    nxp/imx/imx7d-sdb.dtb \
    nxp/imx/imx7d-sdb-epdc.dtb \
    nxp/imx/imx7d-sdb-gpmi-weim.dtb \
    nxp/imx/imx7d-sdb-m4.dtb \
    nxp/imx/imx7d-sdb-mipi-dsi.dtb \
    nxp/imx/imx7d-sdb-mqs.dtb \
    nxp/imx/imx7d-sdb-pcie-ep.dtb \
    nxp/imx/imx7d-sdb-qspi.dtb \
    nxp/imx/imx7d-sdb-reva.dtb \
    nxp/imx/imx7d-sdb-usd-wifi.dtb \
"

#i.MX6ULL
KERNEL_DEVICETREE += " \
    nxp/imx/imx6ull-14x14-evk.dtb \
    nxp/imx/imx6ull-14x14-evk-btwifi.dtb \
    nxp/imx/imx6ull-14x14-evk-emmc.dtb \
    nxp/imx/imx6ull-14x14-evk-gpmi-weim.dtb \
    nxp/imx/imx6ull-14x14-evk-reve.dtb \
    nxp/imx/imx6ull-14x14-evk-reve-btwifi.dtb \
    nxp/imx/imx6ull-14x14-evk-reve-emmc.dtb \
    nxp/imx/imx6ull-14x14-evk-reve-gpmi-weim.dtb \
    nxp/imx/imx6ull-9x9-evk.dtb \
    nxp/imx/imx6ull-9x9-evk-btwifi.dtb \
    nxp/imx/imx6ull-9x9-evk-ldo.dtb \
"

#i.MX6ULZ
KERNEL_DEVICETREE += " \
    nxp/imx/imx6ulz-14x14-evk.dtb \
    nxp/imx/imx6ulz-14x14-evk-btwifi.dtb \
    nxp/imx/imx6ulz-14x14-evk-emmc.dtb \
    nxp/imx/imx6ulz-14x14-evk-gpmi-weim.dtb \
    nxp/imx/imx6ulz-14x14-evk-reve.dtb \
    nxp/imx/imx6ulz-14x14-evk-reve-btwifi.dtb \
    nxp/imx/imx6ulz-14x14-evk-reve-emmc.dtb \
    nxp/imx/imx6ulz-14x14-evk-reve-gpmi-weim.dtb \
"

#imx7d val
KERNEL_DEVICETREE += " \
    nxp/imx/imx7d-12x12-lpddr3-val.dtb \
    nxp/imx/imx7d-12x12-lpddr3-val-sai.dtb \
"

MACHINE_FEATURES:append = " pci wifi bluetooth optee bcm4339 bcm43455 nxpwifi-all-sdio"

##UBOOT_MACHINE = "mx6ul_14x14_evk_config"
UBOOT_CONFIG ??= "${@bb.utils.contains('MACHINE_FEATURES', 'optee', 'sd-optee', 'sd', d)}"
UBOOT_CONFIG[sd] = "mx6ul_14x14_evk_config,sdcard"
UBOOT_CONFIG[sd-optee] = "mx6ul_14x14_evk_optee_config,sdcard"

OPTEE_BIN_EXT = "6ulevk"
```

## meta-bsp/conf/machine/imx6ul9x9evk.conf
```bitbake
#@TYPE: Machine
#@NAME: NXP i.MX6UL 9x9 Evaluation Kit
#@SOC: i.MX6UL
#@DESCRIPTION: Machine configuration for NXP i.MX6UL EVK 9x9
#@MAINTAINER: Lauren Post <lauren.post@nxp.com>

MACHINEOVERRIDES =. "mx6:mx6ul:"

include conf/machine/include/imx-base.inc
include conf/machine/include/arm/armv7a/tune-cortexa7.inc

KERNEL_DEVICETREE = " \
    nxp/imx/imx6ul-9x9-evk.dtb \
    nxp/imx/imx6ul-9x9-evk-btwifi.dtb \
    nxp/imx/imx6ul-9x9-evk-ldo.dtb \
"

UBOOT_CONFIG ??= "${@bb.utils.contains('MACHINE_FEATURES', 'optee', 'sd-optee', 'sd', d)}"
UBOOT_CONFIG[sd] = "mx6ul_9x9_evk_config,sdcard"
UBOOT_CONFIG[qspi1] = "mx6ul_9x9_evk_qspi1_config"
UBOOT_CONFIG[sd-optee] = "mx6ul_9x9_evk_optee_config,sdcard"

OPTEE_BIN_EXT = "6ul9x9evk"

MACHINE_FEATURES += "wifi bluetooth optee bcm4339 bcm43455"
```

## meta-bsp/conf/machine/imx6ull14x14evk.conf
```bitbake
#@TYPE: Machine
#@NAME: NXP i.MX6ULL 14x14 Evaluation Kit
#@SOC: i.MX6ULL
#@DESCRIPTION: Machine configuration for NXP i.MX6ULL 14x14 EVK
#@MAINTAINER: Lauren Post <lauren.post@nxp.com>

MACHINEOVERRIDES =. "mx6:mx6ul:mx6ull:"

include conf/machine/include/imx-base.inc
include conf/machine/include/arm/armv7a/tune-cortexa7.inc

KERNEL_DEVICETREE = " \
    nxp/imx/imx6ull-14x14-evk.dtb \
    nxp/imx/imx6ull-14x14-evk-btwifi.dtb \
    nxp/imx/imx6ull-14x14-evk-emmc.dtb \
    nxp/imx/imx6ull-14x14-evk-gpmi-weim.dtb \
    nxp/imx/imx6ull-14x14-evk-reve.dtb \
    nxp/imx/imx6ull-14x14-evk-reve-btwifi.dtb \
    nxp/imx/imx6ull-14x14-evk-reve-emmc.dtb \
    nxp/imx/imx6ull-14x14-evk-reve-gpmi-weim.dtb \
"

UBOOT_CONFIG ??= "${@bb.utils.contains('MACHINE_FEATURES', 'optee', 'sd-optee', 'sd', d)}"
UBOOT_CONFIG[sd] = "mx6ull_14x14_evk_config,sdcard"
UBOOT_CONFIG[emmc] = "mx6ull_14x14_evk_emmc_config,sdcard"
UBOOT_CONFIG[nand] = "mx6ull_14x14_evk_nand_config,ubifs"
UBOOT_CONFIG[qspi1] = "mx6ull_14x14_evk_qspi1_config"
UBOOT_CONFIG[sd-optee] = "mx6ull_14x14_evk_optee_config,sdcard"

OPTEE_BIN_EXT = "6ullevk"

MACHINE_FEATURES += "wifi bluetooth optee bcm4339 bcm43455"
```

## meta-bsp/conf/machine/imx6ull9x9evk.conf
```bitbake
#@TYPE: Machine
#@NAME: NXP i.MX6ULL 9x9 Evaluation Kit
#@SOC: i.MX6ULL
#@DESCRIPTION: Machine configuration for NXP i.MX6ULL 9x9 EVK
#@MAINTAINER: Lauren Post <lauren.post@nxp.com>

MACHINEOVERRIDES =. "mx6:mx6ul:mx6ull:"

include conf/machine/include/imx-base.inc
include conf/machine/include/arm/armv7a/tune-cortexa7.inc

MACHINE_FIRMWARE:append = " firmware-imx-epdc"

KERNEL_DEVICETREE = " \
    nxp/imx/imx6ull-9x9-evk.dtb \
    nxp/imx/imx6ull-9x9-evk-btwifi.dtb \
    nxp/imx/imx6ull-9x9-evk-ldo.dtb"

UBOOT_CONFIG ??= "${@bb.utils.contains('MACHINE_FEATURES', 'optee', 'sd-optee', 'sd', d)}"
UBOOT_CONFIG[sd] = "mx6ull_9x9_evk_config,sdcard"
UBOOT_CONFIG[qspi1] = "mx6ull_9x9_evk_qspi1_config"
UBOOT_CONFIG[sd-optee] = "mx6ull_14x14_evk_optee_config,sdcard"

OPTEE_BIN_EXT = "6ullevk"

MACHINE_FEATURES += "wifi bluetooth optee bcm4339 bcm43455"
```

## meta-bsp/conf/machine/imx6ulz14x14evk.conf
```bitbake
# DEPRECATED: Machine is renamed, please use imx6ulz-14x14-evk
MACHINEOVERRIDES =. "imx6ulz-14x14-evk:"
require conf/machine/imx6ulz-14x14-evk.conf
```

## meta-bsp/conf/machine/imx7d12x12lpddr3arm2.conf
```bitbake
#@TYPE: Machine
#@NAME: NXP i.MX7D 12x12 LPDDR3 ARM2 Evaluation Kit
#@SOC: i.MX7D
#@DESCRIPTION: Machine configuration for NXP i.MX7D 12x12 LPDDR3 ARM2 Evaluation Kit
#@MAINTAINER: Lauren Post <Lauren.Post@nxp.com>

MACHINEOVERRIDES =. "mx7:mx7d:"

require conf/machine/include/imx-base.inc
require conf/machine/include/tune-cortexa7.inc

MACHINE_FEATURES += " pci wifi bluetooth"

KERNEL_DEVICETREE = "imx7d-12x12-lpddr3-arm2.dtb imx7d-12x12-lpddr3-arm2-ecspi.dtb imx7d-12x12-lpddr3-arm2-enet2.dtb \
                     imx7d-12x12-lpddr3-arm2-m4.dtb imx7d-12x12-lpddr3-arm2-mipi_dsi.dtb \
                     imx7d-12x12-lpddr3-arm2-mqs.dtb imx7d-12x12-lpddr3-arm2-pcie.dtb imx7d-12x12-lpddr3-arm2-qspi.dtb \
                     imx7d-12x12-lpddr3-arm2-sai.dtb imx7d-12x12-lpddr3-arm2-flexcan.dtb \
"

UBOOT_CONFIG ??= "sd"
UBOOT_CONFIG[sd] = "mx7d_12x12_lpddr3_val_config,sdcard"
UBOOT_CONFIG[epdc] = "mx7d_12x12_lpddr3_val_config"
UBOOT_CONFIG[qspi1] = "mx7d_12x12_lpddr3_val_qspi1_config"
UBOOT_CONFIG[spinor] = "mx7d_12x12_lpddr3_val_spinor_config"
UBOOT_CONFIG[mfgtool] = "mx7d_12x12_lpddr3_val_config"
```

## meta-bsp/conf/machine/imx8_all.conf
```bitbake
#@TYPE: Machine
#@NAME: i.MX 8 Common rootfs machine
#@SOC: i.MX 8QM and 8QXP
#@DESCRIPTION: Machine configuration for i.MX 8QM and 8QXP boards
#@MAINTAINER: Jun Zhu <junzhu@nxp.com>

MACHINEOVERRIDES =. "mx8:mx8qm:"

require conf/machine/include/imx-base.inc
require conf/machine/include/arm/armv8a/tune-cortexa72-cortexa53.inc

MACHINE_FEATURES:append = " optee bcm43455 bcm4356 bcm4359"

# Don't include kernels in standard images
RDEPENDS:${KERNEL_PACKAGE_NAME}-base = ""
RDEPENDS:${KERNEL_PACKAGE_NAME}-image = ""

LOADADDR = ""

# Disable the serial console due to auto-serial-console
SERIAL_CONSOLES = "115200;ttyAMA0"

# we do not want to have getty running on tty1 as we run
# auto-serial-console there
USE_VT = "0"

# DEVICETREE of i.MX 8MM
KERNEL_DEVICETREE = "\
"

# DEVICETREE of i.MX 8MN
KERNEL_DEVICETREE += "\
"

# DEVICETREE of i.MX 8MQ
KERNEL_DEVICETREE += "\
"

# DEVICETREE of i.MX 8MP
KERNEL_DEVICETREE += " \
"

# DEVICETREE of i.MX 8QM
KERNEL_DEVICETREE += "\
"

# DEVICETREE of i.MX 8QM Validation
KERNEL_DEVICETREE += "\
"

# DEVICETREE of i.MX 8QXP
KERNEL_DEVICETREE += "\
"

# DEVICETREE of i.MX 8QXP Validation
KERNEL_DEVICETREE += "\
"

# DEVICETREE of i.MX 8DXL
KERNEL_DEVICETREE += "\
                      "

# DEVICETREE of i.MX 8DXL DDR3 EVK Board
KERNEL_DEVICETREE += ""

# DEVICETREE of i.MX 8ULP
KERNEL_DEVICETREE += " \
"

UBOOT_MAKE_TARGET = \
    "${@bb.utils.contains('MACHINE_FEATURES', 'optee', '', \
                                                        'u-boot.bin', d)}"
SPL_BINARY = \
    "${@bb.utils.contains('MACHINE_FEATURES', 'optee', 'spl/u-boot-spl.bin', \
                                                        '', d)}"
UBOOT_CONFIG ??= "sd"
UBOOT_CONFIG[sd]   = "imx8qm_mek_defconfig,sdcard"
UBOOT_CONFIG[fspi] = "imx8qm_mek_fspi_defconfig"

IMAGE_BOOTLOADER = "imx-boot"
IMX_BOOT_SEEK = "32"

IMAGE_BOOT_FILES += "hdmitxfw.bin hdmirxfw.bin dpfw.bin"

BOARD_TYPE = "mek"

IMXBOOT_TARGETS_SD = \
    "${@bb.utils.contains('MACHINE_FEATURES', 'optee', 'flash_b0_spl_container', \
                                                        'flash_b0', d)}"
IMXBOOT_TARGETS_FSPI = \
    "${@bb.utils.contains('MACHINE_FEATURES', 'optee', 'flash_b0_spl_flexspi_container', \
                                                        'flash_b0_flexspi', d)}"
IMXBOOT_TARGETS = \
    "${@bb.utils.contains('UBOOT_CONFIG',         'sd', '${IMXBOOT_TARGETS_SD}', \
                                                        '${IMXBOOT_TARGETS_FSPI}', d)}"
```

## meta-bsp/conf/machine/imx8dxla1-lpddr4-evk.conf
```bitbake
#@TYPE: Machine
#@NAME: i.MX 8DXL A1 EVK with LPDDR4
#@SOC: i.MX8DXL A1
#@DESCRIPTION: Machine configuration for NXP i.MX 8DualXLite A1 Evaluation Kit with LPDDR4
#@MAINTAINER: Lauren Post <lauren.post@nxp.com>

require conf/machine/imx8dxl-a1-lpddr4-evk.conf
```

## meta-bsp/conf/machine/imx8dxla1evk.conf
```bitbake
#@TYPE: Machine
#@NAME: i.MX 8DXL A1 EVK
#@DESCRIPTION: i.MX 8DXL A1 Evaluation Kit (EVK) board

MACHINEOVERRIDES =. "mx8:mx8x:mx8dxl:mx8dxla1:"

require conf/machine/include/imx-base.inc
require conf/machine/include/arm/arch-arm64.inc
require conf/machine/include/imx8dxl-common.inc

KERNEL_DEVICETREE = "freescale/imx8dxl-evk.dtb \
                     freescale/imx8dxl-evk-enet0.dtb freescale/imx8dxl-evk-enet0-tja1100.dtb \
                     freescale/imx8dxl-evk-inmate.dtb \
                     freescale/imx8dxl-evk-lcdif.dtb freescale/imx8dxl-evk-lpspi-slave.dtb \
                     freescale/imx8dxl-evk-pcie-ep.dtb \
                     freescale/imx8dxl-evk-root.dtb \
                     freescale/imx8dxl-evk-rpmsg.dtb"

UBOOT_CONFIG ??= "sd"
UBOOT_CONFIG[sd]   = "imx8dxl_evk_defconfig,sdcard"
UBOOT_CONFIG[fspi]   = "imx8dxl_evk_fspi_defconfig"

BOARD_TYPE = "evk"
```

## meta-bsp/conf/machine/imx8dxlb0-ddr3l-evk.conf
```bitbake
require conf/machine/include/imx8dxl-ddr3l-evk.inc

IMX_SOC_REV = "B0"

MACHINE_FEATURES:append:use-nxp-bsp = " optee"
```

## meta-bsp/conf/machine/imx8dxlb0-lpddr4-evk.conf
```bitbake
require conf/machine/include/imx8dxl-lpddr4-evk.inc

IMX_SOC_REV = "B0"

MACHINE_FEATURES:append:use-nxp-bsp = " optee"
```

## meta-bsp/conf/machine/imx8dxlb0ddr3levk.conf
```bitbake
#@TYPE: Machine
#@NAME: i.MX 8DXL B0 EVK
#@DESCRIPTION: i.MX 8DXL B0 Evaluation Kit (EVK) board

MACHINEOVERRIDES =. "mx8:mx8x:mx8dxl:mx8dxlb0:"

require conf/machine/include/imx-base.inc
require conf/machine/include/arm/arch-arm64.inc
require conf/machine/include/imx8dxl-common.inc

MACHINE_FEATURES_append = " optee"

# Add DTB of i.MX 8DXL DDR3 EVK
KERNEL_DEVICETREE += "freescale/imx8dxl-ddr3-evk.dtb \
                     freescale/imx8dxl-ddr3-evk-rpmsg.dtb \
"

UBOOT_CONFIG ??= "sd"
UBOOT_CONFIG[sd]   = "imx8dxl_ddr3_evk_defconfig,sdcard"
UBOOT_CONFIG[nand]   = "imx8dxl_ddr3_evk_nand_defconfig,ubifs"

BOARD_TYPE = "ddr3-evk"
```

## meta-bsp/conf/machine/imx8dxlddr3evk.conf
```bitbake
# DEPRECATED: Machine is renamed, please use imx8dxl-ddr3l-evk
MACHINEOVERRIDES =. "imx8dxl-ddr3l-evk:"
require conf/machine/imx8dxl-ddr3l-evk.conf
BOARD_TYPE = "ddr3-evk"
UBOOT_CONFIG_BASENAME = "imx8dxl_ddr3l_evk"
UBOOT_CONFIG[fspi] = "${UBOOT_CONFIG_BASENAME}_fspi_defconfig"
UBOOT_CONFIG[nand] = "${UBOOT_CONFIG_BASENAME}_nand_defconfig"
```

## meta-bsp/conf/machine/imx8dxlevk.conf
```bitbake
# DEPRECATED: Machine is renamed, please use imx8dxl-lpddr4-evk
MACHINEOVERRIDES =. "imx8dxl-lpddr4-evk:"
require conf/machine/imx8dxl-lpddr4-evk.conf

# Include device trees for other boards for internal test
KERNEL_DEVICETREE += " \
    freescale/imx8dxl-ddr3-evk.dtb \
    freescale/imx8dxl-ddr3-evk-rpmsg.dtb \
"
```
