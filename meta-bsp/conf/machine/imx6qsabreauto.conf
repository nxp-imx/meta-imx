## meta-bsp/conf/machine/imx8dxlphantommek.conf
```bitbake
#@TYPE: Machine
#@NAME: i.MX 8DXL Phantom MEK
#@DESCRIPTION: i.MX 8DXL Phantom Multisensory Enablement Kit (MEK) board

MACHINEOVERRIDES =. "mx8:mx8x:mx8phantomdxl:"

require conf/machine/include/imx-base.inc
require conf/machine/include/arm/arch-arm64.inc

MACHINE_FEATURES_append = " pci bcm43455 bcm4356 bcm4359"

# Don't include kernels in standard images
RDEPENDS_${KERNEL_PACKAGE_NAME}-base = ""
RDEPENDS_${KERNEL_PACKAGE_NAME}-image = ""

LOADADDR = ""

# Disable the serial console due to auto-serial-console
SERIAL_CONSOLES = "115200;ttyLP0"

# we do not want to have getty running on tty1 as we run
# auto-serial-console there
USE_VT = "0"

KERNEL_DEVICETREE = "freescale/imx8dxl-phantom-mek.dtb freescale/imx8dxl-phantom-mek-rpmsg.dtb"

UBOOT_MAKE_TARGET = "all"
SPL_BINARY = "spl/u-boot-spl.bin"

UBOOT_CONFIG ??= "sd"
UBOOT_CONFIG[sd]   = "imx8dxl_phantom_mek_defconfig,sdcard"
UBOOT_CONFIG[fspi] = "imx8dxl_phantom_mek_fspi_defconfig"

IMAGE_BOOTLOADER = "imx-boot"
IMX_BOOT_SEEK = "32"

IMXBOOT_TARGETS = \
    "${@bb.utils.contains('UBOOT_CONFIG',         'sd', 'flash flash_regression_linux_m4 flash_spl', \
                                                        'flash_flexspi flash_spl_flexspi', d)}"

BOARD_TYPE = "mek"
```

## meta-bsp/conf/machine/imx8dxmek.conf
```bitbake
# DEPRECATED: Machine is renamed, please use imx8dx-mek
MACHINEOVERRIDES =. "imx8dx-mek:"
require conf/machine/imx8dx-mek.conf
KERNEL_DEVICETREE_BASENAME = "imx8dx-mek"
```

## meta-bsp/conf/machine/imx8mm-ddr4-ab2.conf
```bitbake
#@TYPE: Machine
#@NAME: NXP i.MX 8M Mini Audio Board 2.0 with DDR4
#@SOC: i.MX8MM
#@DESCRIPTION: Machine configuration for NXP i.MX 8M Mini AB2 with DDR4
#@MAINTAINER: Adrian Alonso <adrian.alonso@nxp.com>

require include/imx8mm-ab2.inc

KERNEL_DEVICETREE_BASENAME = "${MACHINE}"
KERNEL_DEVICETREE:append:use-nxp-bsp = " \
    freescale/imx8mm-ddr4-ab2-m4.dtb \
    freescale/imx8mm-ddr4-ab2-revb.dtb \
    freescale/imx8mm-ddr4-ab2-m4-revb.dtb \
"

UBOOT_CONFIG_BASENAME = "imx8mm_ddr4_ab2"

DDR_FIRMWARE_NAME = " \
    ddr4_imem_1d.bin \
    ddr4_dmem_1d.bin \
    ddr4_imem_2d.bin \
    ddr4_dmem_2d.bin \
"
IMXBOOT_TARGETS_BASENAME = "flash_ddr4_evk"
```

## meta-bsp/conf/machine/imx8mm-lpddr4-ab2.conf
```bitbake
#@TYPE: Machine
#@NAME: NXP i.MX 8M Mini Audio Board 2.0 with LPDDR4
#@SOC: i.MX8MM
#@DESCRIPTION: Machine configuration for NXP i.MX 8M Mini AB2 with LPDDR4
#@MAINTAINER: Adrian Alonso <adrian.alonso@nxp.com>

require include/imx8mm-ab2.inc

# The device tree name is implicit for LPDDR4, so can't use MACHINE here
KERNEL_DEVICETREE_BASENAME = "imx8mm-ab2"

UBOOT_CONFIG_BASENAME = "imx8mm_ab2"
UBOOT_CONFIG[fspi] = "${UBOOT_CONFIG_BASENAME}_fspi_defconfig"

DDR_FIRMWARE_NAME = " \
    lpddr4_pmu_train_1d_imem.bin \
    lpddr4_pmu_train_1d_dmem.bin \
    lpddr4_pmu_train_2d_imem.bin \
    lpddr4_pmu_train_2d_dmem.bin \
"

IMXBOOT_TARGETS_BASENAME = "flash_evk"
```

## meta-bsp/conf/machine/imx8mmddr3lval.conf
```bitbake
#@TYPE: Machine
#@NAME: NXP i.MX8MM DDR3L Validation Board
#@SOC: i.MX8MM
#@DESCRIPTION: Machine configuration for NXP i.MX8MM DDR3L Validation board
#@MAINTAINER: Carol Zhu <carol.zhu@nxp.com>

MACHINEOVERRIDES =. "mx8:mx8m:mx8mm:"

require conf/machine/include/imx-base.inc
require conf/machine/include/tune-cortexa53.inc

MACHINE_FEATURES += " pci wifi bluetooth optee qca9377"

KERNEL_DEVICETREE = "freescale/imx8mm-ddr3l-val.dtb "

WKS_FILE_DEPENDS_append = " imx-m4-demos"
IMAGE_BOOT_FILES += "imx8mm_m4_TCM_hello_world.bin \
                    imx8mm_m4_TCM_rpmsg_lite_pingpong_rtos_linux_remote.bin \
                    imx8mm_m4_TCM_rpmsg_lite_str_echo_rtos.bin \
                    imx8mm_m4_TCM_sai_low_power_audio.bin \
"

UBOOT_CONFIG ??= "sd"
UBOOT_CONFIG[sd] = "imx8mm_ddr3l_val_config,sdcard"
SPL_BINARY = "spl/u-boot-spl.bin"

# Set DDR FIRMWARE
DDR_FIRMWARE_NAME = "ddr3_imem_1d.bin ddr3_dmem_1d.bin"

# Set u-boot DTB
UBOOT_DTB_NAME = "imx8mm-ddr3l-val.dtb"

# Set imx-mkimage boot target
IMXBOOT_TARGETS = "flash_ddr3l_val"

SERIAL_CONSOLES = "115200;ttymxc1"

IMAGE_BOOTLOADER = "imx-boot"

LOADADDR = ""
IMX_BOOT_SEEK = "33"
```

## meta-bsp/conf/machine/imx8mmddr4evk.conf
```bitbake
# DEPRECATED: Machine is renamed, please use imx8mm-ddr4-evk
MACHINEOVERRIDES =. "imx8mm-ddr4-evk:"
require conf/machine/imx8mm-ddr4-evk.conf
KERNEL_DEVICETREE_BASENAME = "imx8mm-ddr4-evk"
```

## meta-bsp/conf/machine/imx8mmddr4val.conf
```bitbake
#@TYPE: Machine
#@NAME: NXP i.MX8MM DDR4 Validation Board
#@SOC: i.MX8MM
#@DESCRIPTION: Machine configuration for NXP i.MX8MMini DDR4 validation board
#@MAINTAINER: Carol Zhu <carol.zhu@nxp.com>

MACHINEOVERRIDES =. "mx8:mx8m:mx8mm:"

require conf/machine/include/imx-base.inc
require conf/machine/include/tune-cortexa53.inc

MACHINE_FEATURES += " pci wifi bluetooth qca9377"

KERNEL_DEVICETREE = "freescale/imx8mm-ddr4-val.dtb"

WKS_FILE_DEPENDS_append = " imx-m4-demos"
IMAGE_BOOT_FILES += "imx8mm_m4_TCM_hello_world.bin \
                    imx8mm_m4_TCM_rpmsg_lite_pingpong_rtos_linux_remote.bin \
                    imx8mm_m4_TCM_rpmsg_lite_str_echo_rtos.bin \
                    imx8mm_m4_TCM_sai_low_power_audio.bin \
"

UBOOT_CONFIG ??= "sd"
UBOOT_CONFIG[sd] = "imx8mm_ddr4_val_config,sdcard"
SPL_BINARY = "spl/u-boot-spl.bin"

# Set DDR FIRMWARE
DDR_FIRMWARE_NAME = "ddr4_imem_1d.bin ddr4_dmem_1d.bin ddr4_imem_2d.bin ddr4_dmem_2d.bin"

# Set u-boot DTB
UBOOT_DTB_NAME = "imx8mm-ddr4-val.dtb"

# Set imx-mkimage boot target
IMXBOOT_TARGETS = "flash_ddr4_val"

SERIAL_CONSOLES = "115200;ttymxc1"

IMAGE_BOOTLOADER = "imx-boot"

LOADADDR = ""
IMX_BOOT_SEEK = "33"
```
